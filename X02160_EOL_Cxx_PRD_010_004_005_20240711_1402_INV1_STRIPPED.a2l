/* generated by ASAP2 Merger - ASAP2 Tool-Set Version 13.0.20 */
ASAP2_VERSION 1 70
/begin PROJECT bsw_structure ""
/begin MODULE CPP ""
/begin MOD_PAR "" ADDR_EPK 0x0 /end MOD_PAR
/begin MOD_COMMON "" BYTE_ORDER MSB_LAST ALIGNMENT_BYTE 1 ALIGNMENT_WORD 2 ALIGNMENT_LONG 2 ALIGNMENT_FLOAT32_IEEE 2 ALIGNMENT_FLOAT64_IEEE 2 ALIGNMENT_INT64 2 /end MOD_COMMON
/begin IF_DATA XCP
 /begin PROTOCOL_LAYER 0x0104 0x07D0 0x2710 0x07D0 0x07D0 0x07D0 0x07D0 0x00 0x40 0x40 BYTE_ORDER_MSB_LAST ADDRESS_GRANULARITY_BYTE OPTIONAL_CMD SET_REQUEST OPTIONAL_CMD SET_MTA OPTIONAL_CMD UPLOAD OPTIONAL_CMD SHORT_UPLOAD OPTIONAL_CMD BUILD_CHECKSUM OPTIONAL_CMD TRANSPORT_LAYER_CMD OPTIONAL_CMD DOWNLOAD OPTIONAL_CMD DOWNLOAD_MAX OPTIONAL_CMD SET_DAQ_PTR OPTIONAL_CMD WRITE_DAQ OPTIONAL_CMD SET_DAQ_LIST_MODE OPTIONAL_CMD GET_DAQ_LIST_MODE OPTIONAL_CMD START_STOP_DAQ_LIST OPTIONAL_CMD START_STOP_SYNCH OPTIONAL_CMD GET_DAQ_CLOCK OPTIONAL_CMD GET_DAQ_PROCESSOR_INFO OPTIONAL_CMD GET_DAQ_RESOLUTION_INFO OPTIONAL_CMD GET_DAQ_EVENT_INFO OPTIONAL_CMD FREE_DAQ OPTIONAL_CMD ALLOC_DAQ OPTIONAL_CMD ALLOC_ODT OPTIONAL_CMD ALLOC_ODT_ENTRY OPTIONAL_CMD WRITE_DAQ_MULTIPLE COMMUNICATION_MODE_SUPPORTED BLOCK SLAVE /end PROTOCOL_LAYER
 /begin DAQ DYNAMIC 0x15 0x0C 0x00 OPTIMISATION_TYPE_DEFAULT ADDRESS_EXTENSION_FREE IDENTIFICATION_FIELD_TYPE_ABSOLUTE GRANULARITY_ODT_ENTRY_SIZE_DAQ_BYTE 0x07 OVERLOAD_INDICATION_PID PRESCALER_SUPPORTED RESUME_SUPPORTED /begin STIM GRANULARITY_ODT_ENTRY_SIZE_STIM_BYTE 0x07 /end STIM /begin TIMESTAMP_SUPPORTED 0x01 SIZE_WORD UNIT_1MS /end TIMESTAMP_SUPPORTED
  /begin EVENT "XcpEventChannel_Core0_20ms" "XcpEvent" 0x04 DAQ 0x01 0x02 0x07 0x00 /end EVENT
  /begin EVENT "XcpEventChannel_Core0_2ms" "XcpEvent" 0x01 DAQ 0x01 0x02 0x06 0x00 /end EVENT
  /begin EVENT "XcpEventChannel_Core0_10ms" "XcpEvent" 0x03 DAQ 0x01 0x01 0x07 0x00 /end EVENT
  /begin EVENT "XcpEventChannel_Core0_1ms" "XcpEvent" 0x00 DAQ 0x01 0x01 0x06 0x00 /end EVENT
  /begin EVENT "XcpEventChannel_Core0_5ms" "XcpEvent" 0x02 DAQ 0x01 0x05 0x06 0x00 /end EVENT
  /begin EVENT "XcpEventChannel_Core1_100ms" "XcpEvent" 0x07 DAQ 0x01 0x01 0x08 0x00 /end EVENT
  /begin EVENT "XcpEventChannel_Core1_10ms" "XcpEvent" 0x06 DAQ 0x01 0x01 0x07 0x00 /end EVENT
  /begin EVENT "XcpEventChannel_Core1_1000ms" "XcpEvent" 0x08 DAQ 0x01 0x0A 0x08 0x00 /end EVENT
  /begin EVENT "XcpEventChannel_Core1_2ms" "XcpEvent" 0x05 DAQ 0x01 0x02 0x06 0x00 /end EVENT
  /begin EVENT "XcpEventChannel_Core2_1ms" "XcpEvent" 0x09 DAQ 0x01 0x01 0x06 0x00 /end EVENT
  /begin EVENT "XcpEventChannel_Core2_2ms" "XcpEvent" 0x0A DAQ 0x01 0x02 0x06 0x00 /end EVENT
  /begin EVENT "XcpEventChannel_Core2_10ms" "XcpEvent" 0x0B DAQ 0x01 0x01 0x07 0x00 /end EVENT
 /end DAQ
 /begin XCP_ON_CAN 0x0102 CAN_ID_MASTER 0xD8E06209 CAN_ID_SLAVE 0xD8E06208 BAUDRATE 0x07A120 SAMPLE_POINT 0x51 SAMPLE_RATE SINGLE BTL_CYCLES 0x50 SJW 0x0F
  /begin CAN_FD MAX_DLC 0x40 CAN_FD_DATA_TRANSFER_BAUDRATE 0x1E8480 SAMPLE_POINT 0x3C BTL_CYCLES 0x14 SJW 0x04 SECONDARY_SAMPLE_POINT 0x00 TRANSCEIVER_DELAY_COMPENSATION OFF /end CAN_FD
  /begin PROTOCOL_LAYER 0x0104 0x07D0 0x2710 0x07D0 0x07D0 0x07D0 0x07D0 0x00 0x40 0x40 BYTE_ORDER_MSB_LAST ADDRESS_GRANULARITY_BYTE OPTIONAL_CMD SET_REQUEST OPTIONAL_CMD SET_MTA OPTIONAL_CMD UPLOAD OPTIONAL_CMD SHORT_UPLOAD OPTIONAL_CMD BUILD_CHECKSUM OPTIONAL_CMD DOWNLOAD OPTIONAL_CMD DOWNLOAD_MAX OPTIONAL_CMD SET_DAQ_PTR OPTIONAL_CMD WRITE_DAQ OPTIONAL_CMD SET_DAQ_LIST_MODE OPTIONAL_CMD GET_DAQ_LIST_MODE OPTIONAL_CMD START_STOP_DAQ_LIST OPTIONAL_CMD START_STOP_SYNCH OPTIONAL_CMD GET_DAQ_CLOCK OPTIONAL_CMD GET_DAQ_PROCESSOR_INFO OPTIONAL_CMD GET_DAQ_RESOLUTION_INFO OPTIONAL_CMD GET_DAQ_EVENT_INFO OPTIONAL_CMD FREE_DAQ OPTIONAL_CMD ALLOC_DAQ OPTIONAL_CMD ALLOC_ODT OPTIONAL_CMD ALLOC_ODT_ENTRY OPTIONAL_CMD WRITE_DAQ_MULTIPLE COMMUNICATION_MODE_SUPPORTED BLOCK SLAVE /end PROTOCOL_LAYER
 /end XCP_ON_CAN
 /begin XCP_ON_TCP_IP 0x0100 0x15B3 ADDRESS "192.168.0.2"
  /begin PROTOCOL_LAYER 0x0104 0x07D0 0x2710 0x07D0 0x07D0 0x07D0 0x07D0 0x00 0xFF 0xFA BYTE_ORDER_MSB_LAST ADDRESS_GRANULARITY_BYTE OPTIONAL_CMD GET_COMM_MODE_INFO OPTIONAL_CMD GET_ID OPTIONAL_CMD SET_REQUEST OPTIONAL_CMD GET_SEED OPTIONAL_CMD UNLOCK OPTIONAL_CMD SET_MTA OPTIONAL_CMD UPLOAD OPTIONAL_CMD SHORT_UPLOAD OPTIONAL_CMD BUILD_CHECKSUM OPTIONAL_CMD TRANSPORT_LAYER_CMD OPTIONAL_CMD USER_CMD OPTIONAL_CMD CLEAR_DAQ_LIST OPTIONAL_CMD SET_DAQ_PTR OPTIONAL_CMD WRITE_DAQ OPTIONAL_CMD SET_DAQ_LIST_MODE OPTIONAL_CMD GET_DAQ_LIST_MODE OPTIONAL_CMD GET_DAQ_LIST_INFO OPTIONAL_CMD START_STOP_DAQ_LIST OPTIONAL_CMD START_STOP_SYNCH OPTIONAL_CMD GET_DAQ_CLOCK OPTIONAL_CMD READ_DAQ OPTIONAL_CMD GET_DAQ_PROCESSOR_INFO OPTIONAL_CMD GET_DAQ_RESOLUTION_INFO OPTIONAL_CMD GET_DAQ_EVENT_INFO OPTIONAL_CMD FREE_DAQ OPTIONAL_CMD ALLOC_DAQ OPTIONAL_CMD ALLOC_ODT OPTIONAL_CMD ALLOC_ODT_ENTRY OPTIONAL_CMD GET_PGM_PROCESSOR_INFO OPTIONAL_CMD GET_SECTOR_INFO OPTIONAL_CMD WRITE_DAQ_MULTIPLE COMMUNICATION_MODE_SUPPORTED BLOCK SLAVE /end PROTOCOL_LAYER
  /begin DAQ DYNAMIC 0x00 0x05 0x00 OPTIMISATION_TYPE_DEFAULT ADDRESS_EXTENSION_FREE IDENTIFICATION_FIELD_TYPE_ABSOLUTE GRANULARITY_ODT_ENTRY_SIZE_DAQ_BYTE 0xF8 OVERLOAD_INDICATION_PID /begin TIMESTAMP_SUPPORTED 0x01 SIZE_DWORD UNIT_1US /end TIMESTAMP_SUPPORTED
   /begin EVENT "ev_vx1000_20ms_start" "ev_vx1000" 0x10 DAQ 0x01 0x14 0x06 0x06 /end EVENT
   /begin EVENT "ev_vx1000_20ms_end" "ev_vx1000" 0x11 DAQ 0x01 0x14 0x06 0x06 /end EVENT
   /begin EVENT "ev_vx1000_10ms_start" "ev_vx1000" 0x0E DAQ 0x01 0x0A 0x06 0x05 /end EVENT
   /begin EVENT "ev_vx1000_10ms_end" "ev_vx1000" 0x0F DAQ 0x01 0x0A 0x06 0x05 /end EVENT
   /begin EVENT "ev_vx1000_5ms_start" "ev_vx1000" 0x0C DAQ 0x01 0x05 0x06 0x04 /end EVENT
   /begin EVENT "ev_vx1000_5ms_end" "ev_vx1000" 0x0D DAQ 0x01 0x05 0x06 0x04 /end EVENT
   /begin EVENT "ev_vx1000_2ms_start" "ev_vx1000" 0x0A DAQ 0x01 0x02 0x06 0x03 /end EVENT
   /begin EVENT "ev_vx1000_2ms_end" "ev_vx1000" 0x0B DAQ 0x01 0x02 0x06 0x03 /end EVENT
   /begin EVENT "ev_vx1000_1ms_start" "ev_vx1000" 0x08 DAQ 0x01 0x01 0x06 0x02 /end EVENT
   /begin EVENT "ev_vx1000_1ms_end" "ev_vx1000" 0x09 DAQ 0x01 0x01 0x06 0x02 /end EVENT
   /begin EVENT "VX_DAQ_EV_10MS_TC1" "VX_DAQ_EV" 0x00 DAQ 0x01 0x0A 0x06 0x0A /end EVENT
   /begin EVENT "VX_DAQ_EV_1000MS_TC1" "VX_DAQ_EV" 0x01 DAQ 0x01 0x01 0x09 0x09 /end EVENT
   /begin EVENT "VX_DAQ_EV_SLOW_TC1" "VX_DAQ_EV" 0x02 DAQ 0x01 0x01 0x06 0x08 /end EVENT
   /begin EVENT "VX_DAQ_EV_2MS_TC1" "VX_DAQ_EV" 0x04 DAQ 0x01 0x02 0x06 0x08 /end EVENT
   /begin EVENT "VX_DAQ_EV_BLDC_TC1" "VX_DAQ_EV" 0x05 DAQ 0x01 0x32 0x04 0x07 /end EVENT
   /begin EVENT "VX_DAQ_EV_FAST_TC1" "VX_DAQ_EV" 0x07 DAQ 0x01 0x32 0x03 0x07 /end EVENT
   /begin EVENT "VX_DAQ_CORE2_EV_1MS_START" "VX_DAQ_CO" 0x12 DAQ 0x01 0x01 0x06 0x08 /end EVENT
   /begin EVENT "VX_DAQ_CORE2_EV_1MS_END" "VX_DAQ_CO" 0x13 DAQ 0x01 0x01 0x06 0x08 /end EVENT
   /begin EVENT "VX_DAQ_CORE2_EV_2MS_START" "VX_DAQ_CO" 0x14 DAQ 0x01 0x02 0x06 0x08 /end EVENT
   /begin EVENT "VX_DAQ_CORE2_EV_2MS_END" "VX_DAQ_CO" 0x15 DAQ 0x01 0x02 0x06 0x08 /end EVENT
   /begin EVENT "VX_DAQ_CORE2_EV_10MS_START" "VX_DAQ_CO" 0x16 DAQ 0x01 0x0A 0x06 0x08 /end EVENT
   /begin EVENT "VX_DAQ_CORE2_EV_10MS_END" "VX_DAQ_CO" 0x17 DAQ 0x01 0x0A 0x06 0x08 /end EVENT
  /end DAQ
 /end XCP_ON_TCP_IP
/end IF_DATA
/begin CHARACTERISTIC Aps_cBackupFunc2En "Aps module Calibration parameter Backup Function 2 Enable" VALUE 0x6003007C Aps.UBYTE_COL_DIRECT 0 NO_COMPU_METHOD 0 1 /end CHARACTERISTIC
/begin CHARACTERISTIC Aps_cCoilRstc "coil resistance" VALUE 0x60030368 Aps.FLOAT32_IEEE_COL_DIRECT 0 Aps.Asw_Rstc_Ohm 0 100 /end CHARACTERISTIC
/begin CHARACTERISTIC Aps_cCtrlModeTest "control mode test" VALUE 0x60030080 Aps.UBYTE_COL_DIRECT 0 Aps.Aps_CtrlMode 0 4 /end CHARACTERISTIC
/begin CHARACTERISTIC Aps_cDucyReqTest "duty cycle request test" VALUE 0x60030384 Aps.FLOAT32_IEEE_COL_DIRECT 0 Aps.Asw_Perc -100 100 /end CHARACTERISTIC
/begin CHARACTERISTIC Aps_cSupVoltSeln "supply voltage selection" VALUE 0x60030098 Aps.UBYTE_COL_DIRECT 0 Aps.Aps_SupVolt 0 2 /end CHARACTERISTIC
/begin CHARACTERISTIC Aps_cTestModeEn "test mpde enable" VALUE 0x6003009C Aps.UBYTE_COL_DIRECT 0 NO_COMPU_METHOD 0 1 /end CHARACTERISTIC
/begin CHARACTERISTIC Aps_cVoltReqTest "voltage request test" VALUE 0x600303B4 Aps.FLOAT32_IEEE_COL_DIRECT 0 Aps.Asw_Volt_V 0 60 /end CHARACTERISTIC
/begin MEASUREMENT HwTest_VADC_Result_G3_Ch5 "" SLONG HwTest.Adc_Result 0 0 -524288 524287.999756 ECU_ADDRESS 0x6001D1B8 /end MEASUREMENT
/begin CHARACTERISTIC HwTest_cActvDchrgDisOvrrd "" VALUE 0x6002C08C __UBYTE_Z 0 NO_COMPU_METHOD 0 1 BIT_MASK 0x1 /end CHARACTERISTIC
/begin CHARACTERISTIC HwTest_cActvDchrgDisOvrrdEn "" VALUE 0x6002C088 __UBYTE_Z 0 NO_COMPU_METHOD 0 1 BIT_MASK 0x1 /end CHARACTERISTIC
/begin CHARACTERISTIC HwTest_cActvDchrgTstOvrrd "" VALUE 0x6002C094 __UBYTE_Z 0 NO_COMPU_METHOD 0 1 BIT_MASK 0x1 /end CHARACTERISTIC
/begin CHARACTERISTIC HwTest_cActvDchrgTstOvrrdEn "" VALUE 0x6002C090 __UBYTE_Z 0 NO_COMPU_METHOD 0 1 BIT_MASK 0x1 /end CHARACTERISTIC
/begin CHARACTERISTIC HwTest_cDrvSupTopEnOvrrd "" VALUE 0x6002C064 __UBYTE_Z 0 NO_COMPU_METHOD 0 1 BIT_MASK 0x1 /end CHARACTERISTIC
/begin CHARACTERISTIC HwTest_cDrvSupTopEnOvrrdEn "" VALUE 0x6002C060 __UBYTE_Z 0 NO_COMPU_METHOD 0 1 BIT_MASK 0x1 /end CHARACTERISTIC
/begin CHARACTERISTIC HwTest_cPhaseOvcDiagHighOvrrd "" VALUE 0x6002C054 __UBYTE_Z 0 NO_COMPU_METHOD 0 1 BIT_MASK 0x1 /end CHARACTERISTIC
/begin CHARACTERISTIC HwTest_cPhaseOvcDiagHighOvrrdEn "" VALUE 0x6002C050 __UBYTE_Z 0 NO_COMPU_METHOD 0 1 BIT_MASK 0x1 /end CHARACTERISTIC
/begin CHARACTERISTIC HwTest_cPhaseOvcDiagLowOvrrd "" VALUE 0x6002C04C __UBYTE_Z 0 NO_COMPU_METHOD 0 1 BIT_MASK 0x1 /end CHARACTERISTIC
/begin CHARACTERISTIC HwTest_cPhaseOvcDiagLowOvrrdEn "" VALUE 0x6002C048 __UBYTE_Z 0 NO_COMPU_METHOD 0 1 BIT_MASK 0x1 /end CHARACTERISTIC
/begin CHARACTERISTIC HwTest_cPwrStgPar.Mode "" VALUE 0x6002CAFC __UBYTE_Z 0 HwtPwrStg.Mode 0 3 /end CHARACTERISTIC
/begin CHARACTERISTIC HwTest_cPwrStgPar.PhaseOvrrd._0_.Hs "" VALUE 0x6002CAFE __UBYTE_Z 0 NO_COMPU_METHOD 0 1 BIT_MASK 0x1 /end CHARACTERISTIC
/begin CHARACTERISTIC HwTest_cPwrStgPar.PhaseOvrrd._0_.Ls "" VALUE 0x6002CAFF __UBYTE_Z 0 NO_COMPU_METHOD 0 1 BIT_MASK 0x1 /end CHARACTERISTIC
/begin CHARACTERISTIC HwTest_cPwrStgPar.PhaseOvrrd._1_.Hs "" VALUE 0x6002CB00 __UBYTE_Z 0 NO_COMPU_METHOD 0 1 BIT_MASK 0x1 /end CHARACTERISTIC
/begin CHARACTERISTIC HwTest_cPwrStgPar.PhaseOvrrd._1_.Ls "" VALUE 0x6002CB01 __UBYTE_Z 0 NO_COMPU_METHOD 0 1 BIT_MASK 0x1 /end CHARACTERISTIC
/begin CHARACTERISTIC HwTest_cPwrStgPar.PhaseOvrrd._2_.Hs "" VALUE 0x6002CB02 __UBYTE_Z 0 NO_COMPU_METHOD 0 1 BIT_MASK 0x1 /end CHARACTERISTIC
/begin CHARACTERISTIC HwTest_cPwrStgPar.PhaseOvrrd._2_.Ls "" VALUE 0x6002CB03 __UBYTE_Z 0 NO_COMPU_METHOD 0 1 BIT_MASK 0x1 /end CHARACTERISTIC
/begin CHARACTERISTIC HwTest_cT30RppSwdEnOvrrd "" VALUE 0x6002C084 __UBYTE_Z 0 NO_COMPU_METHOD 0 1 BIT_MASK 0x1 /end CHARACTERISTIC
/begin CHARACTERISTIC HwTest_cT30RppSwdEnOvrrdEn "" VALUE 0x6002C080 __UBYTE_Z 0 NO_COMPU_METHOD 0 1 BIT_MASK 0x1 /end CHARACTERISTIC
/begin MEASUREMENT HwTest_rActvDchaCtrlMonDucy "" UWORD HwTest.Icu_DutyCycle 0 0 0 199.996948242 ECU_ADDRESS 0x6001CF98 /end MEASUREMENT
/begin MEASUREMENT HwTest_rHvIlkCurrAdcvolt "" SLONG HwTest.Adc_Result 0 0 -524288 524287.999756 ECU_ADDRESS 0x6001D140 /end MEASUREMENT
/begin MEASUREMENT HwTest_rHvIlkVoltAdcvolt "" SLONG HwTest.Adc_Result 0 0 -524288 524287.999756 ECU_ADDRESS 0x6001D13C /end MEASUREMENT
/begin MEASUREMENT HwTest_rPhaseFeedback_SH1_PinLvl "" UBYTE HwTest.Dio_Level 0 0 0 255 ECU_ADDRESS 0x6001C590 /end MEASUREMENT
/begin MEASUREMENT HwTest_rPhaseFeedback_SH2_PinLvl "" UBYTE HwTest.Dio_Level 0 0 0 255 ECU_ADDRESS 0x6001C594 /end MEASUREMENT
/begin MEASUREMENT HwTest_rPhaseFeedback_SH3_PinLvl "" UBYTE HwTest.Dio_Level 0 0 0 255 ECU_ADDRESS 0x6001C598 /end MEASUREMENT
/begin MEASUREMENT HwTest_rPhaseFeedback_SH4_PinLvl "" UBYTE HwTest.Dio_Level 0 0 0 255 ECU_ADDRESS 0x6001C59C /end MEASUREMENT
/begin MEASUREMENT HwTest_rPhaseFeedback_SH5_PinLvl "" UBYTE HwTest.Dio_Level 0 0 0 255 ECU_ADDRESS 0x6001C5A0 /end MEASUREMENT
/begin MEASUREMENT HwTest_rPhaseFeedback_SH6_PinLvl "" UBYTE HwTest.Dio_Level 0 0 0 255 ECU_ADDRESS 0x6001C5A4 /end MEASUREMENT
/begin MEASUREMENT HwTest_rRpsExcNegAdcVolt "" SLONG HwTest.Adc_Result 0 0 -524288 524287.999756 ECU_ADDRESS 0x6001D0C4 /end MEASUREMENT
/begin MEASUREMENT HwTest_rRpsExcPosAdcVolt "" SLONG HwTest.Adc_Result 0 0 -524288 524287.999756 ECU_ADDRESS 0x6001D0C0 /end MEASUREMENT
/begin MEASUREMENT HwTest_rRslvExcFreq "" ULONG HwTest.Icu_Frequency 0 0 0 1048575.99976 ECU_ADDRESS 0x6001D0D0 /end MEASUREMENT
/begin MEASUREMENT IoActr_ActrCurr "Actuator Current" FLOAT32_IEEE IoActr.Asw_Curr_A 1 100 -10000 10000 ECU_ADDRESS 0x60021710 /end MEASUREMENT
/begin CHARACTERISTIC IoActr_cPrimyCurrMeasPar.AdcVoltOffs "Primary current measurement ADC voltage offset" VALUE 0x6002F880 IoActr.FLOAT32_IEEE_COL_DIRECT 0 IoActr.Asw_Volt_V -10000 10000 /end CHARACTERISTIC
/begin CHARACTERISTIC IoActr_cPrimyCurrMeasPar.Gain "Primary current measurement gain" VALUE 0x6002F884 IoActr.FLOAT32_IEEE_COL_DIRECT 0 IoActr.IDENTICAL_SCALING_FLOAT -1000 1000 /end CHARACTERISTIC
/begin MEASUREMENT IoEcu_AsoAscState "" UBYTE IoEcu.Em_PwrStgHwCtrlMode 1 100 0 2 ECU_ADDRESS 0x6001CAD4 /end MEASUREMENT
/begin CHARACTERISTIC IoEcu_cHwDiag.EmPhaseCurrHighNegEnOvrrd "" VALUE 0x6002C296 IoEcu.UBYTE_COL_DIRECT 0 NO_COMPU_METHOD 0 1 /end CHARACTERISTIC
/begin CHARACTERISTIC IoEcu_cHwDiag.EmPhaseCurrHighPosEnOvrrd "" VALUE 0x6002C297 IoEcu.UBYTE_COL_DIRECT 0 NO_COMPU_METHOD 0 1 /end CHARACTERISTIC
/begin CHARACTERISTIC IoEcu_cHwDiag.OvrrdEn "" VALUE 0x6002C294 IoEcu.UBYTE_COL_DIRECT 0 NO_COMPU_METHOD 0 1 /end CHARACTERISTIC
/begin CHARACTERISTIC IoEcu_cSbcMux.CmdMuxValueOvrrd "Override enable for requested SBC mux. value" VALUE 0x6002C4E9 IoEcu.UBYTE_COL_DIRECT 0 NO_COMPU_METHOD 0 7 /end CHARACTERISTIC
/begin CHARACTERISTIC IoEcu_cSbcMux.CmdMuxValueOvrrdEn "Override enable for requested SBC mux. value" VALUE 0x6002C4E8 IoEcu.UBYTE_COL_DIRECT 0 NO_COMPU_METHOD 0 1 /end CHARACTERISTIC
/begin MEASUREMENT IoEcu_rAsoAsc.AsoAscPinLvl "" UBYTE IoEcu.Dio_Level 1 100 0 1 ECU_ADDRESS 0x6001CACC /end MEASUREMENT
/begin MEASUREMENT IoEcu_rCrash.CrashAdcVolt "T30c ADC input voltage" SLONG IoEcu.Adc_Result 1 100 -524288 524287.999756 ECU_ADDRESS 0x6001D4F4 /end MEASUREMENT
/begin MEASUREMENT IoEcu_rHvil.CurrAdcVolt "HV interlock current signal ADC input voltage" SLONG IoEcu.Adc_Result 1 100 -524288 524287.999756 ECU_ADDRESS 0x6001D70C /end MEASUREMENT
/begin MEASUREMENT IoEcu_rHvil.VoltAdcVolt "HV interlock diag. ADC input voltage" SLONG IoEcu.Adc_Result 1 100 -524288 524287.999756 ECU_ADDRESS 0x6001D708 /end MEASUREMENT
/begin MEASUREMENT IoEcu_rHwDiagPinLvl.InvPhase1CurrHigh "EM phase 1 overcurrent pin-level" UBYTE IoEcu.Dio_Level 1 100 0 1 ECU_ADDRESS 0x6001D606 /end MEASUREMENT
/begin MEASUREMENT IoEcu_rHwDiagPinLvl.InvPhase2CurrHigh "EM phase 2 overcurrent pin-level" UBYTE IoEcu.Dio_Level 1 100 0 1 ECU_ADDRESS 0x6001D607 /end MEASUREMENT
/begin MEASUREMENT IoEcu_rHwDiagPinLvl.InvPhase3CurrHigh "EM phase 3 overcurrent pin-level" UBYTE IoEcu.Dio_Level 1 100 0 1 ECU_ADDRESS 0x6001D608 /end MEASUREMENT
/begin MEASUREMENT IoEcu_rHwDiagPinLvl.PhaseCurrHigh "EM phase overcurrent pin-level" UBYTE IoEcu.Dio_Level 1 100 0 1 ECU_ADDRESS 0x6001D60C /end MEASUREMENT
/begin CHARACTERISTIC IoEm_cInvPhaseDucySpOvrrd "inverter phase duty cycle setpoint override" VAL_BLK 0x6002C394 IoEm.FLOAT32_IEEE_COL_DIRECT 0 IoEm.Asw_Perc -1000 1000 MATRIX_DIM 3 /end CHARACTERISTIC
/begin CHARACTERISTIC IoEm_cInvPhaseDucySpOvrrdEn "inverter phase duty cycle setpoint overrider enable" VALUE 0x6002C18C IoEm.UBYTE_COL_DIRECT 0 NO_COMPU_METHOD 0 1 /end CHARACTERISTIC
/begin CHARACTERISTIC IoEm_cInvPhaseDucySpOvrrdEnFrc "inverter phase duty cycle setpoint overrider force enable" VALUE 0x6002C190 IoEm.UBYTE_COL_DIRECT 0 NO_COMPU_METHOD 0 1 /end CHARACTERISTIC
/begin MEASUREMENT IoEm_rHwSafeStateStsPinLvl "hardware safestate status pin level read from CDD" UBYTE IoEm.Dio_Level 1 100 0 1 ECU_ADDRESS 0x6001CB7C /end MEASUREMENT
/begin CHARACTERISTIC IoMotTemp_cSmPar.State5HoldTime "State 5 Hold Time " VALUE 0x6002CBD8 IoMotTemp.FLOAT32_IEEE_COL_DIRECT 0 IoMotTemp.Asw_Time_s 1E-06 10000 /end CHARACTERISTIC
/begin CHARACTERISTIC IoMotTemp_cSmPar.State6HoldTime "State 6 Hold Time " VALUE 0x6002CBE4 IoMotTemp.FLOAT32_IEEE_COL_DIRECT 0 IoMotTemp.Asw_Time_s 1E-06 10000 /end CHARACTERISTIC
/begin CHARACTERISTIC IoMotTemp_cWndgTemp1Ovrrd.RngOvrrdMode "IoMotTemp module Calibration parameter Winding Temperature 1 Range Override Mode " VALUE 0x6002C454 IoMotTemp.UBYTE_COL_DIRECT 0 IoMotTemp.LibTlHwIo_RngOvrrdMode 0 2 /end CHARACTERISTIC
/begin CHARACTERISTIC IoMotTemp_cWndgTemp2Ovrrd.RngOvrrdMode "IoMotTemp module Calibration parameter Winding Temperature 2 Range Override Mode " VALUE 0x6002C464 IoMotTemp.UBYTE_COL_DIRECT 0 IoMotTemp.LibTlHwIo_RngOvrrdMode 0 2 /end CHARACTERISTIC
/begin MEASUREMENT IoMotTemp_rWndgTemp1AdcVolt "IoMotTemp module Read Winding Temperature 1 Analog-digital conversion Voltage " SLONG IoMotTemp.Adc_Result 1 100 -524288 524287.999756 ECU_ADDRESS 0x6001D488 /end MEASUREMENT
/begin MEASUREMENT IoMotTemp_rWndgTemp1DiagAdcVolt "IoMotTemp module Read Winding Temperature 1 Diagnostics Analog-digital conversion Voltage " SLONG IoMotTemp.Adc_Result 1 100 -524288 524287.999756 ECU_ADDRESS 0x6001D48C /end MEASUREMENT
/begin MEASUREMENT IoMotTemp_rWndgTemp2AdcVolt "IoMotTemp module Read Winding Temperature 2 Analog-digital conversion Voltage " SLONG IoMotTemp.Adc_Result 1 100 -524288 524287.999756 ECU_ADDRESS 0x6001D490 /end MEASUREMENT
/begin MEASUREMENT IoMotTemp_rWndgTemp2DiagAdcVolt "IoMotTemp module Read Winding Temperature 2 Diagnostics Analog-digital conversion Voltage " SLONG IoMotTemp.Adc_Result 1 100 -524288 524287.999756 ECU_ADDRESS 0x6001D494 /end MEASUREMENT
/begin MEASUREMENT IoMotTemp_wWndgTemp1DiagEnPinLvl "IoMotTemp module Write Winding Temperature 1 Diagnostics Enable Pin Level " UBYTE IoMotTemp.Dio_Level 1 100 0 1 ECU_ADDRESS 0x6001A88C /end MEASUREMENT
/begin MEASUREMENT IoMotTemp_wWndgTemp1Rng2EnPinLvl "IoMotTemp module Write Winding Temperature 1 Range 2 Enable Pin Level " UBYTE IoMotTemp.Dio_Level 1 100 0 1 ECU_ADDRESS 0x6001A890 /end MEASUREMENT
/begin MEASUREMENT IoMotTemp_wWndgTemp2DiagEnPinLvl "IoMotTemp module Write Winding Temperature 2 Diagnostics Enable Pin Level " UBYTE IoMotTemp.Dio_Level 1 100 0 1 ECU_ADDRESS 0x6001A894 /end MEASUREMENT
/begin MEASUREMENT IoMotTemp_wWndgTemp2Rng2EnPinLvl "IoMotTemp module Write Winding Temperature 2 Range 2 Enable Pin Level " UBYTE IoMotTemp.Dio_Level 1 100 0 1 ECU_ADDRESS 0x6001A898 /end MEASUREMENT
/begin MEASUREMENT IoWhlSpd_rLeftWhlSpdSensFrq "Left wheel speed sensor frequency" ULONG IoWhlSpd.WhlSpd_Frequency 1 100 0 100000 ECU_ADDRESS 0x60021770 /end MEASUREMENT
/begin MEASUREMENT V_EDM_BF_Active1 "bitfield of active backup functions 1" UWORD NO_COMPU_METHOD 0 0 0 65535 BIT_MASK 0xFFFF ECU_ADDRESS 0x70027D52 FORMAT "%.15" /end MEASUREMENT
/begin MEASUREMENT V_MCU_Data.0.AliveCounter "" UBYTE NO_COMPU_METHOD 0 0 0 255 BIT_MASK 0xFF ECU_ADDRESS 0x70011747 FORMAT "%.15" SYMBOL_LINK "V_MCU_Data" 23 /end MEASUREMENT
/begin MEASUREMENT V_MCU_Data.0.Bus "" UBYTE NO_COMPU_METHOD 0 0 0 255 BIT_MASK 0xFF ECU_ADDRESS 0x70011745 FORMAT "%.15" SYMBOL_LINK "V_MCU_Data" 21 /end MEASUREMENT
/begin MEASUREMENT V_MCU_Data.0.CPU0 "" UBYTE NO_COMPU_METHOD 0 0 0 255 BIT_MASK 0xFF ECU_ADDRESS 0x70011740 FORMAT "%.15" SYMBOL_LINK "V_MCU_Data" 16 /end MEASUREMENT
/begin MEASUREMENT V_MCU_Data.0.CPU1 "" UBYTE NO_COMPU_METHOD 0 0 0 255 BIT_MASK 0xFF ECU_ADDRESS 0x70011741 FORMAT "%.15" SYMBOL_LINK "V_MCU_Data" 17 /end MEASUREMENT
/begin MEASUREMENT V_MCU_Data.0.CRC8 "" UBYTE NO_COMPU_METHOD 0 0 0 255 BIT_MASK 0xFF ECU_ADDRESS 0x7001174D FORMAT "%.15" SYMBOL_LINK "V_MCU_Data" 29 /end MEASUREMENT
/begin MEASUREMENT V_MCU_Data.0.Clock "" UBYTE NO_COMPU_METHOD 0 0 0 255 BIT_MASK 0xFF ECU_ADDRESS 0x70011743 FORMAT "%.15" SYMBOL_LINK "V_MCU_Data" 19 /end MEASUREMENT
/begin MEASUREMENT V_MCU_Data.0.Lockstep "" UBYTE NO_COMPU_METHOD 0 0 0 255 BIT_MASK 0xFF ECU_ADDRESS 0x70011744 FORMAT "%.15" SYMBOL_LINK "V_MCU_Data" 20 /end MEASUREMENT
/begin MEASUREMENT V_MCU_Data.0.MISC "" UWORD NO_COMPU_METHOD 0 0 0 65535 BIT_MASK 0xFFFF ECU_ADDRESS 0x7001173C FORMAT "%.15" SYMBOL_LINK "V_MCU_Data" 12 /end MEASUREMENT
/begin MEASUREMENT V_MCU_Data.0.PERIF "" UBYTE NO_COMPU_METHOD 0 0 0 255 BIT_MASK 0xFF ECU_ADDRESS 0x70011742 FORMAT "%.15" SYMBOL_LINK "V_MCU_Data" 18 /end MEASUREMENT
/begin MEASUREMENT V_MCU_Data.0.PFLASH "" UWORD NO_COMPU_METHOD 0 0 0 65535 BIT_MASK 0xFFFF ECU_ADDRESS 0x7001173E FORMAT "%.15" SYMBOL_LINK "V_MCU_Data" 14 /end MEASUREMENT
/begin MEASUREMENT V_MCU_Data.0.ResetType "" SLONG NO_COMPU_METHOD 0 0 -2147483648 2147483647 BIT_MASK 0xFFFFFFFF ECU_ADDRESS 0x70011730 FORMAT "%.15" SYMBOL_LINK "V_MCU_Data" 0 /end MEASUREMENT
/begin MEASUREMENT V_MCU_Data.0.SFF "" UWORD NO_COMPU_METHOD 0 0 0 65535 BIT_MASK 0xFFFF ECU_ADDRESS 0x7001173A FORMAT "%.15" SYMBOL_LINK "V_MCU_Data" 10 /end MEASUREMENT
/begin MEASUREMENT V_MCU_Data.0.SRI "" UWORD NO_COMPU_METHOD 0 0 0 65535 BIT_MASK 0xFFFF ECU_ADDRESS 0x70011738 FORMAT "%.15" SYMBOL_LINK "V_MCU_Data" 8 /end MEASUREMENT
/begin MEASUREMENT V_MCU_Data.0.SVM "" UWORD NO_COMPU_METHOD 0 0 0 65535 BIT_MASK 0xFFFF ECU_ADDRESS 0x70011736 FORMAT "%.15" SYMBOL_LINK "V_MCU_Data" 6 /end MEASUREMENT
/begin MEASUREMENT V_MCU_Data.0.StartUpResults "" UWORD NO_COMPU_METHOD 0 0 0 65535 BIT_MASK 0xFFFF ECU_ADDRESS 0x70011734 FORMAT "%.15" SYMBOL_LINK "V_MCU_Data" 4 /end MEASUREMENT
/begin MEASUREMENT V_MCU_Data.0.State "" SLONG NO_COMPU_METHOD 0 0 -2147483648 2147483647 BIT_MASK 0xFFFFFFFF ECU_ADDRESS 0x70011748 FORMAT "%.15" SYMBOL_LINK "V_MCU_Data" 24 /end MEASUREMENT
/begin MEASUREMENT V_MCU_Data.0.State_Inv "" UBYTE NO_COMPU_METHOD 0 0 0 255 BIT_MASK 0xFF ECU_ADDRESS 0x7001174C FORMAT "%.15" SYMBOL_LINK "V_MCU_Data" 28 /end MEASUREMENT
/begin MEASUREMENT V_MCU_Data.0.TempMon "" UBYTE NO_COMPU_METHOD 0 0 0 255 BIT_MASK 0xFF ECU_ADDRESS 0x70011746 FORMAT "%.15" SYMBOL_LINK "V_MCU_Data" 22 /end MEASUREMENT
/begin MEASUREMENT V_MCU_Data.0.res4 "" UBYTE NO_COMPU_METHOD 0 0 0 255 BIT_MASK 0xFF ECU_ADDRESS 0x7001174E FORMAT "%.15" SYMBOL_LINK "V_MCU_Data" 30 /end MEASUREMENT
/begin MEASUREMENT V_MCU_Data.0.res5 "" UBYTE NO_COMPU_METHOD 0 0 0 255 BIT_MASK 0xFF ECU_ADDRESS 0x7001174F FORMAT "%.15" SYMBOL_LINK "V_MCU_Data" 31 /end MEASUREMENT
/begin MEASUREMENT V_MCU_Data.AliveCounter "AliveCounter" UBYTE NO_COMPU_METHOD 0 0 0 255 BIT_MASK 0xFF ECU_ADDRESS 0x70011747 FORMAT "%.15" /end MEASUREMENT
/begin MEASUREMENT V_MCU_Data.Bus.0.CPU0_MPU "" ULONG NO_COMPU_METHOD 0 0 0 4294967295 BIT_MASK 0x1 ECU_ADDRESS 0x70011745 FORMAT "%.15" SYMBOL_LINK "V_MCU_Data.Bus" 0 /end MEASUREMENT
/begin MEASUREMENT V_MCU_Data.Bus.0.CPU1_MPU "" ULONG NO_COMPU_METHOD 0 0 0 4294967295 BIT_MASK 0x2 ECU_ADDRESS 0x70011745 FORMAT "%.15" SYMBOL_LINK "V_MCU_Data.Bus" 0 /end MEASUREMENT
/begin MEASUREMENT V_MCU_Data.Bus.0.CPU2_MPU "" ULONG NO_COMPU_METHOD 0 0 0 4294967295 BIT_MASK 0x40 ECU_ADDRESS 0x70011745 FORMAT "%.15" SYMBOL_LINK "V_MCU_Data.Bus" 0 /end MEASUREMENT
/begin MEASUREMENT V_MCU_Data.Bus.0.IR_HSM_AEE "" ULONG NO_COMPU_METHOD 0 0 0 4294967295 BIT_MASK 0x10 ECU_ADDRESS 0x70011745 FORMAT "%.15" SYMBOL_LINK "V_MCU_Data.Bus" 0 /end MEASUREMENT
/begin MEASUREMENT V_MCU_Data.Bus.0.LMU_MPU "" ULONG NO_COMPU_METHOD 0 0 0 4294967295 BIT_MASK 0x80 ECU_ADDRESS 0x70011745 FORMAT "%.15" SYMBOL_LINK "V_MCU_Data.Bus" 0 /end MEASUREMENT
/begin MEASUREMENT V_MCU_Data.Bus.0.PMS_APV "" ULONG NO_COMPU_METHOD 0 0 0 4294967295 BIT_MASK 0x20 ECU_ADDRESS 0x70011745 FORMAT "%.15" SYMBOL_LINK "V_MCU_Data.Bus" 0 /end MEASUREMENT
/begin MEASUREMENT V_MCU_Data.Bus.0.SPB_BEE "" ULONG NO_COMPU_METHOD 0 0 0 4294967295 BIT_MASK 0x8 ECU_ADDRESS 0x70011745 FORMAT "%.15" SYMBOL_LINK "V_MCU_Data.Bus" 0 /end MEASUREMENT
/begin MEASUREMENT V_MCU_Data.Bus.0.reserved1 "" ULONG NO_COMPU_METHOD 0 0 0 4294967295 BIT_MASK 0x4 ECU_ADDRESS 0x70011745 FORMAT "%.15" SYMBOL_LINK "V_MCU_Data.Bus" 0 /end MEASUREMENT
/begin MEASUREMENT V_MCU_Data.CPU0.0.DCACHE_ME "" ULONG NO_COMPU_METHOD 0 0 0 4294967295 BIT_MASK 0x80 ECU_ADDRESS 0x70011740 FORMAT "%.15" SYMBOL_LINK "V_MCU_Data.CPU0" 0 /end MEASUREMENT
/begin MEASUREMENT V_MCU_Data.CPU0.0.DCACHE_UCE "" ULONG NO_COMPU_METHOD 0 0 0 4294967295 BIT_MASK 0x40 ECU_ADDRESS 0x70011740 FORMAT "%.15" SYMBOL_LINK "V_MCU_Data.CPU0" 0 /end MEASUREMENT
/begin MEASUREMENT V_MCU_Data.CPU0.0.DSPR_DCACHE_DLMU_ME "" ULONG NO_COMPU_METHOD 0 0 0 4294967295 BIT_MASK 0x20 ECU_ADDRESS 0x70011740 FORMAT "%.15" SYMBOL_LINK "V_MCU_Data.CPU0" 0 /end MEASUREMENT
/begin MEASUREMENT V_MCU_Data.CPU0.0.DSPR_DCACHE_DLMU_UCE "" ULONG NO_COMPU_METHOD 0 0 0 4294967295 BIT_MASK 0x10 ECU_ADDRESS 0x70011740 FORMAT "%.15" SYMBOL_LINK "V_MCU_Data.CPU0" 0 /end MEASUREMENT
/begin MEASUREMENT V_MCU_Data.CPU0.0.PCACHE_ME "" ULONG NO_COMPU_METHOD 0 0 0 4294967295 BIT_MASK 0x2 ECU_ADDRESS 0x70011740 FORMAT "%.15" SYMBOL_LINK "V_MCU_Data.CPU0" 0 /end MEASUREMENT
/begin MEASUREMENT V_MCU_Data.CPU0.0.PCACHE_UCE "" ULONG NO_COMPU_METHOD 0 0 0 4294967295 BIT_MASK 0x1 ECU_ADDRESS 0x70011740 FORMAT "%.15" SYMBOL_LINK "V_MCU_Data.CPU0" 0 /end MEASUREMENT
/begin MEASUREMENT V_MCU_Data.CPU0.0.PSPR_PCACHE_ME "" ULONG NO_COMPU_METHOD 0 0 0 4294967295 BIT_MASK 0x8 ECU_ADDRESS 0x70011740 FORMAT "%.15" SYMBOL_LINK "V_MCU_Data.CPU0" 0 /end MEASUREMENT
/begin MEASUREMENT V_MCU_Data.CPU0.0.PSPR_PCACHE_UCE "" ULONG NO_COMPU_METHOD 0 0 0 4294967295 BIT_MASK 0x4 ECU_ADDRESS 0x70011740 FORMAT "%.15" SYMBOL_LINK "V_MCU_Data.CPU0" 0 /end MEASUREMENT
/begin MEASUREMENT V_MCU_Data.CPU1.0.DCACHE_ME "" ULONG NO_COMPU_METHOD 0 0 0 4294967295 BIT_MASK 0x80 ECU_ADDRESS 0x70011741 FORMAT "%.15" SYMBOL_LINK "V_MCU_Data.CPU1" 0 /end MEASUREMENT
/begin MEASUREMENT V_MCU_Data.CPU1.0.DCACHE_UCE "" ULONG NO_COMPU_METHOD 0 0 0 4294967295 BIT_MASK 0x40 ECU_ADDRESS 0x70011741 FORMAT "%.15" SYMBOL_LINK "V_MCU_Data.CPU1" 0 /end MEASUREMENT
/begin MEASUREMENT V_MCU_Data.CPU1.0.DSPR_DCACHE_DLMU_ME "" ULONG NO_COMPU_METHOD 0 0 0 4294967295 BIT_MASK 0x20 ECU_ADDRESS 0x70011741 FORMAT "%.15" SYMBOL_LINK "V_MCU_Data.CPU1" 0 /end MEASUREMENT
/begin MEASUREMENT V_MCU_Data.CPU1.0.DSPR_DCACHE_DLMU_UCE "" ULONG NO_COMPU_METHOD 0 0 0 4294967295 BIT_MASK 0x10 ECU_ADDRESS 0x70011741 FORMAT "%.15" SYMBOL_LINK "V_MCU_Data.CPU1" 0 /end MEASUREMENT
/begin MEASUREMENT V_MCU_Data.CPU1.0.PCACHE_ME "" ULONG NO_COMPU_METHOD 0 0 0 4294967295 BIT_MASK 0x2 ECU_ADDRESS 0x70011741 FORMAT "%.15" SYMBOL_LINK "V_MCU_Data.CPU1" 0 /end MEASUREMENT
/begin MEASUREMENT V_MCU_Data.CPU1.0.PCACHE_UCE "" ULONG NO_COMPU_METHOD 0 0 0 4294967295 BIT_MASK 0x1 ECU_ADDRESS 0x70011741 FORMAT "%.15" SYMBOL_LINK "V_MCU_Data.CPU1" 0 /end MEASUREMENT
/begin COMPU_METHOD ADIAG_Debounce_10ms "" RAT_FUNC "%3.3" "ms" COEFFS 0 0.2 0 0 0 1 /end COMPU_METHOD
/begin COMPU_METHOD ADIAG_Linebreak_DebounceCnt "" RAT_FUNC "%3.3" "counter" COEFFS 0 0.5 0 0 0 1 /end COMPU_METHOD
/begin COMPU_METHOD ADIAG_Linebreak_RecoveryCnt "" RAT_FUNC "%3.3" "counter" COEFFS 0 1 0 0 0 1 /end COMPU_METHOD
/begin COMPU_METHOD ADIAG_Recovery_10ms "" RAT_FUNC "%3.3" "ms" COEFFS 0 0.1 0 0 0 1 /end COMPU_METHOD
/begin COMPU_METHOD ART_COM_Age_5ms "time in seconds" RAT_FUNC "%3.4" "s" COEFFS 0 200 0 0 0 1 /end COMPU_METHOD
/begin COMPU_METHOD ART_COM_Age_ms "time in seconds" RAT_FUNC "%3.4" "s" COEFFS 0 1000 0 0 0 1 /end COMPU_METHOD
/begin COMPU_METHOD Aps.Aps_CtrlMode "" TAB_VERB "%3.0" "" COMPU_TAB_REF Aps.CONV_TAB_Aps_CtrlMode /end COMPU_METHOD
/begin COMPU_METHOD Aps.Aps_ReqSrc "" TAB_VERB "%3.0" "" COMPU_TAB_REF Aps.CONV_TAB_Aps_ReqSrc /end COMPU_METHOD
/begin COMPU_METHOD Aps.Aps_SupVolt "" TAB_VERB "%3.0" "" COMPU_TAB_REF Aps.CONV_TAB_Aps_SupVolt /end COMPU_METHOD
/begin COMPU_METHOD Aps.Asw_AvailyState "" TAB_VERB "%d" "" COMPU_TAB_REF Aps.CONV_TAB_Asw_AvailyState /end COMPU_METHOD
/begin COMPU_METHOD Aps.Asw_Curr_A "" IDENTICAL "%12.6" "A" /end COMPU_METHOD
/begin COMPU_METHOD Aps.Asw_Frq_Hz "" IDENTICAL "%12.6" "Hz" /end COMPU_METHOD
/begin COMPU_METHOD Aps.Asw_Perc "" IDENTICAL "%12.6" "%" /end COMPU_METHOD
/begin COMPU_METHOD Aps.Asw_Rstc_Ohm "" IDENTICAL "%12.6" "Ohm" /end COMPU_METHOD
/begin COMPU_METHOD Aps.Asw_SigQly "" TAB_VERB "%s" "" COMPU_TAB_REF Aps.CONV_TAB_Asw_SigQly /end COMPU_METHOD
/begin COMPU_METHOD Aps.Asw_Time_s "" IDENTICAL "%12.6" "s" /end COMPU_METHOD
/begin COMPU_METHOD Aps.Asw_Volt_V "" IDENTICAL "%12.6" "V" /end COMPU_METHOD
/begin COMPU_METHOD Aps.Edp_cmdActOutpStg "" TAB_VERB "%s" "" COMPU_TAB_REF Aps.CONV_TAB_Edp_cmdActOutpStg /end COMPU_METHOD
/begin COMPU_METHOD Aps.Edp_cmdBckFcn2 "" TAB_VERB "%s" "" COMPU_TAB_REF Aps.CONV_TAB_Edp_cmdBckFcn2 /end COMPU_METHOD
/begin COMPU_METHOD Aps.Edp_cmdBckFcn3 "" TAB_VERB "%s" "" COMPU_TAB_REF Aps.CONV_TAB_Edp_cmdBckFcn3 /end COMPU_METHOD
/begin COMPU_METHOD Aps.IDENTICAL_SCALING_FLOAT "" IDENTICAL "%12.6" "" /end COMPU_METHOD
/begin COMPU_METHOD Aps.LibTlSrvc_CmpntState "" TAB_VERB "%3.0" "" COMPU_TAB_REF Aps.CONV_TAB_LibTlSrvc_CmpntState /end COMPU_METHOD
/begin COMPU_METHOD Aps.LibTlSrvc_CmpntStateReq "" TAB_VERB "%3.0" "" COMPU_TAB_REF Aps.CONV_TAB_LibTlSrvc_CmpntStateReq /end COMPU_METHOD
/begin COMPU_METHOD Boolean "TRUE/FALSE" TAB_VERB "%3.0" "" COMPU_TAB_REF Boolean /end COMPU_METHOD
/begin COMPU_METHOD COMPU_Asw_Acc_mps2 "" RAT_FUNC "%9.15" "m/s^2" COEFFS 0 1 0 0 0 1 /end COMPU_METHOD
/begin COMPU_METHOD COMPU_Asw_Ang_deg "" RAT_FUNC "%9.15" "degree" COEFFS 0 1 0 0 0 1 /end COMPU_METHOD
/begin COMPU_METHOD COMPU_Asw_AngrAcc_radps2 "" RAT_FUNC "%9.15" "rad/s^2" COEFFS 0 1 0 0 0 1 /end COMPU_METHOD
/begin COMPU_METHOD COMPU_Asw_AngrVel_radps "" RAT_FUNC "%9.15" "rad/s" COEFFS 0 1 0 0 0 1 /end COMPU_METHOD
/begin COMPU_METHOD COMPU_Asw_AvailyState "" TAB_VERB "%.1" "[]" COMPU_TAB_REF COMPU_Asw_AvailyState /end COMPU_METHOD
/begin COMPU_METHOD COMPU_Asw_Cap_mF "" RAT_FUNC "%9.15" "mF" COEFFS 0 1 0 0 0 1 /end COMPU_METHOD
/begin COMPU_METHOD COMPU_Asw_Chrg_C "" RAT_FUNC "%9.15" "C" COEFFS 0 1 0 0 0 1 /end COMPU_METHOD
/begin COMPU_METHOD COMPU_Asw_CurrRate_Aps "" RAT_FUNC "%9.15" "A/s" COEFFS 0 1 0 0 0 1 /end COMPU_METHOD
/begin COMPU_METHOD COMPU_Asw_Curr_A "" RAT_FUNC "%9.15" "A" COEFFS 0 1 0 0 0 1 /end COMPU_METHOD
/begin COMPU_METHOD COMPU_Asw_Curr_Apeak "" RAT_FUNC "%9.15" "Apeak" COEFFS 0 1 0 0 0 1 /end COMPU_METHOD
/begin COMPU_METHOD COMPU_Asw_Curr_Arms "" RAT_FUNC "%9.15" "Arms" COEFFS 0 1 0 0 0 1 /end COMPU_METHOD
/begin COMPU_METHOD COMPU_Asw_EnrgDens_Wpm2 "" RAT_FUNC "%9.15" "W/m^2" COEFFS 0 1 0 0 0 1 /end COMPU_METHOD
/begin COMPU_METHOD COMPU_Asw_EnrgPerDist_Whpkm "" RAT_FUNC "%9.15" "Wh/km" COEFFS 0 1 0 0 0 1 /end COMPU_METHOD
/begin COMPU_METHOD COMPU_Asw_Enrg_J "" RAT_FUNC "%9.15" "J" COEFFS 0 1 0 0 0 1 /end COMPU_METHOD
/begin COMPU_METHOD COMPU_Asw_Flux_Wb "" RAT_FUNC "%9.15" "Wb" COEFFS 0 1 0 0 0 1 /end COMPU_METHOD
/begin COMPU_METHOD COMPU_Asw_Frq_Hz "" RAT_FUNC "%9.15" "Hz" COEFFS 0 1 0 0 0 1 /end COMPU_METHOD
/begin COMPU_METHOD COMPU_Asw_Frq_kHz "" RAT_FUNC "%9.15" "kHz" COEFFS 0 1 0 0 0 1 /end COMPU_METHOD
/begin COMPU_METHOD COMPU_Asw_Htcpf_JpKps "" RAT_FUNC "%9.15" "J/K/s" COEFFS 0 1 0 0 0 1 /end COMPU_METHOD
/begin COMPU_METHOD COMPU_Asw_Ind_H "" RAT_FUNC "%9.15" "H" COEFFS 0 1 0 0 0 1 /end COMPU_METHOD
/begin COMPU_METHOD COMPU_Asw_Len_km "" RAT_FUNC "%9.15" "km" COEFFS 0 1 0 0 0 1 /end COMPU_METHOD
/begin COMPU_METHOD COMPU_Asw_Len_m "" RAT_FUNC "%9.15" "m" COEFFS 0 1 0 0 0 1 /end COMPU_METHOD
/begin COMPU_METHOD COMPU_Asw_Len_mm "" RAT_FUNC "%9.15" "mm" COEFFS 0 1 0 0 0 1 /end COMPU_METHOD
/begin COMPU_METHOD COMPU_Asw_Mass_kg "" RAT_FUNC "%9.15" "kg" COEFFS 0 1 0 0 0 1 /end COMPU_METHOD
/begin COMPU_METHOD COMPU_Asw_Mem_byte "" RAT_FUNC "%9.15" "byte" COEFFS 0 1 0 0 0 1 /end COMPU_METHOD
/begin COMPU_METHOD COMPU_Asw_Perc "" RAT_FUNC "%9.15" "[]" COEFFS 0 1 0 0 0 1 /end COMPU_METHOD
/begin COMPU_METHOD COMPU_Asw_Press_bar "" RAT_FUNC "%9.15" "bar" COEFFS 0 1 0 0 0 1 /end COMPU_METHOD
/begin COMPU_METHOD COMPU_Asw_Press_mbar "" RAT_FUNC "%9.15" "mbar" COEFFS 0 1 0 0 0 1 /end COMPU_METHOD
/begin COMPU_METHOD COMPU_Asw_Pwr_W "" RAT_FUNC "%9.15" "W" COEFFS 0 1 0 0 0 1 /end COMPU_METHOD
/begin COMPU_METHOD COMPU_Asw_Pwr_kW "" RAT_FUNC "%9.15" "kW" COEFFS 0 1 0 0 0 1 /end COMPU_METHOD
/begin COMPU_METHOD COMPU_Asw_Rate_ps "" RAT_FUNC "%9.15" "1/s" COEFFS 0 1 0 0 0 1 /end COMPU_METHOD
/begin COMPU_METHOD COMPU_Asw_RstcPerVolt_OhmpV "" RAT_FUNC "%9.15" "Ohm/V" COEFFS 0 1 0 0 0 1 /end COMPU_METHOD
/begin COMPU_METHOD COMPU_Asw_Rstc_Ohm "" RAT_FUNC "%9.15" "Ohm" COEFFS 0 1 0 0 0 1 /end COMPU_METHOD
/begin COMPU_METHOD COMPU_Asw_Rstc_kOhm "" RAT_FUNC "%9.15" "kOhm" COEFFS 0 1 0 0 0 1 /end COMPU_METHOD
/begin COMPU_METHOD COMPU_Asw_RunState "" TAB_VERB "%.1" "[]" COMPU_TAB_REF COMPU_Asw_RunState /end COMPU_METHOD
/begin COMPU_METHOD COMPU_Asw_SigQly "" TAB_VERB "%.1" "[]" COMPU_TAB_REF COMPU_Asw_SigQly /end COMPU_METHOD
/begin COMPU_METHOD COMPU_Asw_SpdRate_rpmps "" RAT_FUNC "%9.15" "rpm/s" COEFFS 0 1 0 0 0 1 /end COMPU_METHOD
/begin COMPU_METHOD COMPU_Asw_Spd_rpm "" RAT_FUNC "%9.15" "rpm" COEFFS 0 1 0 0 0 1 /end COMPU_METHOD
/begin COMPU_METHOD COMPU_Asw_Temp_degC "" RAT_FUNC "%9.15" "degC" COEFFS 0 1 0 0 0 1 /end COMPU_METHOD
/begin COMPU_METHOD COMPU_Asw_Time_s "" RAT_FUNC "%9.15" "s" COEFFS 0 1 0 0 0 1 /end COMPU_METHOD
/begin COMPU_METHOD COMPU_Asw_Time_us "" RAT_FUNC "%9.15" "us" COEFFS 0 1 0 0 0 1 /end COMPU_METHOD
/begin COMPU_METHOD COMPU_Asw_TrqRate_Nmps "" RAT_FUNC "%9.15" "Nm/s" COEFFS 0 1 0 0 0 1 /end COMPU_METHOD
/begin COMPU_METHOD COMPU_Asw_Trq_Nm "" RAT_FUNC "%9.15" "Nm" COEFFS 0 1 0 0 0 1 /end COMPU_METHOD
/begin COMPU_METHOD COMPU_Asw_Vel_kmh "" RAT_FUNC "%9.15" "km/h" COEFFS 0 1 0 0 0 1 /end COMPU_METHOD
/begin COMPU_METHOD COMPU_Asw_Vof_lpmin "" RAT_FUNC "%9.15" "lpm" COEFFS 0 1 0 0 0 1 /end COMPU_METHOD
/begin COMPU_METHOD COMPU_Asw_Volt_V "" RAT_FUNC "%9.15" "V" COEFFS 0 1 0 0 0 1 /end COMPU_METHOD
/begin COMPU_METHOD COMPU_Asw_Volt_Vpeak "" RAT_FUNC "%9.15" "Vpeak" COEFFS 0 1 0 0 0 1 /end COMPU_METHOD
/begin COMPU_METHOD COMPU_Asw_Volt_Vrms "" RAT_FUNC "%9.15" "Vrms" COEFFS 0 1 0 0 0 1 /end COMPU_METHOD
/begin COMPU_METHOD COMPU_COMPU_dt_plk_pos_req "" TAB_VERB "%.1" "[]" COMPU_TAB_REF COMPU_COMPU_dt_plk_pos_req /end COMPU_METHOD
/begin COMPU_METHOD COMPU_Edp_EmPwrStgIoCtrlMode "" TAB_VERB "%.1" "[]" COMPU_TAB_REF COMPU_Edp_EmPwrStgIoCtrlMode /end COMPU_METHOD
/begin COMPU_METHOD COMPU_Edp_EmRpsCalnFltRsn "" TAB_VERB "%.1" "[]" COMPU_TAB_REF COMPU_Edp_EmRpsCalnFltRsn /end COMPU_METHOD
/begin COMPU_METHOD COMPU_Edp_LvVoltFxp "" RAT_FUNC "%9.15" "V" COEFFS 0 1 0 0 0 1 /end COMPU_METHOD
/begin COMPU_METHOD COMPU_Edp_MptSignalState "" TAB_VERB "%.1" "[]" COMPU_TAB_REF COMPU_Edp_MptSignalState /end COMPU_METHOD
/begin COMPU_METHOD COMPU_Edp_NvmTempFxp "" RAT_FUNC "%9.15" "degC" COEFFS 0 1 0 0 0 1 /end COMPU_METHOD
/begin COMPU_METHOD COMPU_Edp_TempFxp "" RAT_FUNC "%9.15" "degC" COEFFS 0 1 0 0 0 1 /end COMPU_METHOD
/begin COMPU_METHOD COMPU_Edp_TrqLimRsn "" TAB_VERB "%.1" "[]" COMPU_TAB_REF COMPU_Edp_TrqLimRsn /end COMPU_METHOD
/begin COMPU_METHOD COMPU_Edp_cmdActOutpStg "" TAB_VERB "%.1" "[]" COMPU_TAB_REF COMPU_Edp_cmdActOutpStg /end COMPU_METHOD
/begin COMPU_METHOD COMPU_Edp_cmdBckFcn1 "" TAB_VERB "%.1" "[]" COMPU_TAB_REF COMPU_Edp_cmdBckFcn1 /end COMPU_METHOD
/begin COMPU_METHOD COMPU_Edp_cmdBckFcn2 "" TAB_VERB "%.1" "[]" COMPU_TAB_REF COMPU_Edp_cmdBckFcn2 /end COMPU_METHOD
/begin COMPU_METHOD COMPU_Edp_cmdBckFcn3 "" TAB_VERB "%.1" "[]" COMPU_TAB_REF COMPU_Edp_cmdBckFcn3 /end COMPU_METHOD
/begin COMPU_METHOD COMPU_Edp_cmdBldc "" TAB_VERB "%.1" "[]" COMPU_TAB_REF COMPU_Edp_cmdBldc /end COMPU_METHOD
/begin COMPU_METHOD COMPU_Edp_cmdEm "" TAB_VERB "%.1" "[]" COMPU_TAB_REF COMPU_Edp_cmdEm /end COMPU_METHOD
/begin COMPU_METHOD COMPU_Edp_cmdPwrNetCalib "" TAB_VERB "%.1" "[]" COMPU_TAB_REF COMPU_Edp_cmdPwrNetCalib /end COMPU_METHOD
/begin COMPU_METHOD COMPU_Edp_stActOutpStg "" RAT_FUNC "%9.15" "[]" COEFFS 0 1 0 0 0 1 /end COMPU_METHOD
/begin COMPU_METHOD COMPU_Edp_stBldc "" TAB_VERB "%.1" "[]" COMPU_TAB_REF COMPU_Edp_stBldc /end COMPU_METHOD
/begin COMPU_METHOD COMPU_Edp_stCoolDwn "" TAB_VERB "%.1" "[]" COMPU_TAB_REF COMPU_Edp_stCoolDwn /end COMPU_METHOD
/begin COMPU_METHOD COMPU_Edp_stSafeState "" RAT_FUNC "%9.15" "[]" COEFFS 0 1 0 0 0 1 /end COMPU_METHOD
/begin COMPU_METHOD COMPU_Edp_stSolPlk "" TAB_VERB "%.1" "[]" COMPU_TAB_REF COMPU_Edp_stSolPlk /end COMPU_METHOD
/begin COMPU_METHOD COMPU_Edp_stSolPlkDiag "" TAB_VERB "%.1" "[]" COMPU_TAB_REF COMPU_Edp_stSolPlkDiag /end COMPU_METHOD
/begin COMPU_METHOD COMPU_Em_AscMode "" TAB_VERB "%.1" "[]" COMPU_TAB_REF COMPU_Em_AscMode /end COMPU_METHOD
/begin COMPU_METHOD COMPU_Em_CmtMode "" TAB_VERB "%.1" "[]" COMPU_TAB_REF COMPU_Em_CmtMode /end COMPU_METHOD
/begin COMPU_METHOD COMPU_Em_CtrlModeExtd "" TAB_VERB "%.1" "[]" COMPU_TAB_REF COMPU_Em_CtrlModeExtd /end COMPU_METHOD
/begin COMPU_METHOD COMPU_Em_FastFltReactn "" TAB_VERB "%.1" "[]" COMPU_TAB_REF COMPU_Em_FastFltReactn /end COMPU_METHOD
/begin COMPU_METHOD COMPU_Em_PhaseCnt "" TAB_VERB "%.1" "[]" COMPU_TAB_REF COMPU_Em_PhaseCnt /end COMPU_METHOD
/begin COMPU_METHOD COMPU_Em_PwrStgHwCtrlMode "" TAB_VERB "%.1" "[]" COMPU_TAB_REF COMPU_Em_PwrStgHwCtrlMode /end COMPU_METHOD
/begin COMPU_METHOD COMPU_Em_RpsAngOffsState "" TAB_VERB "%.1" "[]" COMPU_TAB_REF COMPU_Em_RpsAngOffsState /end COMPU_METHOD
/begin COMPU_METHOD COMPU_IDENTICAL_SCALING_FLOAT "" RAT_FUNC "%9.15" "[]" COEFFS 0 1 0 0 0 1 /end COMPU_METHOD
/begin COMPU_METHOD COMPU_IoHwAb_StrtupState "" TAB_VERB "%.1" "[]" COMPU_TAB_REF COMPU_IoHwAb_StrtupState /end COMPU_METHOD
/begin COMPU_METHOD COMPU_LibTlHwIo_IcDrv3245DrvCtrl "" TAB_VERB "%.1" "[]" COMPU_TAB_REF COMPU_LibTlHwIo_IcDrv3245DrvCtrl /end COMPU_METHOD
/begin COMPU_METHOD COMPU_LibTlHwIo_PwrStgFbOpnMode "" TAB_VERB "%.1" "[]" COMPU_TAB_REF COMPU_LibTlHwIo_PwrStgFbOpnMode /end COMPU_METHOD
/begin COMPU_METHOD COMPU_LibTlHwIo_PwrStgOpnMode "" TAB_VERB "%.1" "[]" COMPU_TAB_REF COMPU_LibTlHwIo_PwrStgOpnMode /end COMPU_METHOD
/begin COMPU_METHOD COMPU_LibTlSrvc_CmpntState "" TAB_VERB "%.1" "[]" COMPU_TAB_REF COMPU_LibTlSrvc_CmpntState /end COMPU_METHOD
/begin COMPU_METHOD COMPU_LibTlSrvc_CmpntStateReq "" TAB_VERB "%.1" "[]" COMPU_TAB_REF COMPU_LibTlSrvc_CmpntStateReq /end COMPU_METHOD
/begin COMPU_METHOD COMPU_LibTlSrvc_DcmIfCmd "" TAB_VERB "%.1" "[]" COMPU_TAB_REF COMPU_LibTlSrvc_DcmIfCmd /end COMPU_METHOD
/begin COMPU_METHOD COMPU_LibTlSrvc_DcmIfRoutnState "" TAB_VERB "%.1" "[]" COMPU_TAB_REF COMPU_LibTlSrvc_DcmIfRoutnState /end COMPU_METHOD
/begin COMPU_METHOD COMPU_LibTlSrvc_DcmResp "" TAB_VERB "%.1" "[]" COMPU_TAB_REF COMPU_LibTlSrvc_DcmResp /end COMPU_METHOD
/begin COMPU_METHOD COMPU_LibTlSrvc_IoCtrlCmd "" TAB_VERB "%.1" "[]" COMPU_TAB_REF COMPU_LibTlSrvc_IoCtrlCmd /end COMPU_METHOD
/begin COMPU_METHOD COMPU_LibTlSrvc_LvVoltFxp "" RAT_FUNC "%9.15" "V" COEFFS 0 1 0 0 0 1 /end COMPU_METHOD
/begin COMPU_METHOD COMPU_LibTlSrvc_RoutnExecnCmd "" TAB_VERB "%.1" "[]" COMPU_TAB_REF COMPU_LibTlSrvc_RoutnExecnCmd /end COMPU_METHOD
/begin COMPU_METHOD COMPU_LibTlSrvc_TempFxp "" RAT_FUNC "%9.15" "degC" COEFFS 0 1 0 0 0 1 /end COMPU_METHOD
/begin COMPU_METHOD COMPU_MCU_State "" TAB_VERB "%.1" "[]" COMPU_TAB_REF COMPU_MCU_State /end COMPU_METHOD
/begin COMPU_METHOD COMPU_NvM_RequestResultType "" TAB_VERB "%.1" "[]" COMPU_TAB_REF COMPU_NvM_RequestResultType /end COMPU_METHOD
/begin COMPU_METHOD COMPU_NvM_ServiceIdType "" TAB_VERB "%.1" "[]" COMPU_TAB_REF COMPU_NvM_ServiceIdType /end COMPU_METHOD
/begin COMPU_METHOD COMPU_PORT_HW_INVERTER_t "" TAB_VERB "%.1" "[]" COMPU_TAB_REF COMPU_PORT_HW_INVERTER_t /end COMPU_METHOD
/begin COMPU_METHOD COMPU_PS_stGear "" TAB_VERB "%.1" "[]" COMPU_TAB_REF COMPU_PS_stGear /end COMPU_METHOD
/begin COMPU_METHOD COMPU_PS_stPosMon "" TAB_VERB "%.1" "[]" COMPU_TAB_REF COMPU_PS_stPosMon /end COMPU_METHOD
/begin COMPU_METHOD COMPU_SBC_Mux "" TAB_VERB "%.1" "[]" COMPU_TAB_REF COMPU_SBC_Mux /end COMPU_METHOD
/begin COMPU_METHOD COMPU_SBC_State "" TAB_VERB "%.1" "[]" COMPU_TAB_REF COMPU_SBC_State /end COMPU_METHOD
/begin COMPU_METHOD COMPU_SBC_WD_Mode "" TAB_VERB "%.1" "[]" COMPU_TAB_REF COMPU_SBC_WD_Mode /end COMPU_METHOD
/begin COMPU_METHOD COMPU_SBC_nFault_FSXb "" TAB_VERB "%.1" "[]" COMPU_TAB_REF COMPU_SBC_nFault_FSXb /end COMPU_METHOD
/begin COMPU_METHOD COMPU_SBC_nFault_FSXb1 "" TAB_VERB "%.1" "[]" COMPU_TAB_REF COMPU_SBC_nFault_FSXb1 /end COMPU_METHOD
/begin COMPU_METHOD COMPU_SBC_nSSP3 "" TAB_VERB "%.1" "[]" COMPU_TAB_REF COMPU_SBC_nSSP3 /end COMPU_METHOD
/begin COMPU_METHOD COMPU_SI_Age "" RAT_FUNC "%9.15" "-" COEFFS 0 1 0 0 0 1 /end COMPU_METHOD
/begin COMPU_METHOD COMPU_SI_OrrdCdnWhlSpdBsdTrqLimCalcn "" TAB_VERB "%.1" "[]" COMPU_TAB_REF COMPU_SI_OrrdCdnWhlSpdBsdTrqLimCalcn /end COMPU_METHOD
/begin COMPU_METHOD COMPU_SI_cmdEmReq "" TAB_VERB "%.1" "[]" COMPU_TAB_REF COMPU_SI_cmdEmReq /end COMPU_METHOD
/begin COMPU_METHOD COMPU_SI_cmdHeatReq "" TAB_VERB "%.1" "[]" COMPU_TAB_REF COMPU_SI_cmdHeatReq /end COMPU_METHOD
/begin COMPU_METHOD COMPU_SI_stGear "" TAB_VERB "%.1" "[]" COMPU_TAB_REF COMPU_SI_stGear /end COMPU_METHOD
/begin COMPU_METHOD COMPU_SI_statePwrNet "" TAB_VERB "%.1" "[]" COMPU_TAB_REF COMPU_SI_statePwrNet /end COMPU_METHOD
/begin COMPU_METHOD COMPU_SI_tsDay "" RAT_FUNC "%9.15" "-" COEFFS 0 1 0 0 0 1 /end COMPU_METHOD
/begin COMPU_METHOD COMPU_SI_tsMonth "" RAT_FUNC "%9.15" "-" COEFFS 0 1 0 0 0 1 /end COMPU_METHOD
/begin COMPU_METHOD COMPU_SI_tsYear "" RAT_FUNC "%9.15" "-" COEFFS 0 1 0 0 0 1 /end COMPU_METHOD
/begin COMPU_METHOD COMPU_boolean "" TAB_VERB "%.1" "[]" COMPU_TAB_REF COMPU_boolean /end COMPU_METHOD
/begin COMPU_METHOD COMPU_boolean_CompuMethod "" TAB_VERB "%.1" "[]" COMPU_TAB_REF COMPU_boolean_CompuMethod /end COMPU_METHOD
/begin COMPU_METHOD COMPU_cmActvdcha "" TAB_VERB "%.1" "[]" COMPU_TAB_REF COMPU_cmActvdcha /end COMPU_METHOD
/begin COMPU_METHOD COMPU_cmActvdchaBattCnctSt "" TAB_VERB "%.1" "[]" COMPU_TAB_REF COMPU_cmActvdchaBattCnctSt /end COMPU_METHOD
/begin COMPU_METHOD COMPU_cmActvdchaSt "" TAB_VERB "%.1" "[]" COMPU_TAB_REF COMPU_cmActvdchaSt /end COMPU_METHOD
/begin COMPU_METHOD COMPU_cmAg "" RAT_FUNC "%9.15" "rad" COEFFS 0 1 0 0 0 1 /end COMPU_METHOD
/begin COMPU_METHOD COMPU_cmCptSt "" TAB_VERB "%.1" "[]" COMPU_TAB_REF COMPU_cmCptSt /end COMPU_METHOD
/begin COMPU_METHOD COMPU_cmCsmReq "" TAB_VERB "%.1" "[]" COMPU_TAB_REF COMPU_cmCsmReq /end COMPU_METHOD
/begin COMPU_METHOD COMPU_cmDataQly "" TAB_VERB "%.1" "[]" COMPU_TAB_REF COMPU_cmDataQly /end COMPU_METHOD
/begin COMPU_METHOD COMPU_cmFltReactnReq1Set "" TAB_VERB "%.1" "[]" COMPU_TAB_REF COMPU_cmFltReactnReq1Set /end COMPU_METHOD
/begin COMPU_METHOD COMPU_cmFltReactnReq2Set "" TAB_VERB "%.1" "[]" COMPU_TAB_REF COMPU_cmFltReactnReq2Set /end COMPU_METHOD
/begin COMPU_METHOD COMPU_cmFltReactnReq3Set "" TAB_VERB "%.1" "[]" COMPU_TAB_REF COMPU_cmFltReactnReq3Set /end COMPU_METHOD
/begin COMPU_METHOD COMPU_cmGearSt "" TAB_VERB "%.1" "[]" COMPU_TAB_REF COMPU_cmGearSt /end COMPU_METHOD
/begin COMPU_METHOD COMPU_cmId "" RAT_FUNC "%9.15" "[]" COEFFS 0 1 0 0 0 1 /end COMPU_METHOD
/begin COMPU_METHOD COMPU_cmMCUMod "" TAB_VERB "%.1" "[]" COMPU_TAB_REF COMPU_cmMCUMod /end COMPU_METHOD
/begin COMPU_METHOD COMPU_cmMotPwmSt "" TAB_VERB "%.1" "[]" COMPU_TAB_REF COMPU_cmMotPwmSt /end COMPU_METHOD
/begin COMPU_METHOD COMPU_cmNoUnit "" RAT_FUNC "%9.15" "[]" COEFFS 0 1 0 0 0 1 /end COMPU_METHOD
/begin COMPU_METHOD COMPU_cmPwrstgOperMode "" TAB_VERB "%.1" "[]" COMPU_TAB_REF COMPU_cmPwrstgOperMode /end COMPU_METHOD
/begin COMPU_METHOD COMPU_cmSelftestOpenPhaSt "" TAB_VERB "%.1" "[]" COMPU_TAB_REF COMPU_cmSelftestOpenPhaSt /end COMPU_METHOD
/begin COMPU_METHOD COMPU_cmSelftestSt "" TAB_VERB "%.1" "[]" COMPU_TAB_REF COMPU_cmSelftestSt /end COMPU_METHOD
/begin COMPU_METHOD COMPU_cmSelftestStPwrSply "" TAB_VERB "%.1" "[]" COMPU_TAB_REF COMPU_cmSelftestStPwrSply /end COMPU_METHOD
/begin COMPU_METHOD COMPU_cmSftyFltSt "" TAB_VERB "%.1" "[]" COMPU_TAB_REF COMPU_cmSftyFltSt /end COMPU_METHOD
/begin COMPU_METHOD COMPU_cmSftyMonCfg "" TAB_VERB "%.1" "[]" COMPU_TAB_REF COMPU_cmSftyMonCfg /end COMPU_METHOD
/begin COMPU_METHOD COMPU_cmSftyMonSt "" TAB_VERB "%.1" "[]" COMPU_TAB_REF COMPU_cmSftyMonSt /end COMPU_METHOD
/begin COMPU_METHOD COMPU_cmSftyOperCyc "" TAB_VERB "%.1" "[]" COMPU_TAB_REF COMPU_cmSftyOperCyc /end COMPU_METHOD
/begin COMPU_METHOD COMPU_cmSftyOperCycMask "" TAB_VERB "%.1" "[]" COMPU_TAB_REF COMPU_cmSftyOperCycMask /end COMPU_METHOD
/begin COMPU_METHOD COMPU_cmSftyOperSt "" TAB_VERB "%.1" "[]" COMPU_TAB_REF COMPU_cmSftyOperSt /end COMPU_METHOD
/begin COMPU_METHOD COMPU_cmSftyOperStEncod "" TAB_VERB "%.1" "[]" COMPU_TAB_REF COMPU_cmSftyOperStEncod /end COMPU_METHOD
/begin COMPU_METHOD COMPU_cmSftyTestFltLatent "" TAB_VERB "%.1" "[]" COMPU_TAB_REF COMPU_cmSftyTestFltLatent /end COMPU_METHOD
/begin COMPU_METHOD COMPU_cmSftyTestReq "" TAB_VERB "%.1" "[]" COMPU_TAB_REF COMPU_cmSftyTestReq /end COMPU_METHOD
/begin COMPU_METHOD COMPU_cmSftyTrqIntgl "" RAT_FUNC "%9.15" "Nms" COEFFS 0 1 0 0 0 1 /end COMPU_METHOD
/begin COMPU_METHOD COMPU_cmSplyCpbyFltSt "" TAB_VERB "%.1" "[]" COMPU_TAB_REF COMPU_cmSplyCpbyFltSt /end COMPU_METHOD
/begin COMPU_METHOD COMPU_cmTRecpr "" RAT_FUNC "%9.15" "1/degC" COEFFS 0 1 0 0 0 1 /end COMPU_METHOD
/begin COMPU_METHOD CSM_CMP_State "CSM Component State" TAB_VERB "%2.1" "" COMPU_TAB_REF CSM_CMP_State /end COMPU_METHOD
/begin COMPU_METHOD CSM_HW_Actuator_State_Method "OK/NOK" TAB_VERB "%3.0" "" COMPU_TAB_REF CSM_HW_Actuator_State /end COMPU_METHOD
/begin COMPU_METHOD CSM_OnOff_Method "ON/OFF" TAB_VERB "%3.0" "" COMPU_TAB_REF CSM_OnOff /end COMPU_METHOD
/begin COMPU_METHOD CSM_State "CSM_State" TAB_VERB "%2.1" "" COMPU_TAB_REF CSM_State /end COMPU_METHOD
/begin COMPU_METHOD ComM_Mode_Method "ComM_Mode_Method" TAB_VERB "%2.1" "" COMPU_TAB_REF ComM_Mode /end COMPU_METHOD
/begin COMPU_METHOD Current_1_512 "" RAT_FUNC "%3.3" "A" COEFFS 0 512 0 0 0 1 /end COMPU_METHOD
/begin COMPU_METHOD DCM_SecAccessStateMachine "State of Security Access State Machine" TAB_VERB "%3.1" "" COMPU_TAB_REF DCM_SecAccessStateMachine /end COMPU_METHOD
/begin COMPU_METHOD DCM_TransferData "State of TransferData Service" TAB_VERB "%3.1" "" COMPU_TAB_REF DCM_TransferData /end COMPU_METHOD
/begin COMPU_METHOD ECUM_State_Method "ECUM_State_Method" TAB_VERB "%2.1" "" COMPU_TAB_REF ECUM_State /end COMPU_METHOD
/begin COMPU_METHOD ED.Asw_Ang_deg "" IDENTICAL "%12.6" "degree" /end COMPU_METHOD
/begin COMPU_METHOD ED.Asw_AngrVel_radps "" IDENTICAL "%12.6" "rad/s" /end COMPU_METHOD
/begin COMPU_METHOD ED.Asw_Curr_A "" IDENTICAL "%12.6" "A" /end COMPU_METHOD
/begin COMPU_METHOD ED.Asw_Curr_Apeak "" IDENTICAL "%12.6" "Apeak" /end COMPU_METHOD
/begin COMPU_METHOD ED.Asw_Flux_Wb "" IDENTICAL "%12.6" "Wb" /end COMPU_METHOD
/begin COMPU_METHOD ED.Asw_Frq_Hz "" IDENTICAL "%12.6" "Hz" /end COMPU_METHOD
/begin COMPU_METHOD ED.Asw_Len_m "" IDENTICAL "%12.6" "m" /end COMPU_METHOD
/begin COMPU_METHOD ED.Asw_Len_mm "" IDENTICAL "%12.6" "mm" /end COMPU_METHOD
/begin COMPU_METHOD ED.Asw_Mass_kg "" IDENTICAL "%12.6" "kg" /end COMPU_METHOD
/begin COMPU_METHOD ED.Asw_Perc "" IDENTICAL "%12.6" "%" /end COMPU_METHOD
/begin COMPU_METHOD ED.Asw_Press_bar "" IDENTICAL "%12.6" "bar" /end COMPU_METHOD
/begin COMPU_METHOD ED.Asw_Pwr_W "" IDENTICAL "%12.6" "W" /end COMPU_METHOD
/begin COMPU_METHOD ED.Asw_Pwr_kW "" IDENTICAL "%12.6" "kW" /end COMPU_METHOD
/begin COMPU_METHOD ED.Asw_SigQly "" TAB_VERB "%s" "" COMPU_TAB_REF ED.CONV_TAB_Asw_SigQly /end COMPU_METHOD
/begin COMPU_METHOD ED.Asw_SpdRate_rpmps "" IDENTICAL "%12.6" "rpm/s" /end COMPU_METHOD
/begin COMPU_METHOD ED.Asw_Spd_rpm "" IDENTICAL "%12.6" "rpm" /end COMPU_METHOD
/begin COMPU_METHOD ED.Asw_Temp_degC "" IDENTICAL "%6.1" "degC" /end COMPU_METHOD
/begin COMPU_METHOD ED.Asw_Time_s "" IDENTICAL "%12.6" "s" /end COMPU_METHOD
/begin COMPU_METHOD ED.Asw_TrqRate_Nmps "" IDENTICAL "%12.6" "Nm/s" /end COMPU_METHOD
/begin COMPU_METHOD ED.Asw_Trq_Nm "" IDENTICAL "%12.6" "Nm" /end COMPU_METHOD
/begin COMPU_METHOD ED.Asw_Vel_kmh "" IDENTICAL "%12.6" "km/h" /end COMPU_METHOD
/begin COMPU_METHOD ED.Asw_Vof_lpmin "" IDENTICAL "%12.6" "lpm" /end COMPU_METHOD
/begin COMPU_METHOD ED.Asw_Volt_V "" IDENTICAL "%12.6" "V" /end COMPU_METHOD
/begin COMPU_METHOD ED.Asw_Volt_Vpeak "" IDENTICAL "%12.6" "Vpeak" /end COMPU_METHOD
/begin COMPU_METHOD ED.EQ_LSB_0_0001220703125 "" LINEAR "%20.13" "" COEFFS_LINEAR 0.0001220703125 0 /end COMPU_METHOD
/begin COMPU_METHOD ED.EQ_LSB_0_0001220703125_74 "" LINEAR "%20.13" "rpm" COEFFS_LINEAR 0.0001220703125 0 /end COMPU_METHOD
/begin COMPU_METHOD ED.EQ_LSB_0_0001220703125_75 "" LINEAR "%20.13" "degC" COEFFS_LINEAR 0.0001220703125 0 /end COMPU_METHOD
/begin COMPU_METHOD ED.EQ_LSB_0_000244140625 "" LINEAR "%20.12" "rpm" COEFFS_LINEAR 0.000244140625 0 /end COMPU_METHOD
/begin COMPU_METHOD ED.EQ_LSB_0_001 "" LINEAR "%6.3" "" COEFFS_LINEAR 0.001 0 /end COMPU_METHOD
/begin COMPU_METHOD ED.EQ_LSB_0_001953125 "" LINEAR "%13.9" "" COEFFS_LINEAR 0.001953125 0 /end COMPU_METHOD
/begin COMPU_METHOD ED.EQ_LSB_0_00390625 "" LINEAR "%12.8" "degC" COEFFS_LINEAR 0.00390625 0 /end COMPU_METHOD
/begin COMPU_METHOD ED.EQ_LSB_0_01 "" LINEAR "%6.2" "sec" COEFFS_LINEAR 0.01 0 /end COMPU_METHOD
/begin COMPU_METHOD ED.EQ_LSB_0_01_73 "" LINEAR "%6.2" "" COEFFS_LINEAR 0.01 0 /end COMPU_METHOD
/begin COMPU_METHOD ED.EQ_LSB_0_1 "" LINEAR "%6.1" "s" COEFFS_LINEAR 0.1 0 /end COMPU_METHOD
/begin COMPU_METHOD ED.EQ_LSB_0_5 "" LINEAR "%7.1" "W" COEFFS_LINEAR 0.5 0 /end COMPU_METHOD
/begin COMPU_METHOD ED.EQ_LSB_1 "" LINEAR "%3.0" "" COEFFS_LINEAR 1 0 /end COMPU_METHOD
/begin COMPU_METHOD ED.EQ_LSB_1_68 "" LINEAR "%12.6" "" COEFFS_LINEAR 1 0 /end COMPU_METHOD
/begin COMPU_METHOD ED.EQ_LSB_1_69 "" LINEAR "%12.6" "Nm" COEFFS_LINEAR 1 0 /end COMPU_METHOD
/begin COMPU_METHOD ED.EQ_LSB_1_70 "" LINEAR "%12.6" "rpm" COEFFS_LINEAR 1 0 /end COMPU_METHOD
/begin COMPU_METHOD ED.EQ_LSB_1_71 "" LINEAR "%5.0" "ms" COEFFS_LINEAR 1 0 /end COMPU_METHOD
/begin COMPU_METHOD ED.EQ_LSB_1_72 "" LINEAR "%5.0" "Nm" COEFFS_LINEAR 1 0 /end COMPU_METHOD
/begin COMPU_METHOD ED.EQ_LSB_1_76 "" LINEAR "%5.0" "" COEFFS_LINEAR 1 0 /end COMPU_METHOD
/begin COMPU_METHOD ED.EQ_LSB_1_OFF_m1 "" LINEAR "%5.0" "" COEFFS_LINEAR 1 -1 /end COMPU_METHOD
/begin COMPU_METHOD ED.EQ_LSB_3_0517578125em5 "" LINEAR "%17.15" "" COEFFS_LINEAR 3.0517578125E-05 0 /end COMPU_METHOD
/begin COMPU_METHOD ED.EQ_LSB_4 "" LINEAR "%6.0" "" COEFFS_LINEAR 4 0 /end COMPU_METHOD
/begin COMPU_METHOD ED.EQ_LSB_6_103515625em5 "" LINEAR "%16.14" "" COEFFS_LINEAR 6.103515625E-05 0 /end COMPU_METHOD
/begin COMPU_METHOD ED.TLE_Default "TargetLink Scaling Type MainD10_stCompState" LINEAR "%3.0" "" COEFFS_LINEAR 1 0 /end COMPU_METHOD
/begin COMPU_METHOD ED.TLE_Global_reqCompstate "TargetLink Scaling Type MainY10_stCompState" TAB_VERB "%3.0" "" COMPU_TAB_REF ED.CONV_TAB_TLE_Global_reqCompstate /end COMPU_METHOD
/begin COMPU_METHOD ED.TLE_Global_stCompstate "TargetLink Scaling Type InputY10_reqCompstate" TAB_VERB "%3.0" "" COMPU_TAB_REF ED.CONV_TAB_TLE_Global_stCompstate /end COMPU_METHOD
/begin COMPU_METHOD ED.TLE_ModeNSyncTarget "TargetLink Scaling Type MainD10_stCompState" TAB_VERB "%3.0" "" COMPU_TAB_REF ED.CONV_TAB_TLE_ModeNSyncTarget /end COMPU_METHOD
/begin COMPU_METHOD ED.TLE_QF "TargetLink enumeration for qualifier signals" TAB_VERB "%3.0" "" COMPU_TAB_REF ED.CONV_TAB_TLE_QF /end COMPU_METHOD
/begin COMPU_METHOD ED.TLE_SvcJobED10_curRunStateLC "TargetLink Scaling Type SvcJobP10_curState" TAB_VERB "%3.0" "" COMPU_TAB_REF ED.CONV_TAB_TLE_SvcJobED10_curRunStateLC /end COMPU_METHOD
/begin COMPU_METHOD ED.TLE_SvcJobED10_curState "TargetLink Scaling Type SvcJobP10_curState" TAB_VERB "%3.0" "" COMPU_TAB_REF ED.CONV_TAB_TLE_SvcJobED10_curState /end COMPU_METHOD
/begin COMPU_METHOD ED.TLE_cmdBckupFcn1 "Enumeration for requested controller state" TAB_VERB "%3.0" "" COMPU_TAB_REF ED.CONV_TAB_TLE_cmdBckupFcn1 /end COMPU_METHOD
/begin COMPU_METHOD ED.TLE_cmdBckupFcn2 "Enumeration for Backupfunction Gear Shift / Park Lock" TAB_VERB "%3.0" "" COMPU_TAB_REF ED.CONV_TAB_TLE_cmdBckupFcn2 /end COMPU_METHOD
/begin COMPU_METHOD ED.TLE_cmdEm "TargetLink Scaling Type for command EM" TAB_VERB "%3.0" "" COMPU_TAB_REF ED.CONV_TAB_TLE_cmdEm /end COMPU_METHOD
/begin COMPU_METHOD ED.TLE_cmdEmReq "Enumeration for requested controller state" TAB_VERB "%3.0" "" COMPU_TAB_REF ED.CONV_TAB_TLE_cmdEmReq /end COMPU_METHOD
/begin COMPU_METHOD ED.TLE_cmdReqSvcJob "TargetLink Scaling Type SvcJobP10_stSystemState" TAB_VERB "%3.0" "" COMPU_TAB_REF ED.CONV_TAB_TLE_cmdReqSvcJob /end COMPU_METHOD
/begin COMPU_METHOD ED.TLE_reqBoost "Enumeration for boost mode requests from VCU" TAB_VERB "%3.0" "" COMPU_TAB_REF ED.CONV_TAB_TLE_reqBoost /end COMPU_METHOD
/begin COMPU_METHOD ED.TLE_reqCmtMode "TargetLink Scaling Type mode solenoid" TAB_VERB "%3.0" "" COMPU_TAB_REF ED.CONV_TAB_TLE_reqCmtMode /end COMPU_METHOD
/begin COMPU_METHOD ED.TLE_reqCtrlMode "Enumeration for requested controller state" TAB_VERB "%3.0" "" COMPU_TAB_REF ED.CONV_TAB_TLE_reqCtrlMode /end COMPU_METHOD
/begin COMPU_METHOD ED.TLE_reqTestBenchMode "Enumeration for requested coupling / decoupling state" TAB_VERB "%3.0" "" COMPU_TAB_REF ED.CONV_TAB_TLE_reqTestBenchMode /end COMPU_METHOD
/begin COMPU_METHOD ED.TLE_rsnDeratGen "Enumeration for generatoric derating reason" TAB_VERB "%3.0" "" COMPU_TAB_REF ED.CONV_TAB_TLE_rsnDeratGen /end COMPU_METHOD
/begin COMPU_METHOD ED.TLE_rsnDeratMot "Enumeration for motoric derating reason" TAB_VERB "%3.0" "" COMPU_TAB_REF ED.CONV_TAB_TLE_rsnDeratMot /end COMPU_METHOD
/begin COMPU_METHOD ED.TLE_stActDmpConfig "active damping states" TAB_VERB "%3.0" "" COMPU_TAB_REF ED.CONV_TAB_TLE_stActDmpConfig /end COMPU_METHOD
/begin COMPU_METHOD ED.TLE_stBoost "Enumeration for boost mode states in state machine" TAB_VERB "%3.0" "" COMPU_TAB_REF ED.CONV_TAB_TLE_stBoost /end COMPU_METHOD
/begin COMPU_METHOD ED.TLE_stDCUCalib "Enumeration for DCU Calibration and position learning states" TAB_VERB "%3.0" "" COMPU_TAB_REF ED.CONV_TAB_TLE_stDCUCalib /end COMPU_METHOD
/begin COMPU_METHOD ED.TLE_stDamp "TargetLink enumeration for the active damping status" LINEAR "%3.0" "" COEFFS_LINEAR 1 0 /end COMPU_METHOD
/begin COMPU_METHOD ED.TLE_stGear "Enumeration for gear state" TAB_VERB "%3.0" "" COMPU_TAB_REF ED.CONV_TAB_TLE_stGear /end COMPU_METHOD
/begin COMPU_METHOD ED.TLE_stGearShift "Enumeration for gear state" TAB_VERB "%3.0" "" COMPU_TAB_REF ED.CONV_TAB_TLE_stGearShift /end COMPU_METHOD
/begin COMPU_METHOD ED.TLE_stPosMon "TargetLink Scaling Type PosMonS02_curstate" TAB_VERB "%3.0" "" COMPU_TAB_REF ED.CONV_TAB_TLE_stPosMon /end COMPU_METHOD
/begin COMPU_METHOD ED.TLE_stQuadrant "Enumeration for requested controller state" TAB_VERB "%3.0" "" COMPU_TAB_REF ED.CONV_TAB_TLE_stQuadrant /end COMPU_METHOD
/begin COMPU_METHOD ED.TLE_stTrqRamp "Enumeration for TrqShift module" TAB_VERB "%3.0" "" COMPU_TAB_REF ED.CONV_TAB_TLE_stTrqRamp /end COMPU_METHOD
/begin COMPU_METHOD ED.TLS_AVL_SIG_AGE_TB "" LINEAR "%6.0" "ms" COEFFS_LINEAR 5 0 /end COMPU_METHOD
/begin COMPU_METHOD ED.TLS_EdiClt_EmInletFlow "" LINEAR "%5.2" "l/min" COEFFS_LINEAR 0.05 0 /end COMPU_METHOD
/begin COMPU_METHOD ED.TLS_EdiClt_EmInletTemp "" LINEAR "%7.2" "ï¿½C" COEFFS_LINEAR 0.25 80 /end COMPU_METHOD
/begin COMPU_METHOD ED.TLS_EdiClt_InvInletFlow "" LINEAR "%5.2" "l/min" COEFFS_LINEAR 0.05 0 /end COMPU_METHOD
/begin COMPU_METHOD ED.TLS_EdiClt_InvInletTemp "" LINEAR "%7.2" "ï¿½C" COEFFS_LINEAR 0.25 80 /end COMPU_METHOD
/begin COMPU_METHOD ED.TLS_EdiDcpl_reqDcpl "" LINEAR "%3.0" "" COEFFS_LINEAR 1 0 /end COMPU_METHOD
/begin COMPU_METHOD ED.TLS_EdiEdrv_ActvDchrgReq "" LINEAR "%3.0" "" COEFFS_LINEAR 1 0 /end COMPU_METHOD
/begin COMPU_METHOD ED.TLS_EdiEdrv_AngReq "" LINEAR "%8.3" "deg" COEFFS_LINEAR 0.125 0 /end COMPU_METHOD
/begin COMPU_METHOD ED.TLS_EdiEdrv_CltTempSens "" LINEAR "%7.2" "ï¿½C" COEFFS_LINEAR 0.25 80 /end COMPU_METHOD
/begin COMPU_METHOD ED.TLS_EdiEdrv_CltTempSens_a "" LINEAR "%12.2" "ï¿½C" COEFFS_LINEAR 0.25 80 /end COMPU_METHOD
/begin COMPU_METHOD ED.TLS_EdiEdrv_CmtModeReq "" LINEAR "%3.0" "" COEFFS_LINEAR 1 0 /end COMPU_METHOD
/begin COMPU_METHOD ED.TLS_EdiEdrv_CmtTestModeEn "" LINEAR "%3.0" "" COEFFS_LINEAR 1 0 /end COMPU_METHOD
/begin COMPU_METHOD ED.TLS_EdiEdrv_CsmState "" LINEAR "%3.0" "" COEFFS_LINEAR 1 0 /end COMPU_METHOD
/begin COMPU_METHOD ED.TLS_EdiEdrv_CsmState_b "" LINEAR "%5.0" "" COEFFS_LINEAR 1 0 /end COMPU_METHOD
/begin COMPU_METHOD ED.TLS_EdiEdrv_CtlMode "" LINEAR "%3.0" "" COEFFS_LINEAR 1 0 /end COMPU_METHOD
/begin COMPU_METHOD ED.TLS_EdiEdrv_CtlModeReq "" LINEAR "%3.0" "" COEFFS_LINEAR 1 0 /end COMPU_METHOD
/begin COMPU_METHOD ED.TLS_EdiEdrv_CtlMode_c "" LINEAR "%10.0" "" COEFFS_LINEAR 1 0 /end COMPU_METHOD
/begin COMPU_METHOD ED.TLS_EdiEdrv_CtlTestModeEn "" LINEAR "%3.0" "" COEFFS_LINEAR 1 0 /end COMPU_METHOD
/begin COMPU_METHOD ED.TLS_EdiEdrv_CurrReq "" LINEAR "%9.3" "A" COEFFS_LINEAR 0.625 0 /end COMPU_METHOD
/begin COMPU_METHOD ED.TLS_EdiEdrv_DcLinkCapDeltaTemp "" LINEAR "%7.2" "ï¿½C" COEFFS_LINEAR 0.25 80 /end COMPU_METHOD
/begin COMPU_METHOD ED.TLS_EdiEdrv_DcLinkCapDeltaTemp_d "" LINEAR "%12.2" "ï¿½C" COEFFS_LINEAR 0.25 80 /end COMPU_METHOD
/begin COMPU_METHOD ED.TLS_EdiEdrv_DcLinkCapTemp "" LINEAR "%7.2" "ï¿½C" COEFFS_LINEAR 0.25 80 /end COMPU_METHOD
/begin COMPU_METHOD ED.TLS_EdiEdrv_DcLinkCapTemp_e "" LINEAR "%12.2" "ï¿½C" COEFFS_LINEAR 0.25 80 /end COMPU_METHOD
/begin COMPU_METHOD ED.TLS_EdiEdrv_DcLinkCurr "" LINEAR "%9.3" "A" COEFFS_LINEAR 0.625 0 /end COMPU_METHOD
/begin COMPU_METHOD ED.TLS_EdiEdrv_DcLinkCurrRippleCurr "" LINEAR "%9.3" "A" COEFFS_LINEAR 0.625 0 /end COMPU_METHOD
/begin COMPU_METHOD ED.TLS_EdiEdrv_DcLinkCurrRippleCurr_g "" LINEAR "%14.3" "A" COEFFS_LINEAR 0.625 0 /end COMPU_METHOD
/begin COMPU_METHOD ED.TLS_EdiEdrv_DcLinkCurr_f "" LINEAR "%14.3" "A" COEFFS_LINEAR 0.625 0 /end COMPU_METHOD
/begin COMPU_METHOD ED.TLS_EdiEdrv_DcLinkVolt "" LINEAR "%10.5" "V" COEFFS_LINEAR 0.03125 0 /end COMPU_METHOD
/begin COMPU_METHOD ED.TLS_EdiEdrv_DcLinkVolt_h "" LINEAR "%14.5" "V" COEFFS_LINEAR 0.03125 0 /end COMPU_METHOD
/begin COMPU_METHOD ED.TLS_EdiEdrv_DcplgSt "" LINEAR "%3.0" "" COEFFS_LINEAR 1 0 /end COMPU_METHOD
/begin COMPU_METHOD ED.TLS_EdiEdrv_DrctCurr "" LINEAR "%9.3" "A" COEFFS_LINEAR 0.625 0 /end COMPU_METHOD
/begin COMPU_METHOD ED.TLS_EdiEdrv_DrctCurr2 "" LINEAR "%9.3" "A" COEFFS_LINEAR 0.625 0 /end COMPU_METHOD
/begin COMPU_METHOD ED.TLS_EdiEdrv_DrctCurr_j "" LINEAR "%14.3" "A" COEFFS_LINEAR 0.625 0 /end COMPU_METHOD
/begin COMPU_METHOD ED.TLS_EdiEdrv_DrctVolt "" LINEAR "%10.5" "V" COEFFS_LINEAR 0.03125 0 /end COMPU_METHOD
/begin COMPU_METHOD ED.TLS_EdiEdrv_DrctVolt2 "" LINEAR "%10.5" "V" COEFFS_LINEAR 0.03125 0 /end COMPU_METHOD
/begin COMPU_METHOD ED.TLS_EdiEdrv_DrctVolt2_k "" LINEAR "%14.5" "V" COEFFS_LINEAR 0.03125 0 /end COMPU_METHOD
/begin COMPU_METHOD ED.TLS_EdiEdrv_DrctVolt_l "" LINEAR "%14.5" "V" COEFFS_LINEAR 0.03125 0 /end COMPU_METHOD
/begin COMPU_METHOD ED.TLS_EdiEdrv_EdSmState "" LINEAR "%3.0" "" COEFFS_LINEAR 1 0 /end COMPU_METHOD
/begin COMPU_METHOD ED.TLS_EdiEdrv_EdSmState_m "" LINEAR "%5.0" "" COEFFS_LINEAR 1 0 /end COMPU_METHOD
/begin COMPU_METHOD ED.TLS_EdiEdrv_ElecAng "" LINEAR "%12.6" "deg" COEFFS_LINEAR 0.351906 0 /end COMPU_METHOD
/begin COMPU_METHOD ED.TLS_EdiEdrv_ElecAng_n "" LINEAR "%16.6" "deg" COEFFS_LINEAR 0.351906 0 /end COMPU_METHOD
/begin COMPU_METHOD ED.TLS_EdiEdrv_EmPwrLoss "" LINEAR "%6.0" "W" COEFFS_LINEAR 2 0 /end COMPU_METHOD
/begin COMPU_METHOD ED.TLS_EdiEdrv_EmPwrLoss_o "" LINEAR "%10.0" "W" COEFFS_LINEAR 2 0 /end COMPU_METHOD
/begin COMPU_METHOD ED.TLS_EdiEdrv_EmSmState "" LINEAR "%3.0" "" COEFFS_LINEAR 1 0 /end COMPU_METHOD
/begin COMPU_METHOD ED.TLS_EdiEdrv_EmSmState_p "" LINEAR "%5.0" "" COEFFS_LINEAR 1 0 /end COMPU_METHOD
/begin COMPU_METHOD ED.TLS_EdiEdrv_ErrBf "" LINEAR "%3.0" "" COEFFS_LINEAR 1 0 /end COMPU_METHOD
/begin COMPU_METHOD ED.TLS_EdiEdrv_ExtSnsrFreq1 "" LINEAR "%7.1" "Hz" COEFFS_LINEAR 0.5 0 /end COMPU_METHOD
/begin COMPU_METHOD ED.TLS_EdiEdrv_ExtSnsrFreq2 "" LINEAR "%7.1" "Hz" COEFFS_LINEAR 0.5 0 /end COMPU_METHOD
/begin COMPU_METHOD ED.TLS_EdiEdrv_HgSmState "" LINEAR "%3.0" "" COEFFS_LINEAR 1 0 /end COMPU_METHOD
/begin COMPU_METHOD ED.TLS_EdiEdrv_HgSmState_q "" LINEAR "%5.0" "" COEFFS_LINEAR 1 0 /end COMPU_METHOD
/begin COMPU_METHOD ED.TLS_EdiEdrv_HvBattMainSwtSt "" LINEAR "%3.0" "" COEFFS_LINEAR 1 0 /end COMPU_METHOD
/begin COMPU_METHOD ED.TLS_EdiEdrv_HvBattMainSwtSt_66 "" LINEAR "%10.0" "" COEFFS_LINEAR 1 0 /end COMPU_METHOD
/begin COMPU_METHOD ED.TLS_EdiEdrv_HvBattMainSwtSt_67 "" LINEAR "%5.0" "" COEFFS_LINEAR 1 0 /end COMPU_METHOD
/begin COMPU_METHOD ED.TLS_EdiEdrv_IndMotPsiD "" LINEAR "%12.10" "Wb" COEFFS_LINEAR 6.10352E-05 0 /end COMPU_METHOD
/begin COMPU_METHOD ED.TLS_EdiEdrv_IndMotPsiD_r "" LINEAR "%17.10" "Wb" COEFFS_LINEAR 6.10352E-05 0 /end COMPU_METHOD
/begin COMPU_METHOD ED.TLS_EdiEdrv_IndMotSlipAngVel "" LINEAR "%9.4" "rad/s" COEFFS_LINEAR 0.0325 0 /end COMPU_METHOD
/begin COMPU_METHOD ED.TLS_EdiEdrv_IndMotSlipAngVel_s "" LINEAR "%13.4" "rad/s" COEFFS_LINEAR 0.0325 0 /end COMPU_METHOD
/begin COMPU_METHOD ED.TLS_EdiEdrv_IndMotSlipReq "" LINEAR "%7.2" "rad/s" COEFFS_LINEAR 0.25 0 /end COMPU_METHOD
/begin COMPU_METHOD ED.TLS_EdiEdrv_IndMotStatorAngVel "" LINEAR "%7.2" "rad/s" COEFFS_LINEAR 0.25 0 /end COMPU_METHOD
/begin COMPU_METHOD ED.TLS_EdiEdrv_IndMotStatorAngVel_t "" LINEAR "%12.2" "rad/s" COEFFS_LINEAR 0.25 0 /end COMPU_METHOD
/begin COMPU_METHOD ED.TLS_EdiEdrv_InvJuncTempEstMax "" LINEAR "%7.2" "ï¿½C" COEFFS_LINEAR 0.25 80 /end COMPU_METHOD
/begin COMPU_METHOD ED.TLS_EdiEdrv_InvJuncTempEstMax_u "" LINEAR "%12.2" "ï¿½C" COEFFS_LINEAR 0.25 80 /end COMPU_METHOD
/begin COMPU_METHOD ED.TLS_EdiEdrv_InvPhaseCurr1 "" LINEAR "%9.3" "A" COEFFS_LINEAR 0.625 0 /end COMPU_METHOD
/begin COMPU_METHOD ED.TLS_EdiEdrv_InvPhaseCurr1AdcVolt "" LINEAR "%8.5" "V" COEFFS_LINEAR 0.00125 0 /end COMPU_METHOD
/begin COMPU_METHOD ED.TLS_EdiEdrv_InvPhaseCurr1_v "" LINEAR "%14.3" "A" COEFFS_LINEAR 0.625 0 /end COMPU_METHOD
/begin COMPU_METHOD ED.TLS_EdiEdrv_InvPhaseCurr2 "" LINEAR "%9.3" "A" COEFFS_LINEAR 0.625 0 /end COMPU_METHOD
/begin COMPU_METHOD ED.TLS_EdiEdrv_InvPhaseCurr2AdcVolt "" LINEAR "%8.5" "V" COEFFS_LINEAR 0.00125 0 /end COMPU_METHOD
/begin COMPU_METHOD ED.TLS_EdiEdrv_InvPhaseCurr2_x "" LINEAR "%14.3" "A" COEFFS_LINEAR 0.625 0 /end COMPU_METHOD
/begin COMPU_METHOD ED.TLS_EdiEdrv_InvPhaseCurr3 "" LINEAR "%9.3" "A" COEFFS_LINEAR 0.625 0 /end COMPU_METHOD
/begin COMPU_METHOD ED.TLS_EdiEdrv_InvPhaseCurr3AdcVolt "" LINEAR "%8.5" "V" COEFFS_LINEAR 0.00125 0 /end COMPU_METHOD
/begin COMPU_METHOD ED.TLS_EdiEdrv_InvPhaseCurr3_y "" LINEAR "%14.3" "A" COEFFS_LINEAR 0.625 0 /end COMPU_METHOD
/begin COMPU_METHOD ED.TLS_EdiEdrv_InvPhaseCurr4 "" LINEAR "%9.3" "A" COEFFS_LINEAR 0.625 0 /end COMPU_METHOD
/begin COMPU_METHOD ED.TLS_EdiEdrv_InvPhaseCurr4AdcVolt "" LINEAR "%8.5" "V" COEFFS_LINEAR 0.00125 0 /end COMPU_METHOD
/begin COMPU_METHOD ED.TLS_EdiEdrv_InvPhaseCurr4_z "" LINEAR "%14.3" "A" COEFFS_LINEAR 0.625 0 /end COMPU_METHOD
/begin COMPU_METHOD ED.TLS_EdiEdrv_InvPhaseCurr5 "" LINEAR "%9.3" "A" COEFFS_LINEAR 0.625 0 /end COMPU_METHOD
/begin COMPU_METHOD ED.TLS_EdiEdrv_InvPhaseCurr5AdcVolt "" LINEAR "%8.5" "V" COEFFS_LINEAR 0.00125 0 /end COMPU_METHOD
/begin COMPU_METHOD ED.TLS_EdiEdrv_InvPhaseCurr5_24 "" LINEAR "%14.3" "A" COEFFS_LINEAR 0.625 0 /end COMPU_METHOD
/begin COMPU_METHOD ED.TLS_EdiEdrv_InvPhaseCurr6 "" LINEAR "%9.3" "A" COEFFS_LINEAR 0.625 0 /end COMPU_METHOD
/begin COMPU_METHOD ED.TLS_EdiEdrv_InvPhaseCurr6AdcVolt "" LINEAR "%8.5" "V" COEFFS_LINEAR 0.00125 0 /end COMPU_METHOD
/begin COMPU_METHOD ED.TLS_EdiEdrv_InvPhaseCurr6_25 "" LINEAR "%14.3" "A" COEFFS_LINEAR 0.625 0 /end COMPU_METHOD
/begin COMPU_METHOD ED.TLS_EdiEdrv_InvPwrLoss "" LINEAR "%5.0" "W" COEFFS_LINEAR 1 0 /end COMPU_METHOD
/begin COMPU_METHOD ED.TLS_EdiEdrv_InvPwrLoss_26 "" LINEAR "%10.0" "W" COEFFS_LINEAR 1 0 /end COMPU_METHOD
/begin COMPU_METHOD ED.TLS_EdiEdrv_InvTempU "" LINEAR "%7.2" "ï¿½C" COEFFS_LINEAR 0.25 80 /end COMPU_METHOD
/begin COMPU_METHOD ED.TLS_EdiEdrv_InvTempU_27 "" LINEAR "%12.2" "ï¿½C" COEFFS_LINEAR 0.25 80 /end COMPU_METHOD
/begin COMPU_METHOD ED.TLS_EdiEdrv_InvTempV "" LINEAR "%7.2" "ï¿½C" COEFFS_LINEAR 0.25 80 /end COMPU_METHOD
/begin COMPU_METHOD ED.TLS_EdiEdrv_InvTempV_28 "" LINEAR "%12.2" "ï¿½C" COEFFS_LINEAR 0.25 80 /end COMPU_METHOD
/begin COMPU_METHOD ED.TLS_EdiEdrv_InvTempW "" LINEAR "%7.2" "ï¿½C" COEFFS_LINEAR 0.25 80 /end COMPU_METHOD
/begin COMPU_METHOD ED.TLS_EdiEdrv_InvTempW_29 "" LINEAR "%12.2" "ï¿½C" COEFFS_LINEAR 0.25 80 /end COMPU_METHOD
/begin COMPU_METHOD ED.TLS_EdiEdrv_InvTempX "" LINEAR "%7.2" "ï¿½C" COEFFS_LINEAR 0.25 80 /end COMPU_METHOD
/begin COMPU_METHOD ED.TLS_EdiEdrv_InvTempX_30 "" LINEAR "%12.2" "ï¿½C" COEFFS_LINEAR 0.25 80 /end COMPU_METHOD
/begin COMPU_METHOD ED.TLS_EdiEdrv_InvTempY "" LINEAR "%7.2" "ï¿½C" COEFFS_LINEAR 0.25 80 /end COMPU_METHOD
/begin COMPU_METHOD ED.TLS_EdiEdrv_InvTempY_31 "" LINEAR "%12.2" "ï¿½C" COEFFS_LINEAR 0.25 80 /end COMPU_METHOD
/begin COMPU_METHOD ED.TLS_EdiEdrv_InvTempZ "" LINEAR "%7.2" "ï¿½C" COEFFS_LINEAR 0.25 80 /end COMPU_METHOD
/begin COMPU_METHOD ED.TLS_EdiEdrv_InvTempZ_32 "" LINEAR "%12.2" "ï¿½C" COEFFS_LINEAR 0.25 80 /end COMPU_METHOD
/begin COMPU_METHOD ED.TLS_EdiEdrv_MotTemp1 "" LINEAR "%7.2" "ï¿½C" COEFFS_LINEAR 0.25 80 /end COMPU_METHOD
/begin COMPU_METHOD ED.TLS_EdiEdrv_MotTemp1_33 "" LINEAR "%12.2" "ï¿½C" COEFFS_LINEAR 0.25 80 /end COMPU_METHOD
/begin COMPU_METHOD ED.TLS_EdiEdrv_MotTemp2 "" LINEAR "%7.2" "ï¿½C" COEFFS_LINEAR 0.25 80 /end COMPU_METHOD
/begin COMPU_METHOD ED.TLS_EdiEdrv_MotTemp2_34 "" LINEAR "%12.2" "ï¿½C" COEFFS_LINEAR 0.25 80 /end COMPU_METHOD
/begin COMPU_METHOD ED.TLS_EdiEdrv_PhaseCurrAvlRms "" LINEAR "%5.0" "A" COEFFS_LINEAR 1 0 /end COMPU_METHOD
/begin COMPU_METHOD ED.TLS_EdiEdrv_PhaseCurrRms "" LINEAR "%5.0" "A" COEFFS_LINEAR 1 0 /end COMPU_METHOD
/begin COMPU_METHOD ED.TLS_EdiEdrv_PldSafeStateSrcStsBf "" LINEAR "%5.0" "" COEFFS_LINEAR 1 0 /end COMPU_METHOD
/begin COMPU_METHOD ED.TLS_EdiEdrv_PldSafeStateSrcStsBf_35 "" LINEAR "%10.0" "" COEFFS_LINEAR 1 0 /end COMPU_METHOD
/begin COMPU_METHOD ED.TLS_EdiEdrv_PmFluxFact "" LINEAR "%7.2" "%" COEFFS_LINEAR 0.05 0 /end COMPU_METHOD
/begin COMPU_METHOD ED.TLS_EdiEdrv_PmFluxFact_36 "" LINEAR "%12.2" "%" COEFFS_LINEAR 0.05 0 /end COMPU_METHOD
/begin COMPU_METHOD ED.TLS_EdiEdrv_QuadCurr "" LINEAR "%9.3" "A" COEFFS_LINEAR 0.625 0 /end COMPU_METHOD
/begin COMPU_METHOD ED.TLS_EdiEdrv_QuadCurr2 "" LINEAR "%9.3" "A" COEFFS_LINEAR 0.625 0 /end COMPU_METHOD
/begin COMPU_METHOD ED.TLS_EdiEdrv_QuadCurr_37 "" LINEAR "%14.3" "A" COEFFS_LINEAR 0.625 0 /end COMPU_METHOD
/begin COMPU_METHOD ED.TLS_EdiEdrv_QuadVolt "" LINEAR "%10.5" "V" COEFFS_LINEAR 0.03125 0 /end COMPU_METHOD
/begin COMPU_METHOD ED.TLS_EdiEdrv_QuadVolt2 "" LINEAR "%10.5" "V" COEFFS_LINEAR 0.03125 0 /end COMPU_METHOD
/begin COMPU_METHOD ED.TLS_EdiEdrv_QuadVolt2_38 "" LINEAR "%14.5" "V" COEFFS_LINEAR 0.03125 0 /end COMPU_METHOD
/begin COMPU_METHOD ED.TLS_EdiEdrv_QuadVolt_39 "" LINEAR "%14.5" "V" COEFFS_LINEAR 0.03125 0 /end COMPU_METHOD
/begin COMPU_METHOD ED.TLS_EdiEdrv_RotorTempEstMax "" LINEAR "%7.2" "ï¿½C" COEFFS_LINEAR 0.25 80 /end COMPU_METHOD
/begin COMPU_METHOD ED.TLS_EdiEdrv_RotorTempEstMax_40 "" LINEAR "%12.2" "ï¿½C" COEFFS_LINEAR 0.25 80 /end COMPU_METHOD
/begin COMPU_METHOD ED.TLS_EdiEdrv_SftySt "" LINEAR "%3.0" "" COEFFS_LINEAR 1 0 /end COMPU_METHOD
/begin COMPU_METHOD ED.TLS_EdiEdrv_SftySt_41 "" LINEAR "%5.0" "" COEFFS_LINEAR 1 0 /end COMPU_METHOD
/begin COMPU_METHOD ED.TLS_EdiEdrv_SpdMaxAllwdMotShaft "" LINEAR "%5.0" "RPM" COEFFS_LINEAR 1 0 /end COMPU_METHOD
/begin COMPU_METHOD ED.TLS_EdiEdrv_SpdMaxAllwdMotShaft_42 "" LINEAR "%10.0" "RPM" COEFFS_LINEAR 1 0 /end COMPU_METHOD
/begin COMPU_METHOD ED.TLS_EdiEdrv_SpdMotShaft "" LINEAR "%5.0" "RPM" COEFFS_LINEAR 2 0 /end COMPU_METHOD
/begin COMPU_METHOD ED.TLS_EdiEdrv_SpdMotShaft_43 "" LINEAR "%10.0" "RPM" COEFFS_LINEAR 2 0 /end COMPU_METHOD
/begin COMPU_METHOD ED.TLS_EdiEdrv_SpdReqMotShaft "" LINEAR "%5.0" "RPM" COEFFS_LINEAR 2 0 /end COMPU_METHOD
/begin COMPU_METHOD ED.TLS_EdiEdrv_StatorTempEstMax "" LINEAR "%7.2" "ï¿½C" COEFFS_LINEAR 0.25 80 /end COMPU_METHOD
/begin COMPU_METHOD ED.TLS_EdiEdrv_StatorTempEstMax_44 "" LINEAR "%12.2" "ï¿½C" COEFFS_LINEAR 0.25 80 /end COMPU_METHOD
/begin COMPU_METHOD ED.TLS_EdiEdrv_TrqMotShaft "" LINEAR "%10.5" "Nm" COEFFS_LINEAR 0.03125 0 /end COMPU_METHOD
/begin COMPU_METHOD ED.TLS_EdiEdrv_TrqMotShaft_45 "" LINEAR "%14.5" "Nm" COEFFS_LINEAR 0.03125 0 /end COMPU_METHOD
/begin COMPU_METHOD ED.TLS_EdiEdrv_TrqNegAvlShaft "" LINEAR "%10.5" "Nm" COEFFS_LINEAR 0.03125 -2047.96875 /end COMPU_METHOD
/begin COMPU_METHOD ED.TLS_EdiEdrv_TrqNegAvlShaft_46 "" LINEAR "%14.5" "Nm" COEFFS_LINEAR 0.03125 -2047.96875 /end COMPU_METHOD
/begin COMPU_METHOD ED.TLS_EdiEdrv_TrqNegLimDerReason "" LINEAR "%3.0" "" COEFFS_LINEAR 1 0 /end COMPU_METHOD
/begin COMPU_METHOD ED.TLS_EdiEdrv_TrqNegLimDerReason_47 "" LINEAR "%5.0" "" COEFFS_LINEAR 1 0 /end COMPU_METHOD
/begin COMPU_METHOD ED.TLS_EdiEdrv_TrqPosAvlShaft "" LINEAR "%10.5" "Nm" COEFFS_LINEAR 0.03125 0 /end COMPU_METHOD
/begin COMPU_METHOD ED.TLS_EdiEdrv_TrqPosAvlShaft_48 "" LINEAR "%14.5" "Nm" COEFFS_LINEAR 0.03125 0 /end COMPU_METHOD
/begin COMPU_METHOD ED.TLS_EdiEdrv_TrqPosLimDerReason "" LINEAR "%3.0" "" COEFFS_LINEAR 1 0 /end COMPU_METHOD
/begin COMPU_METHOD ED.TLS_EdiEdrv_TrqPosLimDerReason_49 "" LINEAR "%5.0" "" COEFFS_LINEAR 1 0 /end COMPU_METHOD
/begin COMPU_METHOD ED.TLS_EdiEdrv_TrqReqLimMax "" LINEAR "%10.5" "Nm" COEFFS_LINEAR 0.03125 0 /end COMPU_METHOD
/begin COMPU_METHOD ED.TLS_EdiEdrv_TrqReqLimMin "" LINEAR "%10.5" "Nm" COEFFS_LINEAR 0.03125 0 /end COMPU_METHOD
/begin COMPU_METHOD ED.TLS_EdiEdrv_TrqReqLimSpdCtrlMax "" LINEAR "%10.5" "Nm" COEFFS_LINEAR 0.03125 0 /end COMPU_METHOD
/begin COMPU_METHOD ED.TLS_EdiEdrv_TrqReqLimSpdCtrlMin "" LINEAR "%10.5" "Nm" COEFFS_LINEAR 0.03125 0 /end COMPU_METHOD
/begin COMPU_METHOD ED.TLS_EdiEdrv_TrqReqShaft "" LINEAR "%10.5" "Nm" COEFFS_LINEAR 0.03125 0 /end COMPU_METHOD
/begin COMPU_METHOD ED.TLS_EdiEdrv_VoltReq "" LINEAR "%10.5" "V" COEFFS_LINEAR 0.03125 0 /end COMPU_METHOD
/begin COMPU_METHOD ED.TLS_EdiEdrv_dutyCycleHvil "" LINEAR "%5.1" "%" COEFFS_LINEAR 0.5 0 /end COMPU_METHOD
/begin COMPU_METHOD ED.TLS_EdiEdrv_frqHvil "" LINEAR "%8.2" "Hz" COEFFS_LINEAR 0.25 0 /end COMPU_METHOD
/begin COMPU_METHOD ED.TLS_EdiEdrv_frqHvil_50 "" LINEAR "%12.2" "Hz" COEFFS_LINEAR 0.25 0 /end COMPU_METHOD
/begin COMPU_METHOD ED.TLS_EdiEdrv_nMainShaft "" LINEAR "%5.0" "rpm" COEFFS_LINEAR 1 -32768 /end COMPU_METHOD
/begin COMPU_METHOD ED.TLS_EdiEdrv_nMainShaft_51 "" LINEAR "%10.0" "rpm" COEFFS_LINEAR 1 -32768 /end COMPU_METHOD
/begin COMPU_METHOD ED.TLS_EdiSys_BattCurrMaxDyn "" LINEAR "%5.0" "A" COEFFS_LINEAR 1 0 /end COMPU_METHOD
/begin COMPU_METHOD ED.TLS_EdiSys_BattCurrMinDyn "" LINEAR "%5.0" "A" COEFFS_LINEAR 1 -1023 /end COMPU_METHOD
/begin COMPU_METHOD ED.TLS_EdiSys_BattVoltMax "" LINEAR "%10.5" "V" COEFFS_LINEAR 0.03125 0 /end COMPU_METHOD
/begin COMPU_METHOD ED.TLS_EdiSys_BattVoltMin "" LINEAR "%10.5" "V" COEFFS_LINEAR 0.03125 0 /end COMPU_METHOD
/begin COMPU_METHOD ED.TLS_EdiSys_ResetCounter "" LINEAR "%3.0" "" COEFFS_LINEAR 1 0 /end COMPU_METHOD
/begin COMPU_METHOD ED.TLS_EdiSys_ResetCounter_52 "" LINEAR "%5.0" "" COEFFS_LINEAR 1 0 /end COMPU_METHOD
/begin COMPU_METHOD ED.TLS_EdiSys_SpdSlopMax "" LINEAR "%4.0" "rpm/s" COEFFS_LINEAR 10 0 /end COMPU_METHOD
/begin COMPU_METHOD ED.TLS_EdiSys_SwBugfixVer "" LINEAR "%3.0" "" COEFFS_LINEAR 1 0 /end COMPU_METHOD
/begin COMPU_METHOD ED.TLS_EdiSys_SwBugfixVer_53 "" LINEAR "%5.0" "" COEFFS_LINEAR 1 0 /end COMPU_METHOD
/begin COMPU_METHOD ED.TLS_EdiSys_SwMajorVer "" LINEAR "%3.0" "" COEFFS_LINEAR 1 0 /end COMPU_METHOD
/begin COMPU_METHOD ED.TLS_EdiSys_SwMajorVer_54 "" LINEAR "%5.0" "" COEFFS_LINEAR 1 0 /end COMPU_METHOD
/begin COMPU_METHOD ED.TLS_EdiSys_SwMinorVer "" LINEAR "%3.0" "" COEFFS_LINEAR 1 0 /end COMPU_METHOD
/begin COMPU_METHOD ED.TLS_EdiSys_SwMinorVer_55 "" LINEAR "%5.0" "" COEFFS_LINEAR 1 0 /end COMPU_METHOD
/begin COMPU_METHOD ED.TLS_EdiSys_SwPatch "" LINEAR "%3.0" "" COEFFS_LINEAR 1 0 /end COMPU_METHOD
/begin COMPU_METHOD ED.TLS_EdiSys_SwPatch_56 "" LINEAR "%5.0" "" COEFFS_LINEAR 1 0 /end COMPU_METHOD
/begin COMPU_METHOD ED.TLS_HCU_EM_offset_angle "" LINEAR "%6.2" "ï¿½" COEFFS_LINEAR 0.01 0 /end COMPU_METHOD
/begin COMPU_METHOD ED.TLS_HCU_ModReq "" LINEAR "%3.0" "Mode" COEFFS_LINEAR 1 0 /end COMPU_METHOD
/begin COMPU_METHOD ED.TLS_HCU_OilFlowRate "" LINEAR "%10.5" "L/min" COEFFS_LINEAR 0.03125 0 /end COMPU_METHOD
/begin COMPU_METHOD ED.TLS_HCU_OilT "" LINEAR "%3.0" "C" COEFFS_LINEAR 1 -40 /end COMPU_METHOD
/begin COMPU_METHOD ED.TLS_HCU_SpdReq "" LINEAR "%5.0" "rpm" COEFFS_LINEAR 1 -32768 /end COMPU_METHOD
/begin COMPU_METHOD ED.TLS_HCU_TqDampingMax "" LINEAR "%7.1" "Nm" COEFFS_LINEAR 0.5 -1023 /end COMPU_METHOD
/begin COMPU_METHOD ED.TLS_HCU_TqDampingMin "" LINEAR "%7.1" "Nm" COEFFS_LINEAR 0.5 -1023 /end COMPU_METHOD
/begin COMPU_METHOD ED.TLS_HCU_TqMax "" LINEAR "%7.1" "Nm" COEFFS_LINEAR 0.5 0 /end COMPU_METHOD
/begin COMPU_METHOD ED.TLS_HCU_TqMin "" LINEAR "%7.1" "Nm" COEFFS_LINEAR 0.5 -1023 /end COMPU_METHOD
/begin COMPU_METHOD ED.TLS_HCU_TqReq "" LINEAR "%7.1" "Nm" COEFFS_LINEAR 0.5 -1023 /end COMPU_METHOD
/begin COMPU_METHOD ED.TLS_INV_IDCEstimd "" LINEAR "%6.1" "A" COEFFS_LINEAR 0.1 -1400 /end COMPU_METHOD
/begin COMPU_METHOD ED.TLS_INV_IDCEstimd_57 "" LINEAR "%11.1" "A" COEFFS_LINEAR 0.1 -1400 /end COMPU_METHOD
/begin COMPU_METHOD ED.TLS_INV_ModSts "" LINEAR "%3.0" "Mode" COEFFS_LINEAR 1 0 /end COMPU_METHOD
/begin COMPU_METHOD ED.TLS_INV_ModSts_58 "" LINEAR "%5.0" "Mode" COEFFS_LINEAR 1 0 /end COMPU_METHOD
/begin COMPU_METHOD ED.TLS_INV_PWRModuleTemp "" LINEAR "%3.0" "C" COEFFS_LINEAR 1 -48 /end COMPU_METHOD
/begin COMPU_METHOD ED.TLS_INV_PWRModuleTemp_59 "" LINEAR "%5.0" "C" COEFFS_LINEAR 1 -48 /end COMPU_METHOD
/begin COMPU_METHOD ED.TLS_INV_SCU_DERATING "" LINEAR "%10.0" "-" COEFFS_LINEAR 1 0 /end COMPU_METHOD
/begin COMPU_METHOD ED.TLS_INV_SCU_DIAG "" LINEAR "%10.0" "-" COEFFS_LINEAR 1 0 /end COMPU_METHOD
/begin COMPU_METHOD ED.TLS_INV_SpdMeas "" LINEAR "%5.0" "rpm" COEFFS_LINEAR 1 -32768 /end COMPU_METHOD
/begin COMPU_METHOD ED.TLS_INV_SpdMeas_60 "" LINEAR "%10.0" "rpm" COEFFS_LINEAR 1 -32768 /end COMPU_METHOD
/begin COMPU_METHOD ED.TLS_INV_Stator_TEMP "" LINEAR "%3.0" "C" COEFFS_LINEAR 1 -48 /end COMPU_METHOD
/begin COMPU_METHOD ED.TLS_INV_Stator_TEMP_61 "" LINEAR "%5.0" "C" COEFFS_LINEAR 1 -48 /end COMPU_METHOD
/begin COMPU_METHOD ED.TLS_INV_ThermalLoadrate "" LINEAR "%3.0" "-" COEFFS_LINEAR 1 0 /end COMPU_METHOD
/begin COMPU_METHOD ED.TLS_INV_TrqEstimd "" LINEAR "%7.1" "Nm" COEFFS_LINEAR 0.5 -1023 /end COMPU_METHOD
/begin COMPU_METHOD ED.TLS_INV_TrqEstimd_62 "" LINEAR "%12.1" "Nm" COEFFS_LINEAR 0.5 -1023 /end COMPU_METHOD
/begin COMPU_METHOD ED.TLS_INV_TrqMaxAllwdEstimd "" LINEAR "%7.1" "Nm" COEFFS_LINEAR 0.5 -1023 /end COMPU_METHOD
/begin COMPU_METHOD ED.TLS_INV_TrqMaxAllwdEstimd_63 "" LINEAR "%12.1" "Nm" COEFFS_LINEAR 0.5 -1023 /end COMPU_METHOD
/begin COMPU_METHOD ED.TLS_INV_TrqMinAllwdEstimd "" LINEAR "%7.1" "Nm" COEFFS_LINEAR 0.5 -1023 /end COMPU_METHOD
/begin COMPU_METHOD ED.TLS_INV_TrqMinAllwdEstimd_64 "" LINEAR "%12.1" "Nm" COEFFS_LINEAR 0.5 -1023 /end COMPU_METHOD
/begin COMPU_METHOD ED.TLS_INV_UDCMeas "" LINEAR "%7.1" "V" COEFFS_LINEAR 0.5 0 /end COMPU_METHOD
/begin COMPU_METHOD ED.TLS_INV_UDCMeas_65 "" LINEAR "%12.1" "V" COEFFS_LINEAR 0.5 0 /end COMPU_METHOD
/begin COMPU_METHOD ED.TLS_nRPS "TargetLink Scaling Type speed information from rotary position sensor " LINEAR "%21.15" "" COEFFS_LINEAR 1.52587890625E-05 0 /end COMPU_METHOD
/begin COMPU_METHOD ED.TLS_nRPS_rpm "TargetLink Scaling Type speed information from rotary position sensor " LINEAR "%21.15" "" COEFFS_LINEAR 1.52587890625E-05 0 /end COMPU_METHOD
/begin COMPU_METHOD ED.TLS_phiRPS "TargetLink Scaling Type absolute phi information from rotary position sensor, including multiturn counting " LINEAR "%21.15" "" COEFFS_LINEAR 1.52587890625E-05 0 /end COMPU_METHOD
/begin COMPU_METHOD ED.TLS_phiRPS_rnds "TargetLink Scaling Type for phiRPS" LINEAR "%21.15" "deg" COEFFS_LINEAR 1.52587890625E-05 0 /end COMPU_METHOD
/begin COMPU_METHOD ED.TLS_time1ms "TargetLink Scaling Type time 1ms" LINEAR "%5.0" "ms" COEFFS_LINEAR 1 0 /end COMPU_METHOD
/begin COMPU_METHOD EM.Asw_Len_m "" IDENTICAL "%12.6" "m" /end COMPU_METHOD
/begin COMPU_METHOD EM.Asw_Len_mm "" IDENTICAL "%12.6" "mm" /end COMPU_METHOD
/begin COMPU_METHOD EM.Asw_Mass_kg "" IDENTICAL "%12.6" "kg" /end COMPU_METHOD
/begin COMPU_METHOD EM.Asw_QF "" LINEAR "%3.0" "ratio" COEFFS_LINEAR 1 0 /end COMPU_METHOD
/begin COMPU_METHOD EM.Asw_Ratio "" IDENTICAL "%12.6" "ratio" /end COMPU_METHOD
/begin COMPU_METHOD EM.Asw_Spd_rpm "" IDENTICAL "%12.6" "rpm" /end COMPU_METHOD
/begin COMPU_METHOD EM.Asw_Temp_degC "" IDENTICAL "%6.1" "degC" /end COMPU_METHOD
/begin COMPU_METHOD EM.Asw_Trq_Nm "" IDENTICAL "%12.6" "Nm" /end COMPU_METHOD
/begin COMPU_METHOD EM.Asw_Vel_kmh "" IDENTICAL "%12.6" "km/h" /end COMPU_METHOD
/begin COMPU_METHOD EM.Asw_Volt_V "" IDENTICAL "%12.6" "V" /end COMPU_METHOD
/begin COMPU_METHOD EM.TLE_Global_stCompstate "TargetLink Scaling Type MainY10_stCompState" TAB_VERB "%3.0" "" COMPU_TAB_REF EM.CONV_TAB_TLE_Global_stCompstate /end COMPU_METHOD
/begin COMPU_METHOD EM.TLE_cmdEm "TargetLink Scaling Type for command EM" TAB_VERB "%3.0" "" COMPU_TAB_REF EM.CONV_TAB_TLE_cmdEm /end COMPU_METHOD
/begin COMPU_METHOD EM.TLE_stGear "Enumeration for gear state" TAB_VERB "%3.0" "" COMPU_TAB_REF EM.CONV_TAB_TLE_stGear /end COMPU_METHOD
/begin COMPU_METHOD EM.TLE_stGearShift "Enumeration for gear state" TAB_VERB "%3.0" "" COMPU_TAB_REF EM.CONV_TAB_TLE_stGearShift /end COMPU_METHOD
/begin COMPU_METHOD Edbl_10_NonDim_bp0 "" LINEAR "%1.0" "-" COEFFS_LINEAR 1 0 /end COMPU_METHOD
/begin COMPU_METHOD Edbl_11_Nm_bp0 "" LINEAR "%12.6" "Nm" COEFFS_LINEAR 1 0 /end COMPU_METHOD
/begin COMPU_METHOD Edbl_12_NonDim_bp0 "" LINEAR "%3.0" "-" COEFFS_LINEAR 1 0 /end COMPU_METHOD
/begin COMPU_METHOD Edbl_1_s_bp0 "" LINEAR "%12.6" "s" COEFFS_LINEAR 1 0 /end COMPU_METHOD
/begin COMPU_METHOD Edbl_2_Nm_s_bp0 "" LINEAR "%12.6" "Nm/s" COEFFS_LINEAR 1 0 /end COMPU_METHOD
/begin COMPU_METHOD Edbl_3_NonDim_bp0 "" LINEAR "%12.6" "-" COEFFS_LINEAR 1 0 /end COMPU_METHOD
/begin COMPU_METHOD Edbl_4_rad_s_bp0 "" LINEAR "%12.6" "rad/s" COEFFS_LINEAR 1 0 /end COMPU_METHOD
/begin COMPU_METHOD Edbl_5_Ohm_bp0 "" LINEAR "%12.6" "Ohm" COEFFS_LINEAR 1 0 /end COMPU_METHOD
/begin COMPU_METHOD Edbl_6_rpm_bp0 "" LINEAR "%12.6" "rpm" COEFFS_LINEAR 1 0 /end COMPU_METHOD
/begin COMPU_METHOD Edbl_7_V_bp0 "" LINEAR "%12.6" "V" COEFFS_LINEAR 1 0 /end COMPU_METHOD
/begin COMPU_METHOD Edbl_8_A_bp0 "" LINEAR "%12.6" "A" COEFFS_LINEAR 1 0 /end COMPU_METHOD
/begin COMPU_METHOD Edbl_9_W_bp0 "" LINEAR "%12.6" "W" COEFFS_LINEAR 1 0 /end COMPU_METHOD
/begin COMPU_METHOD Edcf_10_EQ_LSB_0_0002 "Scaling for user-defined data type \'DC_FCTR_5000_U16\'." LINEAR "%7.4" "" COEFFS_LINEAR 0.0002 0 /end COMPU_METHOD
/begin COMPU_METHOD Edcf_11_ms_bp0 "" LINEAR "%5.0" "ms" COEFFS_LINEAR 1 0 /end COMPU_METHOD
/begin COMPU_METHOD Edcf_12_s_bp0 "" LINEAR "%12.6" "s" COEFFS_LINEAR 1 0 /end COMPU_METHOD
/begin COMPU_METHOD Edcf_13__1_s_bp0 "" LINEAR "%12.6" "1/s" COEFFS_LINEAR 1 0 /end COMPU_METHOD
/begin COMPU_METHOD Edcf_14_NonDim_bn16 "" LINEAR "%16.15" "-" COEFFS_LINEAR 1.52587890625E-05 0 /end COMPU_METHOD
/begin COMPU_METHOD Edcf_15_Nm_s_bp0 "" LINEAR "%12.6" "Nm/s" COEFFS_LINEAR 1 0 /end COMPU_METHOD
/begin COMPU_METHOD Edcf_16_rpm_bp0 "" LINEAR "%12.6" "rpm" COEFFS_LINEAR 1 0 /end COMPU_METHOD
/begin COMPU_METHOD Edcf_17_NonDim_bp0 "" LINEAR "%12.6" "-" COEFFS_LINEAR 1 0 /end COMPU_METHOD
/begin COMPU_METHOD Edcf_18_Nm_bp0 "" LINEAR "%12.6" "Nm" COEFFS_LINEAR 1 0 /end COMPU_METHOD
/begin COMPU_METHOD Edcf_19_NonDim_bp0 "" LINEAR "%3.0" "-" COEFFS_LINEAR 1 0 /end COMPU_METHOD
/begin COMPU_METHOD Edcf_1_NonDim_bn10 "" LINEAR "%13.10" "-" COEFFS_LINEAR 0.0009765625 0 /end COMPU_METHOD
/begin COMPU_METHOD Edcf_20_NonDim_bp0 "" LINEAR "%1.0" "-" COEFFS_LINEAR 1 0 /end COMPU_METHOD
/begin COMPU_METHOD Edcf_21_Nm_bp0 "" LINEAR "%5.0" "Nm" COEFFS_LINEAR 1 0 /end COMPU_METHOD
/begin COMPU_METHOD Edcf_2_rpm_bp2 "" LINEAR "%6.0" "rpm" COEFFS_LINEAR 4 0 /end COMPU_METHOD
/begin COMPU_METHOD Edcf_3_NonDim_bp0 "" LINEAR "%5.0" "-" COEFFS_LINEAR 1 0 /end COMPU_METHOD
/begin COMPU_METHOD Edcf_4_Nm_bn4 "" LINEAR "%9.4" "Nm" COEFFS_LINEAR 0.0625 0 /end COMPU_METHOD
/begin COMPU_METHOD Edcf_5_LocalEQ32210 "EDS_enum_Gr" TAB_VERB "%3.0" "-" COMPU_TAB_REF Edcf_5_CONV_TAB_LocalEQ32210 /end COMPU_METHOD
/begin COMPU_METHOD Edcf_6_LocalEQ32209 "EDS_enum_Gr" TAB_VERB "%3.0" "-" COMPU_TAB_REF Edcf_6_CONV_TAB_LocalEQ32209 /end COMPU_METHOD
/begin COMPU_METHOD Edcf_7_LocalEQ32208 "EDS_enum_Gr" TAB_VERB "%3.0" "-" COMPU_TAB_REF Edcf_7_CONV_TAB_LocalEQ32208 /end COMPU_METHOD
/begin COMPU_METHOD Edcf_8_LocalEQ32207 "EDS_enum_Gr" TAB_VERB "%3.0" "-" COMPU_TAB_REF Edcf_8_CONV_TAB_LocalEQ32207 /end COMPU_METHOD
/begin COMPU_METHOD Edcf_9_LocalEQ32206 "EDS_CF_b_SpdDevRefFadSlct_p" TAB_VERB "%3.0" "-" COMPU_TAB_REF Edcf_9_CONV_TAB_LocalEQ32206 /end COMPU_METHOD
/begin COMPU_METHOD Edin_10_LocalEQ55004 "" TAB_VERB "%3.0" "" COMPU_TAB_REF Edin_10_CONV_TAB_LocalEQ55004 /end COMPU_METHOD
/begin COMPU_METHOD Edin_11_LocalEQ55003 "" TAB_VERB "%3.0" "-" COMPU_TAB_REF Edin_11_CONV_TAB_LocalEQ55003 /end COMPU_METHOD
/begin COMPU_METHOD Edin_12_LocalEQ55002 "" TAB_VERB "%3.0" "-" COMPU_TAB_REF Edin_12_CONV_TAB_LocalEQ55002 /end COMPU_METHOD
/begin COMPU_METHOD Edin_13_LocalEQ55001 "" TAB_VERB "%3.0" "" COMPU_TAB_REF Edin_13_CONV_TAB_LocalEQ55001 /end COMPU_METHOD
/begin COMPU_METHOD Edin_14_LocalEQ55000 "" TAB_VERB "%3.0" "" COMPU_TAB_REF Edin_14_CONV_TAB_LocalEQ55000 /end COMPU_METHOD
/begin COMPU_METHOD Edin_15_LocalEQ54999 "" TAB_VERB "%3.0" "" COMPU_TAB_REF Edin_15_CONV_TAB_LocalEQ54999 /end COMPU_METHOD
/begin COMPU_METHOD Edin_16_LocalEQ54998 "" TAB_VERB "%3.0" "" COMPU_TAB_REF Edin_16_CONV_TAB_LocalEQ54998 /end COMPU_METHOD
/begin COMPU_METHOD Edin_17_LocalEQ54997 "" TAB_VERB "%3.0" "" COMPU_TAB_REF Edin_17_CONV_TAB_LocalEQ54997 /end COMPU_METHOD
/begin COMPU_METHOD Edin_18_LocalEQ54996 "" TAB_VERB "%3.0" "" COMPU_TAB_REF Edin_18_CONV_TAB_LocalEQ54996 /end COMPU_METHOD
/begin COMPU_METHOD Edin_19_LocalEQ54995 "" TAB_VERB "%3.0" "" COMPU_TAB_REF Edin_19_CONV_TAB_LocalEQ54995 /end COMPU_METHOD
/begin COMPU_METHOD Edin_1_LocalEQ55013 "" TAB_VERB "%3.0" "" COMPU_TAB_REF Edin_1_CONV_TAB_LocalEQ55013 /end COMPU_METHOD
/begin COMPU_METHOD Edin_20_LocalEQ54994 "" TAB_VERB "%3.0" "" COMPU_TAB_REF Edin_20_CONV_TAB_LocalEQ54994 /end COMPU_METHOD
/begin COMPU_METHOD Edin_21_LocalEQ54993 "" TAB_VERB "%3.0" "" COMPU_TAB_REF Edin_21_CONV_TAB_LocalEQ54993 /end COMPU_METHOD
/begin COMPU_METHOD Edin_22_LocalEQ54992 "" TAB_VERB "%3.0" "" COMPU_TAB_REF Edin_22_CONV_TAB_LocalEQ54992 /end COMPU_METHOD
/begin COMPU_METHOD Edin_23_LocalEQ54991 "" TAB_VERB "%3.0" "" COMPU_TAB_REF Edin_23_CONV_TAB_LocalEQ54991 /end COMPU_METHOD
/begin COMPU_METHOD Edin_24_LocalEQ54990 "" TAB_VERB "%3.0" "-" COMPU_TAB_REF Edin_24_CONV_TAB_LocalEQ54990 /end COMPU_METHOD
/begin COMPU_METHOD Edin_25_NonDim_bp0 "" LINEAR "%3.0" "-" COEFFS_LINEAR 1 0 /end COMPU_METHOD
/begin COMPU_METHOD Edin_26_LocalEQ54989 "" TAB_VERB "%3.0" "" COMPU_TAB_REF Edin_26_CONV_TAB_LocalEQ54989 /end COMPU_METHOD
/begin COMPU_METHOD Edin_27_NonDim_bn10 "" LINEAR "%13.10" "-" COEFFS_LINEAR 0.0009765625 0 /end COMPU_METHOD
/begin COMPU_METHOD Edin_28_Hz_bp0 "" LINEAR "%5.0" "Hz" COEFFS_LINEAR 1 0 /end COMPU_METHOD
/begin COMPU_METHOD Edin_29_rad_s_bp0 "" LINEAR "%12.6" "rad/s" COEFFS_LINEAR 1 0 /end COMPU_METHOD
/begin COMPU_METHOD Edin_2_LocalEQ55012 "" TAB_VERB "%3.0" "" COMPU_TAB_REF Edin_2_CONV_TAB_LocalEQ55012 /end COMPU_METHOD
/begin COMPU_METHOD Edin_30_s_bp0 "" LINEAR "%12.6" "s" COEFFS_LINEAR 1 0 /end COMPU_METHOD
/begin COMPU_METHOD Edin_31_min_bp0 "" LINEAR "%12.6" "min" COEFFS_LINEAR 1 0 /end COMPU_METHOD
/begin COMPU_METHOD Edin_32_km_bp0 "" LINEAR "%12.6" "km" COEFFS_LINEAR 1 0 /end COMPU_METHOD
/begin COMPU_METHOD Edin_33_rpm_bp0 "" LINEAR "%12.6" "rpm" COEFFS_LINEAR 1 0 /end COMPU_METHOD
/begin COMPU_METHOD Edin_34_NonDim_bp0 "" LINEAR "%12.6" "-" COEFFS_LINEAR 1 0 /end COMPU_METHOD
/begin COMPU_METHOD Edin_35_grdC_bp0 "" LINEAR "%12.6" "°C" COEFFS_LINEAR 1 0 /end COMPU_METHOD
/begin COMPU_METHOD Edin_36_lpm_bp0 "" LINEAR "%12.6" "l/min" COEFFS_LINEAR 1 0 /end COMPU_METHOD
/begin COMPU_METHOD Edin_37_NonDim_bp0 "" LINEAR "%5.0" "-" COEFFS_LINEAR 1 0 /end COMPU_METHOD
/begin COMPU_METHOD Edin_38_LocalEQ55022 "" TAB_VERB "%3.0" "" COMPU_TAB_REF Edin_38_CONV_TAB_LocalEQ55022 /end COMPU_METHOD
/begin COMPU_METHOD Edin_39_Nm_bp0 "" LINEAR "%12.6" "Nm" COEFFS_LINEAR 1 0 /end COMPU_METHOD
/begin COMPU_METHOD Edin_3_LocalEQ55011 "" TAB_VERB "%3.0" "" COMPU_TAB_REF Edin_3_CONV_TAB_LocalEQ55011 /end COMPU_METHOD
/begin COMPU_METHOD Edin_40_Ohm_bp0 "" LINEAR "%12.6" "Ohm" COEFFS_LINEAR 1 0 /end COMPU_METHOD
/begin COMPU_METHOD Edin_41_V_bp0 "" LINEAR "%12.6" "V" COEFFS_LINEAR 1 0 /end COMPU_METHOD
/begin COMPU_METHOD Edin_42_W_bp0 "" LINEAR "%12.6" "W" COEFFS_LINEAR 1 0 /end COMPU_METHOD
/begin COMPU_METHOD Edin_43_A_bp0 "" LINEAR "%12.6" "A" COEFFS_LINEAR 1 0 /end COMPU_METHOD
/begin COMPU_METHOD Edin_44_NonDim_bp0 "" LINEAR "%1.0" "-" COEFFS_LINEAR 1 0 /end COMPU_METHOD
/begin COMPU_METHOD Edin_4_LocalEQ55010 "" TAB_VERB "%3.0" "" COMPU_TAB_REF Edin_4_CONV_TAB_LocalEQ55010 /end COMPU_METHOD
/begin COMPU_METHOD Edin_5_LocalEQ55009 "" TAB_VERB "%3.0" "" COMPU_TAB_REF Edin_5_CONV_TAB_LocalEQ55009 /end COMPU_METHOD
/begin COMPU_METHOD Edin_6_LocalEQ55008 "" TAB_VERB "%3.0" "" COMPU_TAB_REF Edin_6_CONV_TAB_LocalEQ55008 /end COMPU_METHOD
/begin COMPU_METHOD Edin_7_LocalEQ55007 "" TAB_VERB "%3.0" "" COMPU_TAB_REF Edin_7_CONV_TAB_LocalEQ55007 /end COMPU_METHOD
/begin COMPU_METHOD Edin_8_LocalEQ55006 "" TAB_VERB "%3.0" "" COMPU_TAB_REF Edin_8_CONV_TAB_LocalEQ55006 /end COMPU_METHOD
/begin COMPU_METHOD Edin_9_LocalEQ55005 "" TAB_VERB "%3.0" "" COMPU_TAB_REF Edin_9_CONV_TAB_LocalEQ55005 /end COMPU_METHOD
/begin COMPU_METHOD Edls_1_NonDim_bp0 "" LINEAR "%12.6" "-" COEFFS_LINEAR 1 0 /end COMPU_METHOD
/begin COMPU_METHOD Edls_2_grdC_bp0 "" LINEAR "%12.6" "°C" COEFFS_LINEAR 1 0 /end COMPU_METHOD
/begin COMPU_METHOD Edls_3_rpm_bp0 "" LINEAR "%12.6" "rpm" COEFFS_LINEAR 1 0 /end COMPU_METHOD
/begin COMPU_METHOD Edls_4_NonDim_bp0 "" LINEAR "%5.0" "-" COEFFS_LINEAR 1 0 /end COMPU_METHOD
/begin COMPU_METHOD Edls_5_LocalEQ77337 "" TAB_VERB "%3.0" "" COMPU_TAB_REF Edls_5_CONV_TAB_LocalEQ77337 /end COMPU_METHOD
/begin COMPU_METHOD Edls_6_LocalEQ77336 "" TAB_VERB "%3.0" "" COMPU_TAB_REF Edls_6_CONV_TAB_LocalEQ77336 /end COMPU_METHOD
/begin COMPU_METHOD Edls_7_Nm_bp0 "" LINEAR "%12.6" "Nm" COEFFS_LINEAR 1 0 /end COMPU_METHOD
/begin COMPU_METHOD Edls_8_NonDim_bp0 "" LINEAR "%3.0" "-" COEFFS_LINEAR 1 0 /end COMPU_METHOD
/begin COMPU_METHOD Edls_9_NonDim_bp0 "" LINEAR "%1.0" "-" COEFFS_LINEAR 1 0 /end COMPU_METHOD
/begin COMPU_METHOD Edsc_10_rpm_bp0 "" LINEAR "%10.0" "rpm" COEFFS_LINEAR 1 0 /end COMPU_METHOD
/begin COMPU_METHOD Edsc_11_rpm_s_bp0 "" LINEAR "%12.6" "rpm/s" COEFFS_LINEAR 1 0 /end COMPU_METHOD
/begin COMPU_METHOD Edsc_12_NonDim_bp0 "" LINEAR "%3.0" "-" COEFFS_LINEAR 1 0 /end COMPU_METHOD
/begin COMPU_METHOD Edsc_13_rad_bp0 "" LINEAR "%12.6" "rad" COEFFS_LINEAR 1 0 /end COMPU_METHOD
/begin COMPU_METHOD Edsc_14_NonDim_bp0 "" LINEAR "%12.6" "-" COEFFS_LINEAR 1 0 /end COMPU_METHOD
/begin COMPU_METHOD Edsc_15_rpm_bp0 "" LINEAR "%5.0" "rpm" COEFFS_LINEAR 1 0 /end COMPU_METHOD
/begin COMPU_METHOD Edsc_16_Nm_bp0 "" LINEAR "%12.6" "Nm" COEFFS_LINEAR 1 0 /end COMPU_METHOD
/begin COMPU_METHOD Edsc_17_rpm_bp0 "" LINEAR "%12.6" "rpm" COEFFS_LINEAR 1 0 /end COMPU_METHOD
/begin COMPU_METHOD Edsc_18_LocalEQ93927 "" TAB_VERB "%3.0" "" COMPU_TAB_REF Edsc_18_CONV_TAB_LocalEQ93927 /end COMPU_METHOD
/begin COMPU_METHOD Edsc_19_LocalEQ93926 "" TAB_VERB "%3.0" "" COMPU_TAB_REF Edsc_19_CONV_TAB_LocalEQ93926 /end COMPU_METHOD
/begin COMPU_METHOD Edsc_1_NonDim_bn10 "" LINEAR "%13.10" "-" COEFFS_LINEAR 0.0009765625 0 /end COMPU_METHOD
/begin COMPU_METHOD Edsc_20_NonDim_bp0 "" LINEAR "%1.0" "-" COEFFS_LINEAR 1 0 /end COMPU_METHOD
/begin COMPU_METHOD Edsc_21_NonDim_bn4 "" LINEAR "%9.4" "-" COEFFS_LINEAR 0.0625 0 /end COMPU_METHOD
/begin COMPU_METHOD Edsc_22_NonDim_bp0 "" LINEAR "%5.0" "-" COEFFS_LINEAR 1 0 /end COMPU_METHOD
/begin COMPU_METHOD Edsc_2_rpm_s_bp0 "" LINEAR "%5.0" "rpm/s" COEFFS_LINEAR 1 0 /end COMPU_METHOD
/begin COMPU_METHOD Edsc_3_NonDim_bn7 "" LINEAR "%11.7" "-" COEFFS_LINEAR 0.0078125 0 /end COMPU_METHOD
/begin COMPU_METHOD Edsc_4_grdC_bp0 "" LINEAR "%5.0" "°C" COEFFS_LINEAR 1 0 /end COMPU_METHOD
/begin COMPU_METHOD Edsc_5_min_bp0 "" LINEAR "%5.0" "min" COEFFS_LINEAR 1 0 /end COMPU_METHOD
/begin COMPU_METHOD Edsc_6_s_bp0 "" LINEAR "%12.6" "s" COEFFS_LINEAR 1 0 /end COMPU_METHOD
/begin COMPU_METHOD Edsc_7_deg_bp0 "" LINEAR "%12.6" "deg" COEFFS_LINEAR 1 0 /end COMPU_METHOD
/begin COMPU_METHOD Edsc_8_NonDim_bn3 "" LINEAR "%8.3" "-" COEFFS_LINEAR 0.125 0 /end COMPU_METHOD
/begin COMPU_METHOD Edsc_9_LocalEQ93931 "" TAB_VERB "%3.0" "" COMPU_TAB_REF Edsc_9_CONV_TAB_LocalEQ93931 /end COMPU_METHOD
/begin COMPU_METHOD Edsl_10_LocalEQ126262 "EDS_enum_SuppoCtrlStat_bp0" TAB_VERB "%3.0" "-" COMPU_TAB_REF Edsl_10_CONV_TAB_LocalEQ126262 /end COMPU_METHOD
/begin COMPU_METHOD Edsl_11_NonDim_bn12 "" LINEAR "%14.12" "-" COEFFS_LINEAR 0.000244140625 0 /end COMPU_METHOD
/begin COMPU_METHOD Edsl_12_ms_bp0 "" LINEAR "%5.0" "ms" COEFFS_LINEAR 1 0 /end COMPU_METHOD
/begin COMPU_METHOD Edsl_13_s_bp0 "" LINEAR "%5.0" "s" COEFFS_LINEAR 1 0 /end COMPU_METHOD
/begin COMPU_METHOD Edsl_14_NonDim_bp0 "" LINEAR "%5.0" "-" COEFFS_LINEAR 1 0 /end COMPU_METHOD
/begin COMPU_METHOD Edsl_15_EQ_LSB_1 "" LINEAR "%5.0" "" COEFFS_LINEAR 1 0 /end COMPU_METHOD
/begin COMPU_METHOD Edsl_16_Nm_bn1 "" LINEAR "%7.1" "Nm" COEFFS_LINEAR 0.5 0 /end COMPU_METHOD
/begin COMPU_METHOD Edsl_17_rpm_s_bp0 "" LINEAR "%12.6" "rpm/s" COEFFS_LINEAR 1 0 /end COMPU_METHOD
/begin COMPU_METHOD Edsl_18_rad_bp0 "" LINEAR "%12.6" "rad" COEFFS_LINEAR 1 0 /end COMPU_METHOD
/begin COMPU_METHOD Edsl_19_s_bp0 "" LINEAR "%12.6" "s" COEFFS_LINEAR 1 0 /end COMPU_METHOD
/begin COMPU_METHOD Edsl_1_NonDim_bn2 "" LINEAR "%7.2" "-" COEFFS_LINEAR 0.25 0 /end COMPU_METHOD
/begin COMPU_METHOD Edsl_20_Nm_bp0 "" LINEAR "%12.6" "Nm" COEFFS_LINEAR 1 0 /end COMPU_METHOD
/begin COMPU_METHOD Edsl_21_NonDim_bp0 "" LINEAR "%1.0" "-" COEFFS_LINEAR 1 0 /end COMPU_METHOD
/begin COMPU_METHOD Edsl_22_rpm_bp0 "" LINEAR "%12.6" "rpm" COEFFS_LINEAR 1 0 /end COMPU_METHOD
/begin COMPU_METHOD Edsl_23_NonDim_bp0 "" LINEAR "%12.6" "-" COEFFS_LINEAR 1 0 /end COMPU_METHOD
/begin COMPU_METHOD Edsl_2_NonDim_bn6 "" LINEAR "%10.6" "-" COEFFS_LINEAR 0.015625 0 /end COMPU_METHOD
/begin COMPU_METHOD Edsl_3_NonDim_bn1 "" LINEAR "%7.1" "-" COEFFS_LINEAR 0.5 0 /end COMPU_METHOD
/begin COMPU_METHOD Edsl_4_NonDim_bn13 "" LINEAR "%15.13" "-" COEFFS_LINEAR 0.0001220703125 0 /end COMPU_METHOD
/begin COMPU_METHOD Edsl_5_NonDim_bp0 "" LINEAR "%3.0" "-" COEFFS_LINEAR 1 0 /end COMPU_METHOD
/begin COMPU_METHOD Edsl_6_NonDim_bn10 "" LINEAR "%13.10" "-" COEFFS_LINEAR 0.0009765625 0 /end COMPU_METHOD
/begin COMPU_METHOD Edsl_7_NonDim_bn7 "" LINEAR "%11.7" "-" COEFFS_LINEAR 0.0078125 0 /end COMPU_METHOD
/begin COMPU_METHOD Edsl_8_Nm_bn2 "" LINEAR "%7.2" "Nm" COEFFS_LINEAR 0.25 0 /end COMPU_METHOD
/begin COMPU_METHOD Edsl_9_NonDim_bn4 "" LINEAR "%9.4" "-" COEFFS_LINEAR 0.0625 0 /end COMPU_METHOD
/begin COMPU_METHOD Edtm_1_Nm_bp0 "" LINEAR "%12.6" "Nm" COEFFS_LINEAR 1 0 /end COMPU_METHOD
/begin COMPU_METHOD Edtm_2_NonDim_bp0 "" LINEAR "%1.0" "-" COEFFS_LINEAR 1 0 /end COMPU_METHOD
/begin COMPU_METHOD EmCtrl.Asw_Ang_deg "" IDENTICAL "%12.6" "degree" /end COMPU_METHOD
/begin COMPU_METHOD EmCtrl.Asw_AngrVel_radps "" IDENTICAL "%12.6" "rad/s" /end COMPU_METHOD
/begin COMPU_METHOD EmCtrl.Asw_AvailyState "" TAB_VERB "%d" "" COMPU_TAB_REF EmCtrl.CONV_TAB_Asw_AvailyState /end COMPU_METHOD
/begin COMPU_METHOD EmCtrl.Asw_CurrRate_Aps "" IDENTICAL "%12.6" "A/s" /end COMPU_METHOD
/begin COMPU_METHOD EmCtrl.Asw_Curr_A "" IDENTICAL "%12.6" "A" /end COMPU_METHOD
/begin COMPU_METHOD EmCtrl.Asw_Curr_Apeak "" IDENTICAL "%12.6" "Apeak" /end COMPU_METHOD
/begin COMPU_METHOD EmCtrl.Asw_Curr_Arms "" IDENTICAL "%12.6" "Arms" /end COMPU_METHOD
/begin COMPU_METHOD EmCtrl.Asw_Flux_Wb "" IDENTICAL "%12.6" "Wb" /end COMPU_METHOD
/begin COMPU_METHOD EmCtrl.Asw_Frq_Hz "" IDENTICAL "%12.6" "Hz" /end COMPU_METHOD
/begin COMPU_METHOD EmCtrl.Asw_Ind_H "" IDENTICAL "%3.10" "H" /end COMPU_METHOD
/begin COMPU_METHOD EmCtrl.Asw_Perc "" IDENTICAL "%12.6" "%" /end COMPU_METHOD
/begin COMPU_METHOD EmCtrl.Asw_Rate_ps "" IDENTICAL "%12.6" "1/s" /end COMPU_METHOD
/begin COMPU_METHOD EmCtrl.Asw_Ratio "" IDENTICAL "%12.6" "ratio" /end COMPU_METHOD
/begin COMPU_METHOD EmCtrl.Asw_Rstc_Ohm "" IDENTICAL "%12.6" "Ohm" /end COMPU_METHOD
/begin COMPU_METHOD EmCtrl.Asw_SigQly "" TAB_VERB "%s" "" COMPU_TAB_REF EmCtrl.CONV_TAB_Asw_SigQly /end COMPU_METHOD
/begin COMPU_METHOD EmCtrl.Asw_SpdRate_rpmps "" IDENTICAL "%12.6" "rpm/s" /end COMPU_METHOD
/begin COMPU_METHOD EmCtrl.Asw_Spd_rpm "" IDENTICAL "%12.6" "rpm" /end COMPU_METHOD
/begin COMPU_METHOD EmCtrl.Asw_Temp_degC "" IDENTICAL "%6.1" "degC" /end COMPU_METHOD
/begin COMPU_METHOD EmCtrl.Asw_Time_s "" IDENTICAL "%12.6" "s" /end COMPU_METHOD
/begin COMPU_METHOD EmCtrl.Asw_Time_us "" IDENTICAL "%12.6" "us" /end COMPU_METHOD
/begin COMPU_METHOD EmCtrl.Asw_TrqRate_Nmps "" IDENTICAL "%12.6" "Nm/s" /end COMPU_METHOD
/begin COMPU_METHOD EmCtrl.Asw_Trq_Nm "" IDENTICAL "%12.6" "Nm" /end COMPU_METHOD
/begin COMPU_METHOD EmCtrl.Asw_Volt_V "" IDENTICAL "%12.6" "V" /end COMPU_METHOD
/begin COMPU_METHOD EmCtrl.Asw_Volt_Vpeak "" IDENTICAL "%12.6" "Vpeak" /end COMPU_METHOD
/begin COMPU_METHOD EmCtrl.EQ_LSB_1 "" LINEAR "%12.6" "-" COEFFS_LINEAR 1 0 /end COMPU_METHOD
/begin COMPU_METHOD EmCtrl.EmCtrl_CurrSpCalcnMode "" TAB_VERB "%3.0" "" COMPU_TAB_REF EmCtrl.CONV_TAB_EmCtrl_CurrSpCalcnMode /end COMPU_METHOD
/begin COMPU_METHOD EmCtrl.EmCtrl_MdltnType "" TAB_VERB "%3.0" "" COMPU_TAB_REF EmCtrl.CONV_TAB_EmCtrl_MdltnType /end COMPU_METHOD
/begin COMPU_METHOD EmCtrl.EmCtrl_ModfdSvmType "" TAB_VERB "%3.0" "" COMPU_TAB_REF EmCtrl.CONV_TAB_EmCtrl_ModfdSvmType /end COMPU_METHOD
/begin COMPU_METHOD EmCtrl.EmCtrl_NoiseShapingMode "" TAB_VERB "%3.0" "" COMPU_TAB_REF EmCtrl.CONV_TAB_EmCtrl_NoiseShapingMode /end COMPU_METHOD
/begin COMPU_METHOD EmCtrl.EmCtrl_NoiseShapingNewMode "" TAB_VERB "%3.0" "" COMPU_TAB_REF EmCtrl.CONV_TAB_EmCtrl_NoiseShapingNewMode /end COMPU_METHOD
/begin COMPU_METHOD EmCtrl.EmCtrl_TrqCtrlFbMode "" TAB_VERB "%3.0" "" COMPU_TAB_REF EmCtrl.CONV_TAB_EmCtrl_TrqCtrlFbMode /end COMPU_METHOD
/begin COMPU_METHOD EmCtrl.EmCtrl_Version "" LINEAR "%06d" "" COEFFS_LINEAR 1 0 /end COMPU_METHOD
/begin COMPU_METHOD EmCtrl.Em_CtrlModeExtd "" TAB_VERB "%d" "" COMPU_TAB_REF EmCtrl.CONV_TAB_Em_CtrlModeExtd /end COMPU_METHOD
/begin COMPU_METHOD EmCtrl.IDENTICAL_SCALING_FLOAT "" IDENTICAL "%12.6" "" /end COMPU_METHOD
/begin COMPU_METHOD EmCtrl.LibTlHwIo_PwrStgOpnMode "" TAB_VERB "%d" "" COMPU_TAB_REF EmCtrl.CONV_TAB_LibTlHwIo_PwrStgOpnMode /end COMPU_METHOD
/begin COMPU_METHOD EmCtrl.T_EmCtrl_PwmFrqMdfnMode "" TAB_VERB "%3.0" "" COMPU_TAB_REF EmCtrl.CONV_TAB_T_EmCtrl_PwmFrqMdfnMode /end COMPU_METHOD
/begin COMPU_METHOD EmCtrl.T_EmCtrl_PwmOpnMode "" TAB_VERB "%3.0" "" COMPU_TAB_REF EmCtrl.CONV_TAB_T_EmCtrl_PwmOpnMode /end COMPU_METHOD
/begin COMPU_METHOD EmInvEstn.Asw_AngrAcc_radps2 "" IDENTICAL "%12.6" "rad/s^2" /end COMPU_METHOD
/begin COMPU_METHOD EmInvEstn.Asw_AngrVel_radps "" IDENTICAL "%12.6" "rad/s" /end COMPU_METHOD
/begin COMPU_METHOD EmInvEstn.Asw_Curr_A "" IDENTICAL "%12.6" "A" /end COMPU_METHOD
/begin COMPU_METHOD EmInvEstn.Asw_Curr_Apeak "" IDENTICAL "%12.6" "Apeak" /end COMPU_METHOD
/begin COMPU_METHOD EmInvEstn.Asw_Curr_Arms "" IDENTICAL "%12.6" "Arms" /end COMPU_METHOD
/begin COMPU_METHOD EmInvEstn.Asw_Frq_Hz "" IDENTICAL "%12.6" "Hz" /end COMPU_METHOD
/begin COMPU_METHOD EmInvEstn.Asw_Perc "" IDENTICAL "%12.6" "%" /end COMPU_METHOD
/begin COMPU_METHOD EmInvEstn.Asw_Pwr_W "" IDENTICAL "%12.6" "W" /end COMPU_METHOD
/begin COMPU_METHOD EmInvEstn.Asw_Rstc_Ohm "" IDENTICAL "%12.6" "Ohm" /end COMPU_METHOD
/begin COMPU_METHOD EmInvEstn.Asw_SigQly "" TAB_VERB "%s" "" COMPU_TAB_REF EmInvEstn.CONV_TAB_Asw_SigQly /end COMPU_METHOD
/begin COMPU_METHOD EmInvEstn.Asw_Spd_rpm "" IDENTICAL "%12.6" "rpm" /end COMPU_METHOD
/begin COMPU_METHOD EmInvEstn.Asw_Temp_degC "" IDENTICAL "%6.1" "degC" /end COMPU_METHOD
/begin COMPU_METHOD EmInvEstn.Asw_Time_s "" IDENTICAL "%12.6" "s" /end COMPU_METHOD
/begin COMPU_METHOD EmInvEstn.Asw_Trq_Nm "" IDENTICAL "%12.6" "Nm" /end COMPU_METHOD
/begin COMPU_METHOD EmInvEstn.Asw_Volt_V "" IDENTICAL "%12.6" "V" /end COMPU_METHOD
/begin COMPU_METHOD EmInvEstn.Asw_Volt_Vpeak "" IDENTICAL "%12.6" "Vpeak" /end COMPU_METHOD
/begin COMPU_METHOD EmInvEstn.Asw_Volt_Vrms "" IDENTICAL "%12.6" "Vrms" /end COMPU_METHOD
/begin COMPU_METHOD EmInvEstn.EmInvEstn_DcCurrSeld "" TAB_VERB "%3.0" "" COMPU_TAB_REF EmInvEstn.CONV_TAB_EmInvEstn_DcCurrSeld /end COMPU_METHOD
/begin COMPU_METHOD EmInvEstn.EmInvEstn_ElecAngrVelSeln "" TAB_VERB "%3.0" "" COMPU_TAB_REF EmInvEstn.CONV_TAB_EmInvEstn_ElecAngrVelSeln /end COMPU_METHOD
/begin COMPU_METHOD EmInvEstn.EmInvEstn_MvOrHvCalcnMode "" TAB_VERB "%3.0" "" COMPU_TAB_REF EmInvEstn.CONV_TAB_EmInvEstn_MvOrHvCalcnMode /end COMPU_METHOD
/begin COMPU_METHOD EmInvEstn.Em_MdltnType "" TAB_VERB "%3.0" "" COMPU_TAB_REF EmInvEstn.CONV_TAB_Em_MdltnType /end COMPU_METHOD
/begin COMPU_METHOD EmInvEstn.IDENTICAL_SCALING_FLOAT "" IDENTICAL "%12.6" "" /end COMPU_METHOD
/begin COMPU_METHOD EmInvEstn.LibTlHwIo_PwrStgOpnMode "" TAB_VERB "%d" "" COMPU_TAB_REF EmInvEstn.CONV_TAB_LibTlHwIo_PwrStgOpnMode /end COMPU_METHOD
/begin COMPU_METHOD EmInvTemp.Asw_AngrVel_radps "" IDENTICAL "%12.6" "rad/s" /end COMPU_METHOD
/begin COMPU_METHOD EmInvTemp.Asw_Curr_A "" IDENTICAL "%12.6" "A" /end COMPU_METHOD
/begin COMPU_METHOD EmInvTemp.Asw_Curr_Apeak "" IDENTICAL "%12.6" "Apeak" /end COMPU_METHOD
/begin COMPU_METHOD EmInvTemp.Asw_Curr_Arms "" IDENTICAL "%12.6" "Arms" /end COMPU_METHOD
/begin COMPU_METHOD EmInvTemp.Asw_Enrg_J "" IDENTICAL "%12.6" "J" /end COMPU_METHOD
/begin COMPU_METHOD EmInvTemp.Asw_Frq_Hz "" IDENTICAL "%12.6" "Hz" /end COMPU_METHOD
/begin COMPU_METHOD EmInvTemp.Asw_Pwr_W "" IDENTICAL "%12.6" "W" /end COMPU_METHOD
/begin COMPU_METHOD EmInvTemp.Asw_Rstc_Ohm "" IDENTICAL "%12.6" "Ohm" /end COMPU_METHOD
/begin COMPU_METHOD EmInvTemp.Asw_SigQly "" TAB_VERB "%s" "" COMPU_TAB_REF EmInvTemp.CONV_TAB_Asw_SigQly /end COMPU_METHOD
/begin COMPU_METHOD EmInvTemp.Asw_Spd_rpm "" IDENTICAL "%12.6" "rpm" /end COMPU_METHOD
/begin COMPU_METHOD EmInvTemp.Asw_Temp_degC "" IDENTICAL "%6.1" "degC" /end COMPU_METHOD
/begin COMPU_METHOD EmInvTemp.Asw_Time_s "" IDENTICAL "%12.6" "s" /end COMPU_METHOD
/begin COMPU_METHOD EmInvTemp.Asw_Trq_Nm "" IDENTICAL "%12.6" "Nm" /end COMPU_METHOD
/begin COMPU_METHOD EmInvTemp.Asw_Vof_lpmin "" IDENTICAL "%12.6" "lpm" /end COMPU_METHOD
/begin COMPU_METHOD EmInvTemp.Asw_Volt_V "" IDENTICAL "%12.6" "V" /end COMPU_METHOD
/begin COMPU_METHOD EmInvTemp.Asw_Volt_Vpeak "" IDENTICAL "%12.6" "Vpeak" /end COMPU_METHOD
/begin COMPU_METHOD EmInvTemp.EmInvTemp_CltInltTempEstnMode "" TAB_VERB "%3.0" "" COMPU_TAB_REF EmInvTemp.CONV_TAB_EmInvTemp_CltInltTempEstnMode /end COMPU_METHOD
/begin COMPU_METHOD EmInvTemp.EmInvTemp_CltTempBasedHvSeln "" TAB_VERB "%3.0" "" COMPU_TAB_REF EmInvTemp.CONV_TAB_EmInvTemp_CltTempBasedHvSeln /end COMPU_METHOD
/begin COMPU_METHOD EmInvTemp.EmInvTemp_CltVofSrc "" TAB_VERB "%3.0" "" COMPU_TAB_REF EmInvTemp.CONV_TAB_EmInvTemp_CltVofSrc /end COMPU_METHOD
/begin COMPU_METHOD EmInvTemp.EmInvTemp_McuTempSeln "" TAB_VERB "%3.0" "" COMPU_TAB_REF EmInvTemp.CONV_TAB_EmInvTemp_McuTempSeln /end COMPU_METHOD
/begin COMPU_METHOD EmInvTemp.EmInvTemp_MdlTempBasedHvSeln "" TAB_VERB "%3.0" "" COMPU_TAB_REF EmInvTemp.CONV_TAB_EmInvTemp_MdlTempBasedHvSeln /end COMPU_METHOD
/begin COMPU_METHOD EmInvTemp.EmInvTemp_PwrModuleHvSeln "" TAB_VERB "%3.0" "" COMPU_TAB_REF EmInvTemp.CONV_TAB_EmInvTemp_PwrModuleHvSeln /end COMPU_METHOD
/begin COMPU_METHOD EmInvTemp.EmInvTemp_PwrSwtTempOrderSelnHigh "" TAB_VERB "%3.0" "" COMPU_TAB_REF EmInvTemp.CONV_TAB_EmInvTemp_PwrSwtTempOrderSelnHigh /end COMPU_METHOD
/begin COMPU_METHOD EmInvTemp.EmInvTemp_PwrSwtTempOrderSelnLow "" TAB_VERB "%3.0" "" COMPU_TAB_REF EmInvTemp.CONV_TAB_EmInvTemp_PwrSwtTempOrderSelnLow /end COMPU_METHOD
/begin COMPU_METHOD EmInvTemp.EmInvTemp_PwrSwtTempOrderSelnMid "" TAB_VERB "%3.0" "" COMPU_TAB_REF EmInvTemp.CONV_TAB_EmInvTemp_PwrSwtTempOrderSelnMid /end COMPU_METHOD
/begin COMPU_METHOD EmInvTemp.EmInvTemp_PwrSwtTempPhaseSeln "" TAB_VERB "%3.0" "" COMPU_TAB_REF EmInvTemp.CONV_TAB_EmInvTemp_PwrSwtTempPhaseSeln /end COMPU_METHOD
/begin COMPU_METHOD EmInvTemp.EmInvTemp_PwrSwtTempSeln "" TAB_VERB "%3.0" "" COMPU_TAB_REF EmInvTemp.CONV_TAB_EmInvTemp_PwrSwtTempSeln /end COMPU_METHOD
/begin COMPU_METHOD EmInvTemp.EmInvTemp_PwrSwtTempSensSeln "" TAB_VERB "%3.0" "" COMPU_TAB_REF EmInvTemp.CONV_TAB_EmInvTemp_PwrSwtTempSensSeln /end COMPU_METHOD
/begin COMPU_METHOD EmInvTemp.Em_CtrlModeExtd "" TAB_VERB "%d" "" COMPU_TAB_REF EmInvTemp.CONV_TAB_Em_CtrlModeExtd /end COMPU_METHOD
/begin COMPU_METHOD EmInvTemp.Em_CtrlReqSrc "" TAB_VERB "%d" "" COMPU_TAB_REF EmInvTemp.CONV_TAB_Em_CtrlReqSrc /end COMPU_METHOD
/begin COMPU_METHOD EmInvTemp.Em_Dens_kgpm3 "" IDENTICAL "%12.6" "kg/m^3" /end COMPU_METHOD
/begin COMPU_METHOD EmInvTemp.Em_DenspK_kgpKm3 "" IDENTICAL "%12.6" "kg/m^3/K" /end COMPU_METHOD
/begin COMPU_METHOD EmInvTemp.Em_ThrmlCapInvs_KpJ "" IDENTICAL "%12.6" "K/J" /end COMPU_METHOD
/begin COMPU_METHOD EmInvTemp.Em_ThrmlCap_JpK "" IDENTICAL "%12.6" "J/K" /end COMPU_METHOD
/begin COMPU_METHOD EmInvTemp.IDENTICAL_SCALING_FLOAT "" IDENTICAL "%12.6" "" /end COMPU_METHOD
/begin COMPU_METHOD EmInvTemp.LibTlSrvc_TempFxp "" LINEAR "%9.4" "degC" COEFFS_LINEAR 0.0625 0 /end COMPU_METHOD
/begin COMPU_METHOD EmLimn.Asw_AngrVel_radps "" IDENTICAL "%12.6" "rad/s" /end COMPU_METHOD
/begin COMPU_METHOD EmLimn.Asw_Curr_A "" IDENTICAL "%12.6" "A" /end COMPU_METHOD
/begin COMPU_METHOD EmLimn.Asw_Curr_Apeak "" IDENTICAL "%12.6" "Apeak" /end COMPU_METHOD
/begin COMPU_METHOD EmLimn.Asw_Curr_Arms "" IDENTICAL "%12.6" "Arms" /end COMPU_METHOD
/begin COMPU_METHOD EmLimn.Asw_Frq_Hz "" IDENTICAL "%12.6" "Hz" /end COMPU_METHOD
/begin COMPU_METHOD EmLimn.Asw_Perc "" IDENTICAL "%12.6" "%" /end COMPU_METHOD
/begin COMPU_METHOD EmLimn.Asw_Pwr_W "" IDENTICAL "%12.6" "W" /end COMPU_METHOD
/begin COMPU_METHOD EmLimn.Asw_Rstc_Ohm "" IDENTICAL "%12.6" "Ohm" /end COMPU_METHOD
/begin COMPU_METHOD EmLimn.Asw_SigQly "" TAB_VERB "%s" "" COMPU_TAB_REF EmLimn.CONV_TAB_Asw_SigQly /end COMPU_METHOD
/begin COMPU_METHOD EmLimn.Asw_Spd_rpm "" IDENTICAL "%12.6" "rpm" /end COMPU_METHOD
/begin COMPU_METHOD EmLimn.Asw_Temp_degC "" IDENTICAL "%6.1" "degC" /end COMPU_METHOD
/begin COMPU_METHOD EmLimn.Asw_Time_s "" IDENTICAL "%12.6" "s" /end COMPU_METHOD
/begin COMPU_METHOD EmLimn.Asw_Trq_Nm "" IDENTICAL "%12.6" "Nm" /end COMPU_METHOD
/begin COMPU_METHOD EmLimn.Asw_Vof_lpmin "" IDENTICAL "%12.6" "lpm" /end COMPU_METHOD
/begin COMPU_METHOD EmLimn.Asw_Volt_V "" IDENTICAL "%12.6" "V" /end COMPU_METHOD
/begin COMPU_METHOD EmLimn.Edp_TrqLimRsn "" TAB_VERB "%d" "" COMPU_TAB_REF EmLimn.CONV_TAB_Edp_TrqLimRsn /end COMPU_METHOD
/begin COMPU_METHOD EmLimn.EmLimn_CltVofReqStressSeln "" TAB_VERB "%d" "" COMPU_TAB_REF EmLimn.CONV_TAB_EmLimn_CltVofReqStressSeln /end COMPU_METHOD
/begin COMPU_METHOD EmLimn.EmLimn_CpprPwrLossSeln "" TAB_VERB "%d" "" COMPU_TAB_REF EmLimn.CONV_TAB_EmLimn_CpprPwrLossSeln /end COMPU_METHOD
/begin COMPU_METHOD EmLimn.EmLimn_CrsFaderSeln "" LINEAR "%3.0" "" COEFFS_LINEAR 1 0 /end COMPU_METHOD
/begin COMPU_METHOD EmLimn.EmLimn_DcPwrExtrnlIntrnlLimSeln "" TAB_VERB "%d" "" COMPU_TAB_REF EmLimn.CONV_TAB_EmLimn_DcPwrExtrnlIntrnlLimSeln /end COMPU_METHOD
/begin COMPU_METHOD EmLimn.EmLimn_DcVoltExtrnlIntrnlLimSeln "" TAB_VERB "%d" "" COMPU_TAB_REF EmLimn.CONV_TAB_EmLimn_DcVoltExtrnlIntrnlLimSeln /end COMPU_METHOD
/begin COMPU_METHOD EmLimn.EmLimn_DcVoltLimSeln "" TAB_VERB "%d" "" COMPU_TAB_REF EmLimn.CONV_TAB_EmLimn_DcVoltLimSeln /end COMPU_METHOD
/begin COMPU_METHOD EmLimn.EmLimn_InvPwrLossSeln "" TAB_VERB "%d" "" COMPU_TAB_REF EmLimn.CONV_TAB_EmLimn_InvPwrLossSeln /end COMPU_METHOD
/begin COMPU_METHOD EmLimn.EmLimn_TrqLossSeln "" TAB_VERB "%d" "" COMPU_TAB_REF EmLimn.CONV_TAB_EmLimn_TrqLossSeln /end COMPU_METHOD
/begin COMPU_METHOD EmLimn.IDENTICAL_SCALING_FLOAT "" IDENTICAL "%12.6" "" /end COMPU_METHOD
/begin COMPU_METHOD EmLimn.LibTlSrvc_DiagEventBf "" TAB_VERB "%3.0" "" COMPU_TAB_REF EmLimn.CONV_TAB_LibTlSrvc_DiagEventBf /end COMPU_METHOD
/begin COMPU_METHOD EmLimn.LibTlSrvc_TempFxp "" LINEAR "%9.4" "degC" COEFFS_LINEAR 0.0625 0 /end COMPU_METHOD
/begin COMPU_METHOD EmMotEstn.Asw_Ang_deg "" IDENTICAL "%12.6" "degree" /end COMPU_METHOD
/begin COMPU_METHOD EmMotEstn.Asw_AngrVel_radps "" IDENTICAL "%12.6" "rad/s" /end COMPU_METHOD
/begin COMPU_METHOD EmMotEstn.Asw_Curr_A "" IDENTICAL "%12.6" "A" /end COMPU_METHOD
/begin COMPU_METHOD EmMotEstn.Asw_Curr_Apeak "" IDENTICAL "%12.6" "Apeak" /end COMPU_METHOD
/begin COMPU_METHOD EmMotEstn.Asw_Curr_Arms "" IDENTICAL "%12.6" "Arms" /end COMPU_METHOD
/begin COMPU_METHOD EmMotEstn.Asw_Flux_Wb "" IDENTICAL "%12.6" "Wb" /end COMPU_METHOD
/begin COMPU_METHOD EmMotEstn.Asw_Frq_Hz "" IDENTICAL "%12.6" "Hz" /end COMPU_METHOD
/begin COMPU_METHOD EmMotEstn.Asw_Ind_H "" IDENTICAL "%3.10" "H" /end COMPU_METHOD
/begin COMPU_METHOD EmMotEstn.Asw_Perc "" IDENTICAL "%12.6" "%" /end COMPU_METHOD
/begin COMPU_METHOD EmMotEstn.Asw_Pwr_W "" IDENTICAL "%12.6" "W" /end COMPU_METHOD
/begin COMPU_METHOD EmMotEstn.Asw_Rstc_Ohm "" IDENTICAL "%12.6" "Ohm" /end COMPU_METHOD
/begin COMPU_METHOD EmMotEstn.Asw_SigQly "" TAB_VERB "%s" "" COMPU_TAB_REF EmMotEstn.CONV_TAB_Asw_SigQly /end COMPU_METHOD
/begin COMPU_METHOD EmMotEstn.Asw_Spd_rpm "" IDENTICAL "%12.6" "rpm" /end COMPU_METHOD
/begin COMPU_METHOD EmMotEstn.Asw_Temp_degC "" IDENTICAL "%6.1" "degC" /end COMPU_METHOD
/begin COMPU_METHOD EmMotEstn.Asw_Trq_Nm "" IDENTICAL "%12.6" "Nm" /end COMPU_METHOD
/begin COMPU_METHOD EmMotEstn.Asw_Volt_V "" IDENTICAL "%12.6" "V" /end COMPU_METHOD
/begin COMPU_METHOD EmMotEstn.Asw_Volt_Vpeak "" IDENTICAL "%12.6" "Vpeak" /end COMPU_METHOD
/begin COMPU_METHOD EmMotEstn.EmMotEstn_InnrTrqCalcnMode "" TAB_VERB "%3.0" "" COMPU_TAB_REF EmMotEstn.CONV_TAB_EmMotEstn_InnrTrqCalcnMode /end COMPU_METHOD
/begin COMPU_METHOD EmMotEstn.EmMotEstn_VoltCpbCalcnMode "" TAB_VERB "%3.0" "" COMPU_TAB_REF EmMotEstn.CONV_TAB_EmMotEstn_VoltCpbCalcnMode /end COMPU_METHOD
/begin COMPU_METHOD EmMotEstn.EmMotEstn_WndgTempCalcnMode "" TAB_VERB "%3.0" "" COMPU_TAB_REF EmMotEstn.CONV_TAB_EmMotEstn_WndgTempCalcnMode /end COMPU_METHOD
/begin COMPU_METHOD EmMotEstn.IDENTICAL_SCALING_FLOAT "" IDENTICAL "%12.6" "" /end COMPU_METHOD
/begin COMPU_METHOD EmMotTemp.Asw_Curr_A "" IDENTICAL "%12.6" "A" /end COMPU_METHOD
/begin COMPU_METHOD EmMotTemp.Asw_Frq_Hz "" IDENTICAL "%12.6" "Hz" /end COMPU_METHOD
/begin COMPU_METHOD EmMotTemp.Asw_Len_mm "" IDENTICAL "%12.6" "mm" /end COMPU_METHOD
/begin COMPU_METHOD EmMotTemp.Asw_Mass_kg "" IDENTICAL "%12.6" "kg" /end COMPU_METHOD
/begin COMPU_METHOD EmMotTemp.Asw_Pwr_W "" IDENTICAL "%12.6" "W" /end COMPU_METHOD
/begin COMPU_METHOD EmMotTemp.Asw_SigQly "" TAB_VERB "%s" "" COMPU_TAB_REF EmMotTemp.CONV_TAB_Asw_SigQly /end COMPU_METHOD
/begin COMPU_METHOD EmMotTemp.Asw_Spd_rpm "" IDENTICAL "%12.6" "rpm" /end COMPU_METHOD
/begin COMPU_METHOD EmMotTemp.Asw_Temp_degC "" IDENTICAL "%6.1" "degC" /end COMPU_METHOD
/begin COMPU_METHOD EmMotTemp.Asw_Time_s "" IDENTICAL "%12.6" "s" /end COMPU_METHOD
/begin COMPU_METHOD EmMotTemp.Asw_Trq_Nm "" IDENTICAL "%12.6" "Nm" /end COMPU_METHOD
/begin COMPU_METHOD EmMotTemp.Asw_Vof_lpmin "" IDENTICAL "%12.6" "lpm" /end COMPU_METHOD
/begin COMPU_METHOD EmMotTemp.Asw_Volt_V "" IDENTICAL "%12.6" "V" /end COMPU_METHOD
/begin COMPU_METHOD EmMotTemp.EmMotTemp_CltInpTempSrc "" TAB_VERB "%3.0" "" COMPU_TAB_REF EmMotTemp.CONV_TAB_EmMotTemp_CltInpTempSrc /end COMPU_METHOD
/begin COMPU_METHOD EmMotTemp.EmMotTemp_CltTempMode "" TAB_VERB "%3.0" "" COMPU_TAB_REF EmMotTemp.CONV_TAB_EmMotTemp_CltTempMode /end COMPU_METHOD
/begin COMPU_METHOD EmMotTemp.EmMotTemp_CltVofCfg "" TAB_VERB "%3.0" "" COMPU_TAB_REF EmMotTemp.CONV_TAB_EmMotTemp_CltVofCfg /end COMPU_METHOD
/begin COMPU_METHOD EmMotTemp.EmMotTemp_CltVofSrc "" TAB_VERB "%3.0" "" COMPU_TAB_REF EmMotTemp.CONV_TAB_EmMotTemp_CltVofSrc /end COMPU_METHOD
/begin COMPU_METHOD EmMotTemp.EmMotTemp_Dens_kgpm3 "" IDENTICAL "%12.6" "kg/m^3" /end COMPU_METHOD
/begin COMPU_METHOD EmMotTemp.EmMotTemp_DenspK_kgpKm3 "" IDENTICAL "%12.6" "kg/m^3/K" /end COMPU_METHOD
/begin COMPU_METHOD EmMotTemp.EmMotTemp_HeatExchgrMdlSeln "" TAB_VERB "%3.0" "" COMPU_TAB_REF EmMotTemp.CONV_TAB_EmMotTemp_HeatExchgrMdlSeln /end COMPU_METHOD
/begin COMPU_METHOD EmMotTemp.EmMotTemp_StatorTempOutMode "" TAB_VERB "%3.0" "" COMPU_TAB_REF EmMotTemp.CONV_TAB_EmMotTemp_StatorTempOutMode /end COMPU_METHOD
/begin COMPU_METHOD EmMotTemp.EmMotTemp_TempInvs_pK "" IDENTICAL "%12.6" "1/K" /end COMPU_METHOD
/begin COMPU_METHOD EmMotTemp.EmMotTemp_Temp_degC "" IDENTICAL "%6.1" "degC" /end COMPU_METHOD
/begin COMPU_METHOD EmMotTemp.EmMotTemp_ThrmlCapInvs_KpJ "" IDENTICAL "%12.6" "K/J" /end COMPU_METHOD
/begin COMPU_METHOD EmMotTemp.EmMotTemp_ThrmlCap_JpK "" IDENTICAL "%12.6" "J/K" /end COMPU_METHOD
/begin COMPU_METHOD EmMotTemp.EmMotTemp_ThrmlCappK_JpK2 "" IDENTICAL "%12.6" "J/K^2" /end COMPU_METHOD
/begin COMPU_METHOD EmMotTemp.EmMotTemp_ThrmlCndctc_WpK "" IDENTICAL "%12.6" "W/K" /end COMPU_METHOD
/begin COMPU_METHOD EmMotTemp.EmMotTemp_ThrmlRstc_KpW "" IDENTICAL "%12.6" "K/W" /end COMPU_METHOD
/begin COMPU_METHOD EmMotTemp.EmMotTemp_VofpSpeed_lpr "liter per rounds" IDENTICAL "%12.6" "lpr" /end COMPU_METHOD
/begin COMPU_METHOD EmMotTemp.EmMotTemp_WhlSpdSeln "" TAB_VERB "%3.0" "" COMPU_TAB_REF EmMotTemp.CONV_TAB_EmMotTemp_WhlSpdSeln /end COMPU_METHOD
/begin COMPU_METHOD EmMotTemp.Em_Dens_kgpm3 "" IDENTICAL "%12.6" "kg/m^3" /end COMPU_METHOD
/begin COMPU_METHOD EmMotTemp.Em_DenspK_kgpKm3 "" IDENTICAL "%12.6" "kg/m^3/K" /end COMPU_METHOD
/begin COMPU_METHOD EmMotTemp.Em_ThrmlCapInvs_KpJ "" IDENTICAL "%12.6" "K/J" /end COMPU_METHOD
/begin COMPU_METHOD EmMotTemp.Em_ThrmlCap_JpK "" IDENTICAL "%12.6" "J/K" /end COMPU_METHOD
/begin COMPU_METHOD EmMotTemp.IDENTICAL_SCALING_FLOAT "" IDENTICAL "%12.6" "" /end COMPU_METHOD
/begin COMPU_METHOD EmPjSpecfc1.IDENTICAL_SCALING_FLOAT "" IDENTICAL "%12.6" "" /end COMPU_METHOD
/begin COMPU_METHOD EmProtn.Asw_AngrVel_radps "" IDENTICAL "%12.6" "rad/s" /end COMPU_METHOD
/begin COMPU_METHOD EmProtn.Asw_Curr_A "" IDENTICAL "%12.6" "A" /end COMPU_METHOD
/begin COMPU_METHOD EmProtn.Asw_Curr_Apeak "" IDENTICAL "%12.6" "Apeak" /end COMPU_METHOD
/begin COMPU_METHOD EmProtn.Asw_Curr_Arms "" IDENTICAL "%12.6" "Arms" /end COMPU_METHOD
/begin COMPU_METHOD EmProtn.Asw_Flux_Wb "" IDENTICAL "%12.6" "Wb" /end COMPU_METHOD
/begin COMPU_METHOD EmProtn.Asw_Perc "" IDENTICAL "%12.6" "%" /end COMPU_METHOD
/begin COMPU_METHOD EmProtn.Asw_SigQly "" TAB_VERB "%s" "" COMPU_TAB_REF EmProtn.CONV_TAB_Asw_SigQly /end COMPU_METHOD
/begin COMPU_METHOD EmProtn.Asw_Spd_rpm "" IDENTICAL "%12.6" "rpm" /end COMPU_METHOD
/begin COMPU_METHOD EmProtn.Asw_Temp_degC "" IDENTICAL "%6.1" "degC" /end COMPU_METHOD
/begin COMPU_METHOD EmProtn.Asw_Time_s "" IDENTICAL "%12.6" "s" /end COMPU_METHOD
/begin COMPU_METHOD EmProtn.Asw_Vof_lpmin "" IDENTICAL "%12.6" "lpm" /end COMPU_METHOD
/begin COMPU_METHOD EmProtn.Asw_Volt_V "" IDENTICAL "%12.6" "V" /end COMPU_METHOD
/begin COMPU_METHOD EmProtn.Edp_cmdBckFcn1 "" TAB_VERB "%s" "" COMPU_TAB_REF EmProtn.CONV_TAB_Edp_cmdBckFcn1 /end COMPU_METHOD
/begin COMPU_METHOD EmProtn.IDENTICAL_SCALING_FLOAT "" IDENTICAL "%12.6" "" /end COMPU_METHOD
/begin COMPU_METHOD EmSm.Asw_Ang_deg "" IDENTICAL "%12.6" "degree" /end COMPU_METHOD
/begin COMPU_METHOD EmSm.Asw_AngrVel_radps "" IDENTICAL "%12.6" "rad/s" /end COMPU_METHOD
/begin COMPU_METHOD EmSm.Asw_AvailyState "" TAB_VERB "%d" "" COMPU_TAB_REF EmSm.CONV_TAB_Asw_AvailyState /end COMPU_METHOD
/begin COMPU_METHOD EmSm.Asw_Curr_A "" IDENTICAL "%12.6" "A" /end COMPU_METHOD
/begin COMPU_METHOD EmSm.Asw_Curr_Apeak "" IDENTICAL "%12.6" "Apeak" /end COMPU_METHOD
/begin COMPU_METHOD EmSm.Asw_Frq_Hz "" IDENTICAL "%12.6" "Hz" /end COMPU_METHOD
/begin COMPU_METHOD EmSm.Asw_RunState "" TAB_VERB "%d" "" COMPU_TAB_REF EmSm.CONV_TAB_Asw_RunState /end COMPU_METHOD
/begin COMPU_METHOD EmSm.Asw_SigQly "" TAB_VERB "%s" "" COMPU_TAB_REF EmSm.CONV_TAB_Asw_SigQly /end COMPU_METHOD
/begin COMPU_METHOD EmSm.Asw_Spd_rpm "" IDENTICAL "%12.6" "rpm" /end COMPU_METHOD
/begin COMPU_METHOD EmSm.Asw_Temp_degC "" IDENTICAL "%6.1" "degC" /end COMPU_METHOD
/begin COMPU_METHOD EmSm.Asw_Time_s "" IDENTICAL "%12.6" "s" /end COMPU_METHOD
/begin COMPU_METHOD EmSm.Asw_TrqRate_Nmps "" IDENTICAL "%12.6" "Nm/s" /end COMPU_METHOD
/begin COMPU_METHOD EmSm.Asw_Trq_Nm "" IDENTICAL "%12.6" "Nm" /end COMPU_METHOD
/begin COMPU_METHOD EmSm.Asw_Volt_Vpeak "" IDENTICAL "%12.6" "Vpeak" /end COMPU_METHOD
/begin COMPU_METHOD EmSm.Edp_EmPwrStgIoCtrlMode "" TAB_VERB "%s" "" COMPU_TAB_REF EmSm.CONV_TAB_Edp_EmPwrStgIoCtrlMode /end COMPU_METHOD
/begin COMPU_METHOD EmSm.Edp_EmRpsCalnFltRsn "" TAB_VERB "%s" "" COMPU_TAB_REF EmSm.CONV_TAB_Edp_EmRpsCalnFltRsn /end COMPU_METHOD
/begin COMPU_METHOD EmSm.Edp_NvmTempFxp "" LINEAR "%10.6" "degC" COEFFS_LINEAR 0.015625 0 /end COMPU_METHOD
/begin COMPU_METHOD EmSm.Edp_cmdBckFcn1 "" TAB_VERB "%s" "" COMPU_TAB_REF EmSm.CONV_TAB_Edp_cmdBckFcn1 /end COMPU_METHOD
/begin COMPU_METHOD EmSm.Edp_cmdEm "" TAB_VERB "%d" "" COMPU_TAB_REF EmSm.CONV_TAB_Edp_cmdEm /end COMPU_METHOD
/begin COMPU_METHOD EmSm.EmSm_NvmSm "" TAB_VERB "%3.0" "" COMPU_TAB_REF EmSm.CONV_TAB_EmSm_NvmSm /end COMPU_METHOD
/begin COMPU_METHOD EmSm.EmSm_RpsAngOffsCalnSmState "" TAB_VERB "%3.0" "" COMPU_TAB_REF EmSm.CONV_TAB_EmSm_RpsAngOffsCalnSmState /end COMPU_METHOD
/begin COMPU_METHOD EmSm.Em_AscMode "" TAB_VERB "%d" "" COMPU_TAB_REF EmSm.CONV_TAB_Em_AscMode /end COMPU_METHOD
/begin COMPU_METHOD EmSm.Em_CtrlModeExtd "" TAB_VERB "%d" "" COMPU_TAB_REF EmSm.CONV_TAB_Em_CtrlModeExtd /end COMPU_METHOD
/begin COMPU_METHOD EmSm.Em_CtrlReqSrc "" TAB_VERB "%d" "" COMPU_TAB_REF EmSm.CONV_TAB_Em_CtrlReqSrc /end COMPU_METHOD
/begin COMPU_METHOD EmSm.IDENTICAL_SCALING_FLOAT "" IDENTICAL "%12.6" "" /end COMPU_METHOD
/begin COMPU_METHOD EmSm.LibTlSrvc_CmpntState "" TAB_VERB "%3.0" "" COMPU_TAB_REF EmSm.CONV_TAB_LibTlSrvc_CmpntState /end COMPU_METHOD
/begin COMPU_METHOD EmSm.LibTlSrvc_CmpntStateReq "" TAB_VERB "%3.0" "" COMPU_TAB_REF EmSm.CONV_TAB_LibTlSrvc_CmpntStateReq /end COMPU_METHOD
/begin COMPU_METHOD EmSm.LibTlSrvc_DcmIfCmd "" TAB_VERB "%3.0" "" COMPU_TAB_REF EmSm.CONV_TAB_LibTlSrvc_DcmIfCmd /end COMPU_METHOD
/begin COMPU_METHOD EmSm.LibTlSrvc_DcmIfRoutnState "" TAB_VERB "%3.0" "" COMPU_TAB_REF EmSm.CONV_TAB_LibTlSrvc_DcmIfRoutnState /end COMPU_METHOD
/begin COMPU_METHOD EmSm.LibTlSrvc_DcmResp "" TAB_VERB "%3.0" "" COMPU_TAB_REF EmSm.CONV_TAB_LibTlSrvc_DcmResp /end COMPU_METHOD
/begin COMPU_METHOD EmSm.LibTlSrvc_IoCtrlCmd "" TAB_VERB "%3.0" "" COMPU_TAB_REF EmSm.CONV_TAB_LibTlSrvc_IoCtrlCmd /end COMPU_METHOD
/begin COMPU_METHOD EmSm.LibTlSrvc_RoutnExecnCmd "" TAB_VERB "%3.0" "" COMPU_TAB_REF EmSm.CONV_TAB_LibTlSrvc_RoutnExecnCmd /end COMPU_METHOD
/begin COMPU_METHOD FCAL_DIRECTION "FCAL_DIRECTION" TAB_VERB "%2.1" "" COMPU_TAB_REF FCAL_DIRECTION /end COMPU_METHOD
/begin COMPU_METHOD FCM_Debounce_10ms "" RAT_FUNC "%3.3" "ms" COEFFS 0 0.2 0 0 0 1 /end COMPU_METHOD
/begin COMPU_METHOD FCM_Debounce_1ms "" RAT_FUNC "%3.3" "ms" COEFFS 0 2 0 0 0 1 /end COMPU_METHOD
/begin COMPU_METHOD FCM_Debounce_pwm "" RAT_FUNC "%3.3" "ms" COEFFS 0 14.7058823529 0 0 0 1 /end COMPU_METHOD
/begin COMPU_METHOD FIM_Faults "FIM Faults" TAB_VERB "%2.1" "" COMPU_TAB_REF FIM_Faults /end COMPU_METHOD
/begin COMPU_METHOD FS0b_request_Method "FS0b_request_Method" TAB_VERB "%2.1" "" COMPU_TAB_REF FS0b_request_Method /end COMPU_METHOD
/begin COMPU_METHOD FSLT_State_Method "FSLT_State_Method" TAB_VERB "%2.1" "" COMPU_TAB_REF FSLT_State_Method /end COMPU_METHOD
/begin COMPU_METHOD FloatVolatage "" RAT_FUNC "%3.3" "V" COEFFS 0 1 0 0 0 1 /end COMPU_METHOD
/begin COMPU_METHOD HG.Asw_Curr_A "" IDENTICAL "%12.6" "A" /end COMPU_METHOD
/begin COMPU_METHOD HG.Asw_QF "" TAB_VERB "%3.0" "" COMPU_TAB_REF HG.CONV_TAB_Asw_QF /end COMPU_METHOD
/begin COMPU_METHOD HG.Asw_Ratio "" IDENTICAL "%12.6" "ratio" /end COMPU_METHOD
/begin COMPU_METHOD HG.Asw_Spd_rpm "" IDENTICAL "%12.6" "rpm" /end COMPU_METHOD
/begin COMPU_METHOD HG.Asw_Temp_degC "" IDENTICAL "%6.1" "degC" /end COMPU_METHOD
/begin COMPU_METHOD HG.Asw_Time_s "" IDENTICAL "%12.6" "s" /end COMPU_METHOD
/begin COMPU_METHOD HG.Asw_Trq_Nm "" IDENTICAL "%12.6" "Nm" /end COMPU_METHOD
/begin COMPU_METHOD HG.Asw_Vel_kmh "" IDENTICAL "%12.6" "km/h" /end COMPU_METHOD
/begin COMPU_METHOD HG.Asw_Vof_lpmin "" IDENTICAL "%12.6" "lpm" /end COMPU_METHOD
/begin COMPU_METHOD HG.Asw_Volt_V "" IDENTICAL "%12.6" "V" /end COMPU_METHOD
/begin COMPU_METHOD HG.EQ_LSB_0_5 "" LINEAR "%5.1" "" COEFFS_LINEAR 0.5 0 /end COMPU_METHOD
/begin COMPU_METHOD HG.EQ_LSB_3_0517578125em5 "" LINEAR "%22.15" "cnt" COEFFS_LINEAR 3.0517578125E-05 0 /end COMPU_METHOD
/begin COMPU_METHOD HG.Edp_TempFxp "" LINEAR "%9.4" "degC" COEFFS_LINEAR 0.0625 0 /end COMPU_METHOD
/begin COMPU_METHOD HG.TLS_dTClockRnflw "" LINEAR "%8.2" "" COEFFS_LINEAR 0.25 0 /end COMPU_METHOD
/begin COMPU_METHOD HG.TLS_dTmpPeak "" LINEAR "%5.0" "" COEFFS_LINEAR 1 0 /end COMPU_METHOD
/begin COMPU_METHOD HG.TLS_dmgPwrMdl "" LINEAR "%15.14" "" COEFFS_LINEAR 2.32830643654E-10 0 /end COMPU_METHOD
/begin COMPU_METHOD HG.TLS_dmgPwrMdlNvm "" LINEAR "%17.15" "" COEFFS_LINEAR 9.31322574615E-10 0 /end COMPU_METHOD
/begin COMPU_METHOD HG.TLS_tClockRnflw "" LINEAR "%8.2" "" COEFFS_LINEAR 0.25 -60 /end COMPU_METHOD
/begin COMPU_METHOD HG.TLS_tmpPeakStack "" LINEAR "%3.0" "" COEFFS_LINEAR 1 -40 /end COMPU_METHOD
/begin COMPU_METHOD HSM_State "State of HSM" TAB_VERB "%3.1" "" COMPU_TAB_REF HSM_State /end COMPU_METHOD
/begin COMPU_METHOD HwTest.AdcExtTemp "" LINEAR "%19.3" "degC" COEFFS_LINEAR 0.000244140625 0 /end COMPU_METHOD
/begin COMPU_METHOD HwTest.AdcExt_Result "" LINEAR "%19.12" "V" COEFFS_LINEAR 0.000244140625 0 /end COMPU_METHOD
/begin COMPU_METHOD HwTest.Adc_Result "" LINEAR "%19.12" "V" COEFFS_LINEAR 0.000244140625 0 /end COMPU_METHOD
/begin COMPU_METHOD HwTest.AngleDeg "" LINEAR "%19.12" "deg" COEFFS_LINEAR 1 0 /end COMPU_METHOD
/begin COMPU_METHOD HwTest.Dio_Level "" TAB_VERB "%3.0" "" COMPU_TAB_REF HwTest.CONV_TAB_Dio_Level /end COMPU_METHOD
/begin COMPU_METHOD HwTest.DsAdc_Result "" LINEAR "%19.12" "V" COEFFS_LINEAR 0.000244140625 0 /end COMPU_METHOD
/begin COMPU_METHOD HwTest.Icu_DutyCycle "" LINEAR "%17.13" "%" COEFFS_LINEAR 0.0030517578125 0 /end COMPU_METHOD
/begin COMPU_METHOD HwTest.Icu_Frequency "" LINEAR "%20.12" "Hz" COEFFS_LINEAR 0.000244140625 0 /end COMPU_METHOD
/begin COMPU_METHOD HwTest.Icu_Period "" LINEAR "%17.13" "sec." COEFFS_LINEAR 1E-08 0 /end COMPU_METHOD
/begin COMPU_METHOD HwTest.Temp "" LINEAR "%19.12" "degC" COEFFS_LINEAR 1 0 /end COMPU_METHOD
/begin COMPU_METHOD HwTest.Volt "" LINEAR "%19.12" "V" COEFFS_LINEAR 1 0 /end COMPU_METHOD
/begin COMPU_METHOD HwtPwrStg.Gd31xxAdcMux "GD31xx ADC mux values" TAB_VERB "%.3" "" COMPU_TAB_REF HwtPwrStg.Gd31xxAdcMux /end COMPU_METHOD
/begin COMPU_METHOD HwtPwrStg.Mode "Powerstage operation modes" TAB_VERB "%.3" "" COMPU_TAB_REF HwtPwrStg.Mode /end COMPU_METHOD
/begin COMPU_METHOD HwtPwrStg.PulseGenTime "" LINEAR "%3.2" "us" COEFFS_LINEAR 0.01 0 /end COMPU_METHOD
/begin COMPU_METHOD IMPS_Amplitude_Synchronicity "Amplitude Synchronicity in %" LINEAR "%2.1" "%" COEFFS_LINEAR 0.00610354 100 /end COMPU_METHOD
/begin COMPU_METHOD IMPS_Angle2Degree "Angle in degree" LINEAR "%4.4" "°" COEFFS_LINEAR 0.00549316 0 /end COMPU_METHOD
/begin COMPU_METHOD IMPS_Orthogonality_Correction "Orthogonality Correction of X and Y Components" LINEAR "%2.4" "°" COEFFS_LINEAR 0.00549316 0 /end COMPU_METHOD
/begin COMPU_METHOD ISO_DEM_Status_Method "ISO_DEM_Status_Method" TAB_VERB "%3.1" "" COMPU_TAB_REF ISO_DEM_Status /end COMPU_METHOD
/begin COMPU_METHOD Interface_10_LocalEQ173677 "Torque reduction type" TAB_VERB "%3.0" "" COMPU_TAB_REF Interface_10_CONV_TAB_LocalEQ173677 /end COMPU_METHOD
/begin COMPU_METHOD Interface_11_LocalEQ173676 "" TAB_VERB "%3.0" "" COMPU_TAB_REF Interface_11_CONV_TAB_LocalEQ173676 /end COMPU_METHOD
/begin COMPU_METHOD Interface_12_LocalEQ173675 "Towing Enabled status" TAB_VERB "%3.0" "" COMPU_TAB_REF Interface_12_CONV_TAB_LocalEQ173675 /end COMPU_METHOD
/begin COMPU_METHOD Interface_13_V_bn4 "" LINEAR "%9.4" "V" COEFFS_LINEAR 0.0625 0 /end COMPU_METHOD
/begin COMPU_METHOD Interface_14_grdC_bn3 "" LINEAR "%8.3" "°C" COEFFS_LINEAR 0.125 0 /end COMPU_METHOD
/begin COMPU_METHOD Interface_15_km_bp4 "" LINEAR "%11.0" "km" COEFFS_LINEAR 16 0 /end COMPU_METHOD
/begin COMPU_METHOD Interface_16_EQ_LSB_3_814697265625em06 "Local scaling for the flux stored in EEPROM" LINEAR "%16.15" "Wb" COEFFS_LINEAR 3.81469726563E-06 0 /end COMPU_METHOD
/begin COMPU_METHOD Interface_17_rpm_bn1 "" LINEAR "%7.1" "rpm" COEFFS_LINEAR 0.5 0 /end COMPU_METHOD
/begin COMPU_METHOD Interface_18_rpm_bp0 "" LINEAR "%5.0" "rpm" COEFFS_LINEAR 1 0 /end COMPU_METHOD
/begin COMPU_METHOD Interface_19_LocalEQ173666 "Torque reduction type" TAB_VERB "%3.0" "" COMPU_TAB_REF Interface_19_CONV_TAB_LocalEQ173666 /end COMPU_METHOD
/begin COMPU_METHOD Interface_1_LocalEQ173686 "Torque reduction type" TAB_VERB "%3.0" "" COMPU_TAB_REF Interface_1_CONV_TAB_LocalEQ173686 /end COMPU_METHOD
/begin COMPU_METHOD Interface_20_LocalEQ173665 "" TAB_VERB "%3.0" "" COMPU_TAB_REF Interface_20_CONV_TAB_LocalEQ173665 /end COMPU_METHOD
/begin COMPU_METHOD Interface_21_LocalEQ173664 "Torque reduction type" TAB_VERB "%3.0" "" COMPU_TAB_REF Interface_21_CONV_TAB_LocalEQ173664 /end COMPU_METHOD
/begin COMPU_METHOD Interface_22_LocalEQ173663 "" TAB_VERB "%3.0" "-" COMPU_TAB_REF Interface_22_CONV_TAB_LocalEQ173663 /end COMPU_METHOD
/begin COMPU_METHOD Interface_23_LocalEQ173662 "" TAB_VERB "%3.0" "" COMPU_TAB_REF Interface_23_CONV_TAB_LocalEQ173662 /end COMPU_METHOD
/begin COMPU_METHOD Interface_24_LocalEQ173661 "" TAB_VERB "%3.0" "" COMPU_TAB_REF Interface_24_CONV_TAB_LocalEQ173661 /end COMPU_METHOD
/begin COMPU_METHOD Interface_25_LocalEQ173660 "" TAB_VERB "%3.0" "" COMPU_TAB_REF Interface_25_CONV_TAB_LocalEQ173660 /end COMPU_METHOD
/begin COMPU_METHOD Interface_26_LocalEQ173659 "" TAB_VERB "%3.0" "" COMPU_TAB_REF Interface_26_CONV_TAB_LocalEQ173659 /end COMPU_METHOD
/begin COMPU_METHOD Interface_27_LocalEQ173658 "" TAB_VERB "%3.0" "" COMPU_TAB_REF Interface_27_CONV_TAB_LocalEQ173658 /end COMPU_METHOD
/begin COMPU_METHOD Interface_28_LocalEQ173657 "" TAB_VERB "%3.0" "" COMPU_TAB_REF Interface_28_CONV_TAB_LocalEQ173657 /end COMPU_METHOD
/begin COMPU_METHOD Interface_29_LocalEQ173656 "" TAB_VERB "%3.0" "" COMPU_TAB_REF Interface_29_CONV_TAB_LocalEQ173656 /end COMPU_METHOD
/begin COMPU_METHOD Interface_2_LocalEQ173685 "" TAB_VERB "%3.0" "" COMPU_TAB_REF Interface_2_CONV_TAB_LocalEQ173685 /end COMPU_METHOD
/begin COMPU_METHOD Interface_30_LocalEQ173655 "" TAB_VERB "%3.0" "" COMPU_TAB_REF Interface_30_CONV_TAB_LocalEQ173655 /end COMPU_METHOD
/begin COMPU_METHOD Interface_31_LocalEQ173654 "" TAB_VERB "%3.0" "" COMPU_TAB_REF Interface_31_CONV_TAB_LocalEQ173654 /end COMPU_METHOD
/begin COMPU_METHOD Interface_32_LocalEQ173653 "" TAB_VERB "%3.0" "" COMPU_TAB_REF Interface_32_CONV_TAB_LocalEQ173653 /end COMPU_METHOD
/begin COMPU_METHOD Interface_33_LocalEQ173652 "" TAB_VERB "%3.0" "" COMPU_TAB_REF Interface_33_CONV_TAB_LocalEQ173652 /end COMPU_METHOD
/begin COMPU_METHOD Interface_34_LocalEQ173651 "" TAB_VERB "%3.0" "" COMPU_TAB_REF Interface_34_CONV_TAB_LocalEQ173651 /end COMPU_METHOD
/begin COMPU_METHOD Interface_35_LocalEQ173650 "" TAB_VERB "%3.0" "-" COMPU_TAB_REF Interface_35_CONV_TAB_LocalEQ173650 /end COMPU_METHOD
/begin COMPU_METHOD Interface_36_LocalEQ173649 "" TAB_VERB "%3.0" "" COMPU_TAB_REF Interface_36_CONV_TAB_LocalEQ173649 /end COMPU_METHOD
/begin COMPU_METHOD Interface_37_LocalEQ173648 "" TAB_VERB "%3.0" "" COMPU_TAB_REF Interface_37_CONV_TAB_LocalEQ173648 /end COMPU_METHOD
/begin COMPU_METHOD Interface_38_LocalEQ173647 "" TAB_VERB "%3.0" "" COMPU_TAB_REF Interface_38_CONV_TAB_LocalEQ173647 /end COMPU_METHOD
/begin COMPU_METHOD Interface_39_LocalEQ173646 "" TAB_VERB "%3.0" "" COMPU_TAB_REF Interface_39_CONV_TAB_LocalEQ173646 /end COMPU_METHOD
/begin COMPU_METHOD Interface_3_s_bp0 "" LINEAR "%5.0" "s" COEFFS_LINEAR 1 0 /end COMPU_METHOD
/begin COMPU_METHOD Interface_40_LocalEQ173645 "" TAB_VERB "%3.0" "" COMPU_TAB_REF Interface_40_CONV_TAB_LocalEQ173645 /end COMPU_METHOD
/begin COMPU_METHOD Interface_41_LocalEQ173644 "" TAB_VERB "%3.0" "" COMPU_TAB_REF Interface_41_CONV_TAB_LocalEQ173644 /end COMPU_METHOD
/begin COMPU_METHOD Interface_42_LocalEQ173643 "" TAB_VERB "%3.0" "" COMPU_TAB_REF Interface_42_CONV_TAB_LocalEQ173643 /end COMPU_METHOD
/begin COMPU_METHOD Interface_43_LocalEQ173642 "" TAB_VERB "%3.0" "" COMPU_TAB_REF Interface_43_CONV_TAB_LocalEQ173642 /end COMPU_METHOD
/begin COMPU_METHOD Interface_44_LocalEQ173641 "" TAB_VERB "%3.0" "" COMPU_TAB_REF Interface_44_CONV_TAB_LocalEQ173641 /end COMPU_METHOD
/begin COMPU_METHOD Interface_45_LocalEQ173640 "" TAB_VERB "%3.0" "" COMPU_TAB_REF Interface_45_CONV_TAB_LocalEQ173640 /end COMPU_METHOD
/begin COMPU_METHOD Interface_46_LocalEQ173639 "" TAB_VERB "%3.0" "-" COMPU_TAB_REF Interface_46_CONV_TAB_LocalEQ173639 /end COMPU_METHOD
/begin COMPU_METHOD Interface_47_LocalEQ173638 "" TAB_VERB "%3.0" "" COMPU_TAB_REF Interface_47_CONV_TAB_LocalEQ173638 /end COMPU_METHOD
/begin COMPU_METHOD Interface_48_rad_s_bp0 "" LINEAR "%12.6" "rad/s" COEFFS_LINEAR 1 0 /end COMPU_METHOD
/begin COMPU_METHOD Interface_49_V_bp0 "" LINEAR "%12.6" "V" COEFFS_LINEAR 1 0 /end COMPU_METHOD
/begin COMPU_METHOD Interface_4_Wb_bp0 "" LINEAR "%12.6" "Wb" COEFFS_LINEAR 1 0 /end COMPU_METHOD
/begin COMPU_METHOD Interface_50_h_bp0 "" LINEAR "%10.0" "h" COEFFS_LINEAR 1 0 /end COMPU_METHOD
/begin COMPU_METHOD Interface_51_min_bp0 "" LINEAR "%12.6" "min" COEFFS_LINEAR 1 0 /end COMPU_METHOD
/begin COMPU_METHOD Interface_52_grdC_bp0 "" LINEAR "%12.6" "°C" COEFFS_LINEAR 1 0 /end COMPU_METHOD
/begin COMPU_METHOD Interface_53_km_bp0 "" LINEAR "%12.6" "km" COEFFS_LINEAR 1 0 /end COMPU_METHOD
/begin COMPU_METHOD Interface_54_NonDim_bn10 "" LINEAR "%13.10" "-" COEFFS_LINEAR 0.0009765625 0 /end COMPU_METHOD
/begin COMPU_METHOD Interface_55_Ohm_bp0 "" LINEAR "%12.6" "Ohm" COEFFS_LINEAR 1 0 /end COMPU_METHOD
/begin COMPU_METHOD Interface_56_lpm_bp0 "" LINEAR "%12.6" "l/min" COEFFS_LINEAR 1 0 /end COMPU_METHOD
/begin COMPU_METHOD Interface_57_W_bp0 "" LINEAR "%12.6" "W" COEFFS_LINEAR 1 0 /end COMPU_METHOD
/begin COMPU_METHOD Interface_58_rpm_bp0 "" LINEAR "%12.6" "rpm" COEFFS_LINEAR 1 0 /end COMPU_METHOD
/begin COMPU_METHOD Interface_59_Nm_bp0 "" LINEAR "%12.6" "Nm" COEFFS_LINEAR 1 0 /end COMPU_METHOD
/begin COMPU_METHOD Interface_5_LocalEQ173681 "" TAB_VERB "%3.0" "" COMPU_TAB_REF Interface_5_CONV_TAB_LocalEQ173681 /end COMPU_METHOD
/begin COMPU_METHOD Interface_60_A_bp0 "" LINEAR "%12.6" "A" COEFFS_LINEAR 1 0 /end COMPU_METHOD
/begin COMPU_METHOD Interface_61_Hz_bp0 "" LINEAR "%5.0" "Hz" COEFFS_LINEAR 1 0 /end COMPU_METHOD
/begin COMPU_METHOD Interface_62_LocalEQ173611 "" TAB_VERB "%3.0" "" COMPU_TAB_REF Interface_62_CONV_TAB_LocalEQ173611 /end COMPU_METHOD
/begin COMPU_METHOD Interface_63_LocalEQ173610 "" TAB_VERB "%3.0" "" COMPU_TAB_REF Interface_63_CONV_TAB_LocalEQ173610 /end COMPU_METHOD
/begin COMPU_METHOD Interface_64_LocalEQ173609 "" TAB_VERB "%3.0" "" COMPU_TAB_REF Interface_64_CONV_TAB_LocalEQ173609 /end COMPU_METHOD
/begin COMPU_METHOD Interface_65_LocalEQ173608 "" TAB_VERB "%3.0" "" COMPU_TAB_REF Interface_65_CONV_TAB_LocalEQ173608 /end COMPU_METHOD
/begin COMPU_METHOD Interface_66_LocalEQ173607 "" TAB_VERB "%3.0" "" COMPU_TAB_REF Interface_66_CONV_TAB_LocalEQ173607 /end COMPU_METHOD
/begin COMPU_METHOD Interface_67_LocalEQ173606 "" TAB_VERB "%3.0" "" COMPU_TAB_REF Interface_67_CONV_TAB_LocalEQ173606 /end COMPU_METHOD
/begin COMPU_METHOD Interface_68_LocalEQ173605 "" TAB_VERB "%3.0" "" COMPU_TAB_REF Interface_68_CONV_TAB_LocalEQ173605 /end COMPU_METHOD
/begin COMPU_METHOD Interface_69_LocalEQ173604 "" TAB_VERB "%3.0" "" COMPU_TAB_REF Interface_69_CONV_TAB_LocalEQ173604 /end COMPU_METHOD
/begin COMPU_METHOD Interface_6_LocalEQ173680 "" TAB_VERB "%3.0" "" COMPU_TAB_REF Interface_6_CONV_TAB_LocalEQ173680 /end COMPU_METHOD
/begin COMPU_METHOD Interface_70_LocalEQ173603 "" TAB_VERB "%3.0" "" COMPU_TAB_REF Interface_70_CONV_TAB_LocalEQ173603 /end COMPU_METHOD
/begin COMPU_METHOD Interface_71_LocalEQ173602 "" TAB_VERB "%3.0" "" COMPU_TAB_REF Interface_71_CONV_TAB_LocalEQ173602 /end COMPU_METHOD
/begin COMPU_METHOD Interface_72_LocalEQ173601 "" TAB_VERB "%3.0" "" COMPU_TAB_REF Interface_72_CONV_TAB_LocalEQ173601 /end COMPU_METHOD
/begin COMPU_METHOD Interface_73_LocalEQ173600 "" TAB_VERB "%3.0" "-" COMPU_TAB_REF Interface_73_CONV_TAB_LocalEQ173600 /end COMPU_METHOD
/begin COMPU_METHOD Interface_74_LocalEQ173599 "" TAB_VERB "%3.0" "-" COMPU_TAB_REF Interface_74_CONV_TAB_LocalEQ173599 /end COMPU_METHOD
/begin COMPU_METHOD Interface_75_LocalEQ173598 "" TAB_VERB "%3.0" "" COMPU_TAB_REF Interface_75_CONV_TAB_LocalEQ173598 /end COMPU_METHOD
/begin COMPU_METHOD Interface_76_LocalEQ173597 "" TAB_VERB "%3.0" "" COMPU_TAB_REF Interface_76_CONV_TAB_LocalEQ173597 /end COMPU_METHOD
/begin COMPU_METHOD Interface_77_LocalEQ173596 "" TAB_VERB "%3.0" "" COMPU_TAB_REF Interface_77_CONV_TAB_LocalEQ173596 /end COMPU_METHOD
/begin COMPU_METHOD Interface_78_LocalEQ173595 "" TAB_VERB "%3.0" "" COMPU_TAB_REF Interface_78_CONV_TAB_LocalEQ173595 /end COMPU_METHOD
/begin COMPU_METHOD Interface_79_LocalEQ173594 "" TAB_VERB "%3.0" "" COMPU_TAB_REF Interface_79_CONV_TAB_LocalEQ173594 /end COMPU_METHOD
/begin COMPU_METHOD Interface_7_NonDim_bp0 "" LINEAR "%10.0" "-" COEFFS_LINEAR 1 0 /end COMPU_METHOD
/begin COMPU_METHOD Interface_80_LocalEQ173593 "" TAB_VERB "%3.0" "" COMPU_TAB_REF Interface_80_CONV_TAB_LocalEQ173593 /end COMPU_METHOD
/begin COMPU_METHOD Interface_81_LocalEQ173592 "" TAB_VERB "%3.0" "" COMPU_TAB_REF Interface_81_CONV_TAB_LocalEQ173592 /end COMPU_METHOD
/begin COMPU_METHOD Interface_82_LocalEQ173591 "" TAB_VERB "%3.0" "" COMPU_TAB_REF Interface_82_CONV_TAB_LocalEQ173591 /end COMPU_METHOD
/begin COMPU_METHOD Interface_83_LocalEQ173590 "" TAB_VERB "%3.0" "" COMPU_TAB_REF Interface_83_CONV_TAB_LocalEQ173590 /end COMPU_METHOD
/begin COMPU_METHOD Interface_84_LocalEQ173589 "" TAB_VERB "%3.0" "" COMPU_TAB_REF Interface_84_CONV_TAB_LocalEQ173589 /end COMPU_METHOD
/begin COMPU_METHOD Interface_85_LocalEQ173588 "" TAB_VERB "%3.0" "-" COMPU_TAB_REF Interface_85_CONV_TAB_LocalEQ173588 /end COMPU_METHOD
/begin COMPU_METHOD Interface_86_NonDim_bp0 "" LINEAR "%12.6" "-" COEFFS_LINEAR 1 0 /end COMPU_METHOD
/begin COMPU_METHOD Interface_87_NonDim_bp0 "" LINEAR "%5.0" "-" COEFFS_LINEAR 1 0 /end COMPU_METHOD
/begin COMPU_METHOD Interface_88_LocalEQ173587 "" TAB_VERB "%3.0" "" COMPU_TAB_REF Interface_88_CONV_TAB_LocalEQ173587 /end COMPU_METHOD
/begin COMPU_METHOD Interface_89_NonDim_bp0 "" LINEAR "%1.0" "-" COEFFS_LINEAR 1 0 /end COMPU_METHOD
/begin COMPU_METHOD Interface_8_LocalEQ173679 "" TAB_VERB "%3.0" "" COMPU_TAB_REF Interface_8_CONV_TAB_LocalEQ173679 /end COMPU_METHOD
/begin COMPU_METHOD Interface_90_LocalEQ173586 "" TAB_VERB "%3.0" "" COMPU_TAB_REF Interface_90_CONV_TAB_LocalEQ173586 /end COMPU_METHOD
/begin COMPU_METHOD Interface_91_LocalEQ173585 "Printable ASCII, excl. special characters" TAB_VERB "%3.0" "" COMPU_TAB_REF Interface_91_CONV_TAB_LocalEQ173585 /end COMPU_METHOD
/begin COMPU_METHOD Interface_92_LocalEQ173578 "" TAB_VERB "%3.0" "" COMPU_TAB_REF Interface_92_CONV_TAB_LocalEQ173578 /end COMPU_METHOD
/begin COMPU_METHOD Interface_93_LocalEQ173577 "" TAB_VERB "%3.0" "" COMPU_TAB_REF Interface_93_CONV_TAB_LocalEQ173577 /end COMPU_METHOD
/begin COMPU_METHOD Interface_94_NonDim_bp0 "" LINEAR "%3.0" "-" COEFFS_LINEAR 1 0 /end COMPU_METHOD
/begin COMPU_METHOD Interface_95_LocalEQ173571 "" TAB_VERB "%3.0" "" COMPU_TAB_REF Interface_95_CONV_TAB_LocalEQ173571 /end COMPU_METHOD
/begin COMPU_METHOD Interface_96_LocalEQ173567 "" TAB_VERB "%3.0" "" COMPU_TAB_REF Interface_96_CONV_TAB_LocalEQ173567 /end COMPU_METHOD
/begin COMPU_METHOD Interface_9_LocalEQ173678 "" TAB_VERB "%3.0" "" COMPU_TAB_REF Interface_9_CONV_TAB_LocalEQ173678 /end COMPU_METHOD
/begin COMPU_METHOD IoActr.Adc_Result "" LINEAR "%19.12" "V" COEFFS_LINEAR 0.000244140625 0 /end COMPU_METHOD
/begin COMPU_METHOD IoActr.Adc_Status "" TAB_VERB "%d" "" COMPU_TAB_REF IoActr.CONV_TAB_Adc_Status /end COMPU_METHOD
/begin COMPU_METHOD IoActr.Asw_AvailyState "" TAB_VERB "%d" "" COMPU_TAB_REF IoActr.CONV_TAB_Asw_AvailyState /end COMPU_METHOD
/begin COMPU_METHOD IoActr.Asw_Curr_A "" IDENTICAL "%12.6" "A" /end COMPU_METHOD
/begin COMPU_METHOD IoActr.Asw_Enrg_J "" IDENTICAL "%12.6" "J" /end COMPU_METHOD
/begin COMPU_METHOD IoActr.Asw_Frq_Hz "" IDENTICAL "%12.6" "Hz" /end COMPU_METHOD
/begin COMPU_METHOD IoActr.Asw_Len_mm "" IDENTICAL "%12.6" "mm" /end COMPU_METHOD
/begin COMPU_METHOD IoActr.Asw_Perc "" IDENTICAL "%12.6" "%" /end COMPU_METHOD
/begin COMPU_METHOD IoActr.Asw_Rstc_Ohm "" IDENTICAL "%12.6" "Ohm" /end COMPU_METHOD
/begin COMPU_METHOD IoActr.Asw_SigQly "" TAB_VERB "%s" "" COMPU_TAB_REF IoActr.CONV_TAB_Asw_SigQly /end COMPU_METHOD
/begin COMPU_METHOD IoActr.Asw_Temp_degC "" IDENTICAL "%6.1" "degC" /end COMPU_METHOD
/begin COMPU_METHOD IoActr.Asw_Time_s "" IDENTICAL "%12.6" "s" /end COMPU_METHOD
/begin COMPU_METHOD IoActr.Asw_Time_us "" IDENTICAL "%12.6" "us" /end COMPU_METHOD
/begin COMPU_METHOD IoActr.Asw_Volt_V "" IDENTICAL "%12.6" "V" /end COMPU_METHOD
/begin COMPU_METHOD IoActr.Dio_Level "" TAB_VERB "%3.0" "" COMPU_TAB_REF IoActr.CONV_TAB_Dio_Level /end COMPU_METHOD
/begin COMPU_METHOD IoActr.Edp_cmdBckFcn2 "" TAB_VERB "%s" "" COMPU_TAB_REF IoActr.CONV_TAB_Edp_cmdBckFcn2 /end COMPU_METHOD
/begin COMPU_METHOD IoActr.Edp_cmdBckFcn3 "" TAB_VERB "%s" "" COMPU_TAB_REF IoActr.CONV_TAB_Edp_cmdBckFcn3 /end COMPU_METHOD
/begin COMPU_METHOD IoActr.Hbr_DutyCycle "" LINEAR "%17.13" "%" COEFFS_LINEAR 0.0030517578125 0 /end COMPU_METHOD
/begin COMPU_METHOD IoActr.Hbr_Frequency "" LINEAR "%d" "%" COEFFS_LINEAR 1 0 /end COMPU_METHOD
/begin COMPU_METHOD IoActr.IDENTICAL_SCALING "" IDENTICAL "%10.0" "" /end COMPU_METHOD
/begin COMPU_METHOD IoActr.IDENTICAL_SCALING_FLOAT "" IDENTICAL "%12.6" "" /end COMPU_METHOD
/begin COMPU_METHOD IoActr.IcDrv3245_Status "" TAB_VERB "%d" "" COMPU_TAB_REF IoActr.CONV_TAB_IcDrv3245_Status /end COMPU_METHOD
/begin COMPU_METHOD IoActr.IoActr_PwrStgMngtState "" TAB_VERB "%3.0" "-" COMPU_TAB_REF IoActr.CONV_TAB_IoActr_PwrStgMngtState /end COMPU_METHOD
/begin COMPU_METHOD IoActr.LibTlHwIo_IcDrv3245MngtState "" TAB_VERB "%3.0" "" COMPU_TAB_REF IoActr.CONV_TAB_LibTlHwIo_IcDrv3245MngtState /end COMPU_METHOD
/begin COMPU_METHOD IoActr.LibTlHwIo_PwrStgOpnMode "" TAB_VERB "%d" "" COMPU_TAB_REF IoActr.CONV_TAB_LibTlHwIo_PwrStgOpnMode /end COMPU_METHOD
/begin COMPU_METHOD IoActr.LibTlHwIo_SpiCmdMngtState "" TAB_VERB "%3.0" "" COMPU_TAB_REF IoActr.CONV_TAB_LibTlHwIo_SpiCmdMngtState /end COMPU_METHOD
/begin COMPU_METHOD IoActr.LibTlSrvc_CmpntStateReq "" TAB_VERB "%3.0" "" COMPU_TAB_REF IoActr.CONV_TAB_LibTlSrvc_CmpntStateReq /end COMPU_METHOD
/begin COMPU_METHOD IoActr.SBC_State "" TAB_VERB "%s" "" COMPU_TAB_REF IoActr.CONV_TAB_SBC_State /end COMPU_METHOD
/begin COMPU_METHOD IoActr.Sent_Status "" TAB_VERB "%3.0" "" COMPU_TAB_REF IoActr.CONV_TAB_Sent_Status /end COMPU_METHOD
/begin COMPU_METHOD IoActr.SnrKavx_Status "" TAB_VERB "%3.0" "" COMPU_TAB_REF IoActr.CONV_TAB_SnrKavx_Status /end COMPU_METHOD
/begin COMPU_METHOD IoEcu.Adc_Result "" LINEAR "%19.12" "V" COEFFS_LINEAR 0.000244140625 0 /end COMPU_METHOD
/begin COMPU_METHOD IoEcu.Adc_Status "" TAB_VERB "%d" "" COMPU_TAB_REF IoEcu.CONV_TAB_Adc_Status /end COMPU_METHOD
/begin COMPU_METHOD IoEcu.Asw_AvailyState "" TAB_VERB "%d" "" COMPU_TAB_REF IoEcu.CONV_TAB_Asw_AvailyState /end COMPU_METHOD
/begin COMPU_METHOD IoEcu.Asw_Curr_A "" IDENTICAL "%12.6" "A" /end COMPU_METHOD
/begin COMPU_METHOD IoEcu.Asw_Frq_Hz "" IDENTICAL "%12.6" "Hz" /end COMPU_METHOD
/begin COMPU_METHOD IoEcu.Asw_Perc "" IDENTICAL "%12.6" "%" /end COMPU_METHOD
/begin COMPU_METHOD IoEcu.Asw_Rstc_Ohm "" IDENTICAL "%12.6" "Ohm" /end COMPU_METHOD
/begin COMPU_METHOD IoEcu.Asw_SigQly "" TAB_VERB "%s" "" COMPU_TAB_REF IoEcu.CONV_TAB_Asw_SigQly /end COMPU_METHOD
/begin COMPU_METHOD IoEcu.Asw_Spd_rpm "" IDENTICAL "%12.6" "rpm" /end COMPU_METHOD
/begin COMPU_METHOD IoEcu.Asw_Temp_degC "" IDENTICAL "%6.1" "degC" /end COMPU_METHOD
/begin COMPU_METHOD IoEcu.Asw_Time_s "" IDENTICAL "%12.6" "s" /end COMPU_METHOD
/begin COMPU_METHOD IoEcu.Asw_Time_us "" IDENTICAL "%12.6" "us" /end COMPU_METHOD
/begin COMPU_METHOD IoEcu.Asw_Volt_V "" IDENTICAL "%12.6" "V" /end COMPU_METHOD
/begin COMPU_METHOD IoEcu.Dio_Level "" TAB_VERB "%3.0" "" COMPU_TAB_REF IoEcu.CONV_TAB_Dio_Level /end COMPU_METHOD
/begin COMPU_METHOD IoEcu.Edp_LvVoltFxp "" LINEAR "%13.10" "V" COEFFS_LINEAR 0.0009765625 0 /end COMPU_METHOD
/begin COMPU_METHOD IoEcu.Edp_LvVoltFxp_a "" LINEAR "%18.10" "V" COEFFS_LINEAR 0.0009765625 0 /end COMPU_METHOD
/begin COMPU_METHOD IoEcu.Edp_MptSignalState "" TAB_VERB "%3.0" "" COMPU_TAB_REF IoEcu.CONV_TAB_Edp_MptSignalState /end COMPU_METHOD
/begin COMPU_METHOD IoEcu.Edp_TempFxp "" LINEAR "%9.4" "degC" COEFFS_LINEAR 0.0625 0 /end COMPU_METHOD
/begin COMPU_METHOD IoEcu.Edp_cmdBckFcn1 "" TAB_VERB "%s" "" COMPU_TAB_REF IoEcu.CONV_TAB_Edp_cmdBckFcn1 /end COMPU_METHOD
/begin COMPU_METHOD IoEcu.Em_PwrStgHwCtrlMode "" TAB_VERB "%d" "" COMPU_TAB_REF IoEcu.CONV_TAB_Em_PwrStgHwCtrlMode /end COMPU_METHOD
/begin COMPU_METHOD IoEcu.HvilSmState "" TAB_VERB "%3.0" "" COMPU_TAB_REF IoEcu.CONV_TAB_HvilSmState /end COMPU_METHOD
/begin COMPU_METHOD IoEcu.HvilState "" TAB_VERB "%3.0" "" COMPU_TAB_REF IoEcu.CONV_TAB_HvilState /end COMPU_METHOD
/begin COMPU_METHOD IoEcu.HvilState_eATS "" TAB_VERB "%3.0" "" COMPU_TAB_REF IoEcu.CONV_TAB_HvilState_eATS /end COMPU_METHOD
/begin COMPU_METHOD IoEcu.IDENTICAL_SCALING "" IDENTICAL "%10.0" "" /end COMPU_METHOD
/begin COMPU_METHOD IoEcu.IDENTICAL_SCALING_FLOAT "" IDENTICAL "%12.6" "" /end COMPU_METHOD
/begin COMPU_METHOD IoEcu.Icu_DutyCycle "" LINEAR "%17.13" "%" COEFFS_LINEAR 0.0030517578125 0 /end COMPU_METHOD
/begin COMPU_METHOD IoEcu.Icu_Frequency "" LINEAR "%20.12" "Hz" COEFFS_LINEAR 0.000244140625 0 /end COMPU_METHOD
/begin COMPU_METHOD IoEcu.Icu_Status "" TAB_VERB "%3.0" "" COMPU_TAB_REF IoEcu.CONV_TAB_Icu_Status /end COMPU_METHOD
/begin COMPU_METHOD IoEcu.IoEcu_UnlockgState "" TAB_VERB "%3.0" "" COMPU_TAB_REF IoEcu.CONV_TAB_IoEcu_UnlockgState /end COMPU_METHOD
/begin COMPU_METHOD IoEcu.IoHwAb_PwrStgDrvrInactvState "" TAB_VERB "%3.0" "" COMPU_TAB_REF IoEcu.CONV_TAB_IoHwAb_PwrStgDrvrInactvState /end COMPU_METHOD
/begin COMPU_METHOD IoEcu.IoHwAb_StrtupState "" TAB_VERB "%3.0" "" COMPU_TAB_REF IoEcu.CONV_TAB_IoHwAb_StrtupState /end COMPU_METHOD
/begin COMPU_METHOD IoEcu.LibTlHwIo_PwrStgFbOpnMode "" TAB_VERB "%d" "" COMPU_TAB_REF IoEcu.CONV_TAB_LibTlHwIo_PwrStgFbOpnMode /end COMPU_METHOD
/begin COMPU_METHOD IoEcu.LibTlHwIo_PwrStgOpnMode "" TAB_VERB "%d" "" COMPU_TAB_REF IoEcu.CONV_TAB_LibTlHwIo_PwrStgOpnMode /end COMPU_METHOD
/begin COMPU_METHOD IoEcu.LibTlSrvc_DcmIfCmd "" TAB_VERB "%3.0" "" COMPU_TAB_REF IoEcu.CONV_TAB_LibTlSrvc_DcmIfCmd /end COMPU_METHOD
/begin COMPU_METHOD IoEcu.LibTlSrvc_DcmIfRoutnState "" TAB_VERB "%3.0" "" COMPU_TAB_REF IoEcu.CONV_TAB_LibTlSrvc_DcmIfRoutnState /end COMPU_METHOD
/begin COMPU_METHOD IoEcu.LibTlSrvc_DcmResp "" TAB_VERB "%3.0" "" COMPU_TAB_REF IoEcu.CONV_TAB_LibTlSrvc_DcmResp /end COMPU_METHOD
/begin COMPU_METHOD IoEcu.LibTlSrvc_RoutnExecnCmd "" TAB_VERB "%3.0" "" COMPU_TAB_REF IoEcu.CONV_TAB_LibTlSrvc_RoutnExecnCmd /end COMPU_METHOD
/begin COMPU_METHOD IoEcu.LibTlSrvc_TempFxp "" LINEAR "%9.4" "degC" COEFFS_LINEAR 0.0625 0 /end COMPU_METHOD
/begin COMPU_METHOD IoEcu.PreDrv_State "" TAB_VERB "%10.0" "" COMPU_TAB_REF IoEcu.CONV_TAB_PreDrv_State /end COMPU_METHOD
/begin COMPU_METHOD IoEcu.PreDrv_Sts "" TAB_VERB "%10.0" "" COMPU_TAB_REF IoEcu.CONV_TAB_PreDrv_Sts /end COMPU_METHOD
/begin COMPU_METHOD IoEcu.SBC_State "" TAB_VERB "%s" "" COMPU_TAB_REF IoEcu.CONV_TAB_SBC_State /end COMPU_METHOD
/begin COMPU_METHOD IoEcu.Saf_EventMask "" LINEAR "%d" "" COEFFS_LINEAR 1 0 /end COMPU_METHOD
/begin COMPU_METHOD IoEcu.cmSelftestSt "" TAB_VERB "%3.0" "" COMPU_TAB_REF IoEcu.CONV_TAB_cmSelftestSt /end COMPU_METHOD
/begin COMPU_METHOD IoEcu.cmSftyOperSt "" TAB_VERB "%5.0" "" COMPU_TAB_REF IoEcu.CONV_TAB_cmSftyOperSt /end COMPU_METHOD
/begin COMPU_METHOD IoEm.Adc_Result "" LINEAR "%19.12" "V" COEFFS_LINEAR 0.000244140625 0 /end COMPU_METHOD
/begin COMPU_METHOD IoEm.Adc_Status "" TAB_VERB "%d" "" COMPU_TAB_REF IoEm.CONV_TAB_Adc_Status /end COMPU_METHOD
/begin COMPU_METHOD IoEm.Asw_Ang_deg "" IDENTICAL "%12.6" "degree" /end COMPU_METHOD
/begin COMPU_METHOD IoEm.Asw_AngrAcc_radps2 "" IDENTICAL "%12.6" "rad/s^2" /end COMPU_METHOD
/begin COMPU_METHOD IoEm.Asw_AngrVel_radps "" IDENTICAL "%12.6" "rad/s" /end COMPU_METHOD
/begin COMPU_METHOD IoEm.Asw_AvailyState "" TAB_VERB "%d" "" COMPU_TAB_REF IoEm.CONV_TAB_Asw_AvailyState /end COMPU_METHOD
/begin COMPU_METHOD IoEm.Asw_Curr_A "" IDENTICAL "%12.6" "A" /end COMPU_METHOD
/begin COMPU_METHOD IoEm.Asw_Curr_Apeak "" IDENTICAL "%12.6" "Apeak" /end COMPU_METHOD
/begin COMPU_METHOD IoEm.Asw_Frq_Hz "" IDENTICAL "%12.6" "Hz" /end COMPU_METHOD
/begin COMPU_METHOD IoEm.Asw_Perc "" IDENTICAL "%12.6" "%" /end COMPU_METHOD
/begin COMPU_METHOD IoEm.Asw_Pwr_W "" IDENTICAL "%12.6" "W" /end COMPU_METHOD
/begin COMPU_METHOD IoEm.Asw_Rstc_Ohm "" IDENTICAL "%12.6" "Ohm" /end COMPU_METHOD
/begin COMPU_METHOD IoEm.Asw_RunState "" TAB_VERB "%d" "" COMPU_TAB_REF IoEm.CONV_TAB_Asw_RunState /end COMPU_METHOD
/begin COMPU_METHOD IoEm.Asw_SigQly "" TAB_VERB "%s" "" COMPU_TAB_REF IoEm.CONV_TAB_Asw_SigQly /end COMPU_METHOD
/begin COMPU_METHOD IoEm.Asw_SpdRate_rpmps "" IDENTICAL "%12.6" "rpm/s" /end COMPU_METHOD
/begin COMPU_METHOD IoEm.Asw_Spd_rpm "" IDENTICAL "%12.6" "rpm" /end COMPU_METHOD
/begin COMPU_METHOD IoEm.Asw_Temp_degC "" IDENTICAL "%6.1" "degC" /end COMPU_METHOD
/begin COMPU_METHOD IoEm.Asw_Time_s "" IDENTICAL "%12.6" "s" /end COMPU_METHOD
/begin COMPU_METHOD IoEm.Asw_Time_us "" IDENTICAL "%12.6" "us" /end COMPU_METHOD
/begin COMPU_METHOD IoEm.Asw_Volt_V "" IDENTICAL "%12.6" "V" /end COMPU_METHOD
/begin COMPU_METHOD IoEm.Asw_Volt_Vpeak "" IDENTICAL "%12.6" "Vpeak" /end COMPU_METHOD
/begin COMPU_METHOD IoEm.Dio_Level "" TAB_VERB "%3.0" "" COMPU_TAB_REF IoEm.CONV_TAB_Dio_Level /end COMPU_METHOD
/begin COMPU_METHOD IoEm.DsAdc_CarrierGenDiv "" TAB_VERB "%3.0" "" COMPU_TAB_REF IoEm.CONV_TAB_DsAdc_CarrierGenDiv /end COMPU_METHOD
/begin COMPU_METHOD IoEm.DsAdc_CarrierGenMode "" TAB_VERB "%3.0" "" COMPU_TAB_REF IoEm.CONV_TAB_DsAdc_CarrierGenMode /end COMPU_METHOD
/begin COMPU_METHOD IoEm.DsAdc_Result "" LINEAR "%19.12" "V" COEFFS_LINEAR 0.000244140625 0 /end COMPU_METHOD
/begin COMPU_METHOD IoEm.EQ_LSB_1 "" LINEAR "%12.6" "1/V" COEFFS_LINEAR 1 0 /end COMPU_METHOD
/begin COMPU_METHOD IoEm.EQ_LSB_1_a "" LINEAR "%12.6" "-" COEFFS_LINEAR 1 0 /end COMPU_METHOD
/begin COMPU_METHOD IoEm.Edp_cmdBckFcn1 "" TAB_VERB "%s" "" COMPU_TAB_REF IoEm.CONV_TAB_Edp_cmdBckFcn1 /end COMPU_METHOD
/begin COMPU_METHOD IoEm.Em_AscMode "" TAB_VERB "%d" "" COMPU_TAB_REF IoEm.CONV_TAB_Em_AscMode /end COMPU_METHOD
/begin COMPU_METHOD IoEm.Em_CmtMode "" TAB_VERB "%d" "" COMPU_TAB_REF IoEm.CONV_TAB_Em_CmtMode /end COMPU_METHOD
/begin COMPU_METHOD IoEm.Em_FastFltReactn "" TAB_VERB "%d" "" COMPU_TAB_REF IoEm.CONV_TAB_Em_FastFltReactn /end COMPU_METHOD
/begin COMPU_METHOD IoEm.GtmMisc_Timestamp "" LINEAR "%d" "ticks" COEFFS_LINEAR 1 0 /end COMPU_METHOD
/begin COMPU_METHOD IoEm.IDENTICAL_SCALING "" IDENTICAL "%10.0" "" /end COMPU_METHOD
/begin COMPU_METHOD IoEm.IDENTICAL_SCALING_FLOAT "" IDENTICAL "%12.6" "" /end COMPU_METHOD
/begin COMPU_METHOD IoEm.Icu_DutyCycle "" LINEAR "%17.13" "%" COEFFS_LINEAR 0.0030517578125 0 /end COMPU_METHOD
/begin COMPU_METHOD IoEm.Icu_Frequency "" LINEAR "%20.12" "Hz" COEFFS_LINEAR 0.000244140625 0 /end COMPU_METHOD
/begin COMPU_METHOD IoEm.Icu_Timestamp "" LINEAR "%d" "ticks" COEFFS_LINEAR 1 0 /end COMPU_METHOD
/begin COMPU_METHOD IoEm.IoEm_AngOvrrdMode "" TAB_VERB "%3.0" "" COMPU_TAB_REF IoEm.CONV_TAB_IoEm_AngOvrrdMode /end COMPU_METHOD
/begin COMPU_METHOD IoEm.IoEm_ParSrc "" TAB_VERB "%3.0" "" COMPU_TAB_REF IoEm.CONV_TAB_IoEm_ParSrc /end COMPU_METHOD
/begin COMPU_METHOD IoEm.IoEm_SoftFltReactnMode "" TAB_VERB "%d" "" COMPU_TAB_REF IoEm.CONV_TAB_IoEm_SoftFltReactnMode /end COMPU_METHOD
/begin COMPU_METHOD IoEm.IoHwAb_CalnState "" TAB_VERB "%3.0" "" COMPU_TAB_REF IoEm.CONV_TAB_IoHwAb_CalnState /end COMPU_METHOD
/begin COMPU_METHOD IoEm.IoHwAb_PwrStgDrvrInactvState "" TAB_VERB "%3.0" "" COMPU_TAB_REF IoEm.CONV_TAB_IoHwAb_PwrStgDrvrInactvState /end COMPU_METHOD
/begin COMPU_METHOD IoEm.IoHwAb_RdndtSafeStateActvnSts "" TAB_VERB "%3.0" "" COMPU_TAB_REF IoEm.CONV_TAB_IoHwAb_RdndtSafeStateActvnSts /end COMPU_METHOD
/begin COMPU_METHOD IoEm.IoHwAb_StrtupState "" TAB_VERB "%3.0" "" COMPU_TAB_REF IoEm.CONV_TAB_IoHwAb_StrtupState /end COMPU_METHOD
/begin COMPU_METHOD IoEm.LibTlHwIo_PwrStgFbOpnMode "" TAB_VERB "%d" "" COMPU_TAB_REF IoEm.CONV_TAB_LibTlHwIo_PwrStgFbOpnMode /end COMPU_METHOD
/begin COMPU_METHOD IoEm.LibTlHwIo_PwrStgOpnMode "" TAB_VERB "%d" "" COMPU_TAB_REF IoEm.CONV_TAB_LibTlHwIo_PwrStgOpnMode /end COMPU_METHOD
/begin COMPU_METHOD IoEm.Mpwm_DeadTime "" LINEAR "%d" "IF ticks" COEFFS_LINEAR 1 0 /end COMPU_METHOD
/begin COMPU_METHOD IoEm.Mpwm_DutyCycle "" LINEAR "%17.13" "%" COEFFS_LINEAR 0.0030517578125 0 /end COMPU_METHOD
/begin COMPU_METHOD IoEm.Mpwm_Period "" LINEAR "%d" "IF ticks" COEFFS_LINEAR 1 0 /end COMPU_METHOD
/begin COMPU_METHOD IoEm.Mpwm_Status "" TAB_VERB "%d" "" COMPU_TAB_REF IoEm.CONV_TAB_Mpwm_Status /end COMPU_METHOD
/begin COMPU_METHOD IoEm.SBC_nFault_FSXb1 "" TAB_VERB "%s" "" COMPU_TAB_REF IoEm.CONV_TAB_SBC_nFault_FSXb1 /end COMPU_METHOD
/begin COMPU_METHOD IoEm.SBC_nSSP3 "" TAB_VERB "%s" "" COMPU_TAB_REF IoEm.CONV_TAB_SBC_nSSP3 /end COMPU_METHOD
/begin COMPU_METHOD IoEm.SI_statePwrNet "" TAB_VERB "%3.0" "" COMPU_TAB_REF IoEm.CONV_TAB_SI_statePwrNet /end COMPU_METHOD
/begin COMPU_METHOD IoInvTemp.Asw_Perc "" IDENTICAL "%12.6" "%" /end COMPU_METHOD
/begin COMPU_METHOD IoInvTemp.Asw_SigQly "" TAB_VERB "%s" "" COMPU_TAB_REF IoInvTemp.CONV_TAB_Asw_SigQly /end COMPU_METHOD
/begin COMPU_METHOD IoInvTemp.Asw_Spd_rpm "" IDENTICAL "%12.6" "rpm" /end COMPU_METHOD
/begin COMPU_METHOD IoInvTemp.Asw_Temp_degC "" IDENTICAL "%6.1" "degC" /end COMPU_METHOD
/begin COMPU_METHOD IoInvTemp.Asw_Time_s "" IDENTICAL "%12.6" "s" /end COMPU_METHOD
/begin COMPU_METHOD IoInvTemp.Asw_Trq_Nm "" IDENTICAL "%12.6" "Nm" /end COMPU_METHOD
/begin COMPU_METHOD IoInvTemp.Asw_Vof_lpmin "" IDENTICAL "%12.6" "lpm" /end COMPU_METHOD
/begin COMPU_METHOD IoInvTemp.IDENTICAL_SCALING_FLOAT "" IDENTICAL "%12.6" "" /end COMPU_METHOD
/begin COMPU_METHOD IoInvTemp.Icu_DutyCycle "" LINEAR "%17.13" "%" COEFFS_LINEAR 0.0030517578125 0 /end COMPU_METHOD
/begin COMPU_METHOD IoMotTemp.Adc_Result "" LINEAR "%19.12" "V" COEFFS_LINEAR 0.000244140625 0 /end COMPU_METHOD
/begin COMPU_METHOD IoMotTemp.Asw_Rstc_Ohm "" IDENTICAL "%12.6" "Ohm" /end COMPU_METHOD
/begin COMPU_METHOD IoMotTemp.Asw_Rstc_kOhm "" IDENTICAL "%12.6" "kOhm" /end COMPU_METHOD
/begin COMPU_METHOD IoMotTemp.Asw_SigQly "" TAB_VERB "%s" "" COMPU_TAB_REF IoMotTemp.CONV_TAB_Asw_SigQly /end COMPU_METHOD
/begin COMPU_METHOD IoMotTemp.Asw_Spd_rpm "" IDENTICAL "%12.6" "rpm" /end COMPU_METHOD
/begin COMPU_METHOD IoMotTemp.Asw_Temp_degC "" IDENTICAL "%6.1" "degC" /end COMPU_METHOD
/begin COMPU_METHOD IoMotTemp.Asw_Time_s "" IDENTICAL "%12.6" "s" /end COMPU_METHOD
/begin COMPU_METHOD IoMotTemp.Asw_Volt_V "" IDENTICAL "%12.6" "V" /end COMPU_METHOD
/begin COMPU_METHOD IoMotTemp.Dio_Level "" TAB_VERB "%3.0" "" COMPU_TAB_REF IoMotTemp.CONV_TAB_Dio_Level /end COMPU_METHOD
/begin COMPU_METHOD IoMotTemp.IDENTICAL_SCALING_FLOAT "" IDENTICAL "%12.6" "" /end COMPU_METHOD
/begin COMPU_METHOD IoMotTemp.IoMotTemp_CtrlrVrsn "" TAB_VERB "%d" "" COMPU_TAB_REF IoMotTemp.CONV_TAB_IoMotTemp_CtrlrVrsn /end COMPU_METHOD
/begin COMPU_METHOD IoMotTemp.IoMotTemp_EmTempSm "" TAB_VERB "%d" "" COMPU_TAB_REF IoMotTemp.CONV_TAB_IoMotTemp_EmTempSm /end COMPU_METHOD
/begin COMPU_METHOD IoMotTemp.IoMotTemp_SensType "" TAB_VERB "%d" "" COMPU_TAB_REF IoMotTemp.CONV_TAB_IoMotTemp_SensType /end COMPU_METHOD
/begin COMPU_METHOD IoMotTemp.IoMotTemp_WndgTempCalcnVarnt "" TAB_VERB "%d" "" COMPU_TAB_REF IoMotTemp.CONV_TAB_IoMotTemp_WndgTempCalcnVarnt /end COMPU_METHOD
/begin COMPU_METHOD IoMotTemp.LibTlHwIo_RngOvrrdMode "" TAB_VERB "%d" "" COMPU_TAB_REF IoMotTemp.CONV_TAB_LibTlHwIo_RngOvrrdMode /end COMPU_METHOD
/begin COMPU_METHOD IoPjSpecfc1.Asw_SigQly "" TAB_VERB "%s" "" COMPU_TAB_REF IoPjSpecfc1.CONV_TAB_Asw_SigQly /end COMPU_METHOD
/begin COMPU_METHOD IoPjSpecfc1.Dio_Level "" TAB_VERB "%3.0" "" COMPU_TAB_REF IoPjSpecfc1.CONV_TAB_Dio_Level /end COMPU_METHOD
/begin COMPU_METHOD IoPjSpecfc1.IDENTICAL_SCALING_FLOAT "" IDENTICAL "%12.6" "" /end COMPU_METHOD
/begin COMPU_METHOD IoWhlSpd.Asw_Frq_Hz "" IDENTICAL "%12.6" "Hz" /end COMPU_METHOD
/begin COMPU_METHOD IoWhlSpd.Asw_SigQly "" TAB_VERB "%s" "" COMPU_TAB_REF IoWhlSpd.CONV_TAB_Asw_SigQly /end COMPU_METHOD
/begin COMPU_METHOD IoWhlSpd.Asw_SpdRate_rpmps "" IDENTICAL "%12.6" "rpm/s" /end COMPU_METHOD
/begin COMPU_METHOD IoWhlSpd.Asw_Spd_rpm "" IDENTICAL "%12.6" "rpm" /end COMPU_METHOD
/begin COMPU_METHOD IoWhlSpd.IDENTICAL_SCALING_FLOAT "" IDENTICAL "%12.6" "" /end COMPU_METHOD
/begin COMPU_METHOD IoWhlSpd.IoWhlSpd_AxSpdDir "" TAB_VERB "%3.0" "" COMPU_TAB_REF IoWhlSpd.CONV_TAB_IoWhlSpd_AxSpdDir /end COMPU_METHOD
/begin COMPU_METHOD IoWhlSpd.IoWhlSpd_SpdSensSts "" TAB_VERB "%3.0" "" COMPU_TAB_REF IoWhlSpd.CONV_TAB_IoWhlSpd_SpdSensSts /end COMPU_METHOD
/begin COMPU_METHOD IoWhlSpd.WhlSpd_Frequency "" LINEAR "%20.12" "Hz" COEFFS_LINEAR 0.000244140625 0 /end COMPU_METHOD
/begin COMPU_METHOD Joule_2_minus_16_to_kWh "Joule * 2^-16 to kWh" LINEAR "%4.4" "kWh" COEFFS_LINEAR 4.23855251736E-12 0 /end COMPU_METHOD
/begin COMPU_METHOD LoadSpeedState "LoadSpeedState" TAB_VERB "%3.1" "" COMPU_TAB_REF LoadSpeedState /end COMPU_METHOD
/begin COMPU_METHOD LocalEQ_virtBit_177051 "" FORM "%12.6" "-" /begin FORMULA "(X1&1)>>0" /end FORMULA /end COMPU_METHOD
/begin COMPU_METHOD LocalEQ_virtBit_177053 "" FORM "%12.6" "-" /begin FORMULA "(X1&2)>>1" /end FORMULA /end COMPU_METHOD
/begin COMPU_METHOD LocalEQ_virtBit_177060 "" FORM "%12.6" "-" /begin FORMULA "(X1&4)>>2" /end FORMULA /end COMPU_METHOD
/begin COMPU_METHOD LocalEQ_virtBit_177067 "" FORM "%12.6" "-" /begin FORMULA "(X1&8)>>3" /end FORMULA /end COMPU_METHOD
/begin COMPU_METHOD LocalEQ_virtBit_177074 "" FORM "%12.6" "-" /begin FORMULA "(X1&16)>>4" /end FORMULA /end COMPU_METHOD
/begin COMPU_METHOD LocalEQ_virtBit_177081 "" FORM "%12.6" "-" /begin FORMULA "(X1&32)>>5" /end FORMULA /end COMPU_METHOD
/begin COMPU_METHOD LocalEQ_virtBit_177094 "" FORM "%12.6" "-" /begin FORMULA "(X1&1)>>0" /end FORMULA /end COMPU_METHOD
/begin COMPU_METHOD LocalEQ_virtBit_177096 "" FORM "%12.6" "-" /begin FORMULA "(X1&2)>>1" /end FORMULA /end COMPU_METHOD
/begin COMPU_METHOD LocalEQ_virtBit_177103 "" FORM "%12.6" "-" /begin FORMULA "(X1&4)>>2" /end FORMULA /end COMPU_METHOD
/begin COMPU_METHOD LocalEQ_virtBit_177110 "" FORM "%12.6" "-" /begin FORMULA "(X1&8)>>3" /end FORMULA /end COMPU_METHOD
/begin COMPU_METHOD LocalEQ_virtBit_177123 "" FORM "%12.6" "-" /begin FORMULA "(X1&1)>>0" /end FORMULA /end COMPU_METHOD
/begin COMPU_METHOD LocalEQ_virtBit_177125 "" FORM "%12.6" "-" /begin FORMULA "(X1&2)>>1" /end FORMULA /end COMPU_METHOD
/begin COMPU_METHOD LocalEQ_virtBit_177132 "" FORM "%12.6" "-" /begin FORMULA "(X1&4)>>2" /end FORMULA /end COMPU_METHOD
/begin COMPU_METHOD MPT_SignalStates "signal states" TAB_VERB "%3.1" "" COMPU_TAB_REF MPT_SignalStates /end COMPU_METHOD
/begin COMPU_METHOD MSE_TED_OperationTime "" LINEAR "%3.1" "seconds" COEFFS_LINEAR 0.01 0 /end COMPU_METHOD
/begin COMPU_METHOD MotorDirection "Motor direction" TAB_VERB "%3.1" "" COMPU_TAB_REF MotorDirection /end COMPU_METHOD
/begin COMPU_METHOD NVM_Internal_Errors "NVM-Internal Errors" TAB_VERB "%3.1" "" COMPU_TAB_REF NVM_Internal_Errors /end COMPU_METHOD
/begin COMPU_METHOD NVM_PAGE_NO "NVM Page Number" TAB_VERB "%3.0" "" COMPU_TAB_REF NVM_PAGE_NO /end COMPU_METHOD
/begin COMPU_METHOD NVM_PgSwitchState "NVM Page Switch State" TAB_VERB "%3.1" "" COMPU_TAB_REF NVM_PgSwitchState /end COMPU_METHOD
/begin COMPU_METHOD Offset_Calculation_Method "Offset calculation method" TAB_VERB "%2.1" "" COMPU_TAB_REF Offset_Calculation_Method /end COMPU_METHOD
/begin COMPU_METHOD PS.Asw_Ang_deg "" IDENTICAL "%12.6" "degree" /end COMPU_METHOD
/begin COMPU_METHOD PS.Asw_AngrVel_radps "" IDENTICAL "%12.6" "rad/s" /end COMPU_METHOD
/begin COMPU_METHOD PS.Asw_Curr_A "" IDENTICAL "%12.6" "A" /end COMPU_METHOD
/begin COMPU_METHOD PS.Asw_Frq_Hz "" IDENTICAL "%12.6" "Hz" /end COMPU_METHOD
/begin COMPU_METHOD PS.Asw_Len_mm "" IDENTICAL "%12.6" "mm" /end COMPU_METHOD
/begin COMPU_METHOD PS.Asw_MomOfInertia_kgm2 "" IDENTICAL "%12.6" "kg" /end COMPU_METHOD
/begin COMPU_METHOD PS.Asw_Pwr_W "" IDENTICAL "%12.6" "W" /end COMPU_METHOD
/begin COMPU_METHOD PS.Asw_QF "" TAB_VERB "%3.0" "" COMPU_TAB_REF PS.CONV_TAB_Asw_QF /end COMPU_METHOD
/begin COMPU_METHOD PS.Asw_QF_CDD "" TAB_VERB "%3.0" "ratio" COMPU_TAB_REF PS.CONV_TAB_Asw_QF_CDD /end COMPU_METHOD
/begin COMPU_METHOD PS.Asw_Ratio "" IDENTICAL "%12.6" "ratio" /end COMPU_METHOD
/begin COMPU_METHOD PS.Asw_Revolutions "" IDENTICAL "%12.6" "revolutions" /end COMPU_METHOD
/begin COMPU_METHOD PS.Asw_SigQly "" TAB_VERB "%s" "" COMPU_TAB_REF PS.CONV_TAB_Asw_SigQly /end COMPU_METHOD
/begin COMPU_METHOD PS.Asw_SpdRate_rpmps "" IDENTICAL "%12.6" "rpm/s" /end COMPU_METHOD
/begin COMPU_METHOD PS.Asw_Spd_rpm "" IDENTICAL "%12.6" "rpm" /end COMPU_METHOD
/begin COMPU_METHOD PS.Asw_Time2Millisec "" IDENTICAL "%5.0" "2 ms" /end COMPU_METHOD
/begin COMPU_METHOD PS.Asw_Time_s "" IDENTICAL "%12.6" "s" /end COMPU_METHOD
/begin COMPU_METHOD PS.Asw_Trq_Nm "" IDENTICAL "%12.6" "Nm" /end COMPU_METHOD
/begin COMPU_METHOD PS.Asw_Vel_kmh "" IDENTICAL "%12.6" "km/h" /end COMPU_METHOD
/begin COMPU_METHOD PS.Asw_VoltCDD_V "TargetLink Scaling Type voltage of controller output and battery" LINEAR "%13.10" "V" COEFFS_LINEAR 0.0009765625 0 /end COMPU_METHOD
/begin COMPU_METHOD PS.Asw_VoltTB_V "TargetLink Scaling Type voltage for testbench" LINEAR "%13.10" "V" COEFFS_LINEAR 0.0009765625 -32 /end COMPU_METHOD
/begin COMPU_METHOD PS.Asw_Volt_V "" IDENTICAL "%12.6" "V" /end COMPU_METHOD
/begin COMPU_METHOD PS.EQ_LSB_0_001953125 "" LINEAR "%13.9" "" COEFFS_LINEAR 0.001953125 0 /end COMPU_METHOD
/begin COMPU_METHOD PS.EQ_LSB_0_002 "" LINEAR "%7.3" "" COEFFS_LINEAR 0.002 0 /end COMPU_METHOD
/begin COMPU_METHOD PS.EQ_LSB_1 "" LINEAR "%3.0" "2ms" COEFFS_LINEAR 1 0 /end COMPU_METHOD
/end MODULE
/end PROJECT
