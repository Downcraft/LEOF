ASAP2_VERSION 1 70
/begin PROJECT bsw_structure ""
/begin MODULE CPP ""
/begin MOD_COMMON "" BYTE_ORDER MSB_LAST ALIGNMENT_BYTE 1 ALIGNMENT_WORD 2 ALIGNMENT_LONG 2 ALIGNMENT_FLOAT32_IEEE 2 ALIGNMENT_FLOAT64_IEEE 2 ALIGNMENT_INT64 2 /end MOD_COMMON
/begin MEASUREMENT V_MCU_Data.CPU1.0.PSPR_PCACHE_ME "" ULONG NO_COMPU_METHOD 0 0 0 4294967295 BIT_MASK 0x8 ECU_ADDRESS 0x70011741 FORMAT "%.15" SYMBOL_LINK "V_MCU_Data.CPU1" 0 /end MEASUREMENT
/begin MEASUREMENT V_MCU_Data.CPU1.0.PSPR_PCACHE_UCE "" ULONG NO_COMPU_METHOD 0 0 0 4294967295 BIT_MASK 0x4 ECU_ADDRESS 0x70011741 FORMAT "%.15" SYMBOL_LINK "V_MCU_Data.CPU1" 0 /end MEASUREMENT
/begin MEASUREMENT V_MCU_Data.CRC8 "CRC8" UBYTE NO_COMPU_METHOD 0 0 0 255 BIT_MASK 0xFF ECU_ADDRESS 0x7001174D FORMAT "%.15" /end MEASUREMENT
/begin MEASUREMENT V_MCU_Data.Clock.0.BCLK_OOR "" ULONG NO_COMPU_METHOD 0 0 0 4294967295 BIT_MASK 0x2 ECU_ADDRESS 0x70011743 FORMAT "%.15" SYMBOL_LINK "V_MCU_Data.Clock" 0 /end MEASUREMENT
/begin MEASUREMENT V_MCU_Data.Clock.0.CCU_CAM "" ULONG NO_COMPU_METHOD 0 0 0 4294967295 BIT_MASK 0x40 ECU_ADDRESS 0x70011743 FORMAT "%.15" SYMBOL_LINK "V_MCU_Data.Clock" 0 /end MEASUREMENT
/begin MEASUREMENT V_MCU_Data.Clock.0.CLK_ALIVE_MON "" ULONG NO_COMPU_METHOD 0 0 0 4294967295 BIT_MASK 0x4 ECU_ADDRESS 0x70011743 FORMAT "%.15" SYMBOL_LINK "V_MCU_Data.Clock" 0 /end MEASUREMENT
/begin MEASUREMENT V_MCU_Data.Clock.0.CLK_PLAUSIB "" ULONG NO_COMPU_METHOD 0 0 0 4294967295 BIT_MASK 0x20 ECU_ADDRESS 0x70011743 FORMAT "%.15" SYMBOL_LINK "V_MCU_Data.Clock" 0 /end MEASUREMENT
/begin MEASUREMENT V_MCU_Data.Clock.0.OSC_OOR "" ULONG NO_COMPU_METHOD 0 0 0 4294967295 BIT_MASK 0x1 ECU_ADDRESS 0x70011743 FORMAT "%.15" SYMBOL_LINK "V_MCU_Data.Clock" 0 /end MEASUREMENT
/begin MEASUREMENT V_MCU_Data.Clock.0.PERI_PLL_LOL "" ULONG NO_COMPU_METHOD 0 0 0 4294967295 BIT_MASK 0x10 ECU_ADDRESS 0x70011743 FORMAT "%.15" SYMBOL_LINK "V_MCU_Data.Clock" 0 /end MEASUREMENT
/begin MEASUREMENT V_MCU_Data.Clock.0.STM_MON "" ULONG NO_COMPU_METHOD 0 0 0 4294967295 BIT_MASK 0x80 ECU_ADDRESS 0x70011743 FORMAT "%.15" SYMBOL_LINK "V_MCU_Data.Clock" 0 /end MEASUREMENT
/begin MEASUREMENT V_MCU_Data.Clock.0.SYS_PLL_LOL "" ULONG NO_COMPU_METHOD 0 0 0 4294967295 BIT_MASK 0x8 ECU_ADDRESS 0x70011743 FORMAT "%.15" SYMBOL_LINK "V_MCU_Data.Clock" 0 /end MEASUREMENT
/begin MEASUREMENT V_MCU_Data.Lockstep.0.CPU0_CompErr "" ULONG NO_COMPU_METHOD 0 0 0 4294967295 BIT_MASK 0x1 ECU_ADDRESS 0x70011744 FORMAT "%.15" SYMBOL_LINK "V_MCU_Data.Lockstep" 0 /end MEASUREMENT
/begin MEASUREMENT V_MCU_Data.Lockstep.0.CPU1_CompErr "" ULONG NO_COMPU_METHOD 0 0 0 4294967295 BIT_MASK 0x2 ECU_ADDRESS 0x70011744 FORMAT "%.15" SYMBOL_LINK "V_MCU_Data.Lockstep" 0 /end MEASUREMENT
/begin MEASUREMENT V_MCU_Data.Lockstep.0.DualRailErr "" ULONG NO_COMPU_METHOD 0 0 0 4294967295 BIT_MASK 0x10 ECU_ADDRESS 0x70011744 FORMAT "%.15" SYMBOL_LINK "V_MCU_Data.Lockstep" 0 /end MEASUREMENT
/begin MEASUREMENT V_MCU_Data.Lockstep.0.reserved "" ULONG NO_COMPU_METHOD 0 0 0 4294967295 BIT_MASK 0xE0 ECU_ADDRESS 0x70011744 FORMAT "%.15" SYMBOL_LINK "V_MCU_Data.Lockstep" 0 /end MEASUREMENT
/begin MEASUREMENT V_MCU_Data.Lockstep.0.reserved0 "" ULONG NO_COMPU_METHOD 0 0 0 4294967295 BIT_MASK 0x4 ECU_ADDRESS 0x70011744 FORMAT "%.15" SYMBOL_LINK "V_MCU_Data.Lockstep" 0 /end MEASUREMENT
/begin MEASUREMENT V_MCU_Data.Lockstep.0.reserved1 "" ULONG NO_COMPU_METHOD 0 0 0 4294967295 BIT_MASK 0x8 ECU_ADDRESS 0x70011744 FORMAT "%.15" SYMBOL_LINK "V_MCU_Data.Lockstep" 0 /end MEASUREMENT
/begin MEASUREMENT V_MCU_Data.MISC.0.CPU0_TRAP "" ULONG NO_COMPU_METHOD 0 0 0 4294967295 BIT_MASK 0x1 ECU_ADDRESS 0x7001173C FORMAT "%.15" SYMBOL_LINK "V_MCU_Data.MISC" 0 /end MEASUREMENT
/begin MEASUREMENT V_MCU_Data.MISC.0.CPU1_TRAP "" ULONG NO_COMPU_METHOD 0 0 0 4294967295 BIT_MASK 0x2 ECU_ADDRESS 0x7001173C FORMAT "%.15" SYMBOL_LINK "V_MCU_Data.MISC" 0 /end MEASUREMENT
/begin MEASUREMENT V_MCU_Data.MISC.0.CPU2_TRAP "" ULONG NO_COMPU_METHOD 0 0 0 4294967295 BIT_MASK 0x4 ECU_ADDRESS 0x7001173C FORMAT "%.15" SYMBOL_LINK "V_MCU_Data.MISC" 0 /end MEASUREMENT
/begin MEASUREMENT V_MCU_Data.MISC.0.EmergencyStop "" ULONG NO_COMPU_METHOD 0 0 0 4294967295 BIT_MASK 0x400 ECU_ADDRESS 0x7001173C FORMAT "%.15" SYMBOL_LINK "V_MCU_Data.MISC" 0 /end MEASUREMENT
/begin MEASUREMENT V_MCU_Data.MISC.0.IM_DPE "" ULONG NO_COMPU_METHOD 0 0 0 4294967295 BIT_MASK 0x40 ECU_ADDRESS 0x7001173C FORMAT "%.15" SYMBOL_LINK "V_MCU_Data.MISC" 0 /end MEASUREMENT
/begin MEASUREMENT V_MCU_Data.MISC.0.IOM_PinMismatch "" ULONG NO_COMPU_METHOD 0 0 0 4294967295 BIT_MASK 0x200 ECU_ADDRESS 0x7001173C FORMAT "%.15" SYMBOL_LINK "V_MCU_Data.MISC" 0 /end MEASUREMENT
/begin MEASUREMENT V_MCU_Data.MISC.0.LBIST_SRS "" ULONG NO_COMPU_METHOD 0 0 0 4294967295 BIT_MASK 0x8 ECU_ADDRESS 0x7001173C FORMAT "%.15" SYMBOL_LINK "V_MCU_Data.MISC" 0 /end MEASUREMENT
/begin MEASUREMENT V_MCU_Data.MISC.0.LBIST_TMA "" ULONG NO_COMPU_METHOD 0 0 0 4294967295 BIT_MASK 0x20 ECU_ADDRESS 0x7001173C FORMAT "%.15" SYMBOL_LINK "V_MCU_Data.MISC" 0 /end MEASUREMENT
/begin MEASUREMENT V_MCU_Data.MISC.0.PadHeating "" ULONG NO_COMPU_METHOD 0 0 0 4294967295 BIT_MASK 0x10 ECU_ADDRESS 0x7001173C FORMAT "%.15" SYMBOL_LINK "V_MCU_Data.MISC" 0 /end MEASUREMENT
/begin MEASUREMENT V_MCU_Data.MISC.0.RecTimer1 "" ULONG NO_COMPU_METHOD 0 0 0 4294967295 BIT_MASK 0x80 ECU_ADDRESS 0x7001173C FORMAT "%.15" SYMBOL_LINK "V_MCU_Data.MISC" 0 /end MEASUREMENT
/begin MEASUREMENT V_MCU_Data.MISC.0.SWD_TimeOut "" ULONG NO_COMPU_METHOD 0 0 0 4294967295 BIT_MASK 0x2000 ECU_ADDRESS 0x7001173C FORMAT "%.15" SYMBOL_LINK "V_MCU_Data.MISC" 0 /end MEASUREMENT
/begin MEASUREMENT V_MCU_Data.MISC.0.SW_Alarm "" ULONG NO_COMPU_METHOD 0 0 0 4294967295 BIT_MASK 0x800 ECU_ADDRESS 0x7001173C FORMAT "%.15" SYMBOL_LINK "V_MCU_Data.MISC" 0 /end MEASUREMENT
/begin MEASUREMENT V_MCU_Data.MISC.0.WD_CPU0_TimeOut "" ULONG NO_COMPU_METHOD 0 0 0 4294967295 BIT_MASK 0x8000 ECU_ADDRESS 0x7001173C FORMAT "%.15" SYMBOL_LINK "V_MCU_Data.MISC" 0 /end MEASUREMENT
/begin MEASUREMENT V_MCU_Data.MISC.0.WD_CPU1_TimeOut "" ULONG NO_COMPU_METHOD 0 0 0 4294967295 BIT_MASK 0x4000 ECU_ADDRESS 0x7001173C FORMAT "%.15" SYMBOL_LINK "V_MCU_Data.MISC" 0 /end MEASUREMENT
/begin MEASUREMENT V_MCU_Data.MISC.0.WD_TimeOut "" ULONG NO_COMPU_METHOD 0 0 0 4294967295 BIT_MASK 0x1000 ECU_ADDRESS 0x7001173C FORMAT "%.15" SYMBOL_LINK "V_MCU_Data.MISC" 0 /end MEASUREMENT
/begin MEASUREMENT V_MCU_Data.MISC.0.reserved0 "" ULONG NO_COMPU_METHOD 0 0 0 4294967295 BIT_MASK 0x100 ECU_ADDRESS 0x7001173C FORMAT "%.15" SYMBOL_LINK "V_MCU_Data.MISC" 0 /end MEASUREMENT
/begin MEASUREMENT V_MCU_Data.PERIF.0.CAN_ME "" ULONG NO_COMPU_METHOD 0 0 0 4294967295 BIT_MASK 0x8 ECU_ADDRESS 0x70011742 FORMAT "%.15" SYMBOL_LINK "V_MCU_Data.PERIF" 0 /end MEASUREMENT
/begin MEASUREMENT V_MCU_Data.PERIF.0.CAN_UCE "" ULONG NO_COMPU_METHOD 0 0 0 4294967295 BIT_MASK 0x4 ECU_ADDRESS 0x70011742 FORMAT "%.15" SYMBOL_LINK "V_MCU_Data.PERIF" 0 /end MEASUREMENT
/begin MEASUREMENT V_MCU_Data.PERIF.0.GTM_ME "" ULONG NO_COMPU_METHOD 0 0 0 4294967295 BIT_MASK 0x2 ECU_ADDRESS 0x70011742 FORMAT "%.15" SYMBOL_LINK "V_MCU_Data.PERIF" 0 /end MEASUREMENT
/begin MEASUREMENT V_MCU_Data.PERIF.0.GTM_UCE "" ULONG NO_COMPU_METHOD 0 0 0 4294967295 BIT_MASK 0x1 ECU_ADDRESS 0x70011742 FORMAT "%.15" SYMBOL_LINK "V_MCU_Data.PERIF" 0 /end MEASUREMENT
/begin MEASUREMENT V_MCU_Data.PERIF.0.LMU_FSI_RAM_ME "" ULONG NO_COMPU_METHOD 0 0 0 4294967295 BIT_MASK 0x80 ECU_ADDRESS 0x70011742 FORMAT "%.15" SYMBOL_LINK "V_MCU_Data.PERIF" 0 /end MEASUREMENT
/begin MEASUREMENT V_MCU_Data.PERIF.0.LMU_FSI_RAM_UCE "" ULONG NO_COMPU_METHOD 0 0 0 4294967295 BIT_MASK 0x40 ECU_ADDRESS 0x70011742 FORMAT "%.15" SYMBOL_LINK "V_MCU_Data.PERIF" 0 /end MEASUREMENT
/begin MEASUREMENT V_MCU_Data.PERIF.0.MISC_ME "" ULONG NO_COMPU_METHOD 0 0 0 4294967295 BIT_MASK 0x20 ECU_ADDRESS 0x70011742 FORMAT "%.15" SYMBOL_LINK "V_MCU_Data.PERIF" 0 /end MEASUREMENT
/begin MEASUREMENT V_MCU_Data.PERIF.0.MISC_UCE "" ULONG NO_COMPU_METHOD 0 0 0 4294967295 BIT_MASK 0x10 ECU_ADDRESS 0x70011742 FORMAT "%.15" SYMBOL_LINK "V_MCU_Data.PERIF" 0 /end MEASUREMENT
/begin MEASUREMENT V_MCU_Data.PFLASH.0.CPU0_ReadPathErr "" ULONG NO_COMPU_METHOD 0 0 0 4294967295 BIT_MASK 0x1 ECU_ADDRESS 0x7001173E FORMAT "%.15" SYMBOL_LINK "V_MCU_Data.PFLASH" 0 /end MEASUREMENT
/begin MEASUREMENT V_MCU_Data.PFLASH.0.CPU1_ReadPathErr "" ULONG NO_COMPU_METHOD 0 0 0 4294967295 BIT_MASK 0x2 ECU_ADDRESS 0x7001173E FORMAT "%.15" SYMBOL_LINK "V_MCU_Data.PFLASH" 0 /end MEASUREMENT
/begin MEASUREMENT V_MCU_Data.PFLASH.0.ECC_DBC_TBF "" ULONG NO_COMPU_METHOD 0 0 0 4294967295 BIT_MASK 0x8 ECU_ADDRESS 0x7001173E FORMAT "%.15" SYMBOL_LINK "V_MCU_Data.PFLASH" 0 /end MEASUREMENT
/begin MEASUREMENT V_MCU_Data.PFLASH.0.ECC_Error "" ULONG NO_COMPU_METHOD 0 0 0 4294967295 BIT_MASK 0x40 ECU_ADDRESS 0x7001173E FORMAT "%.15" SYMBOL_LINK "V_MCU_Data.PFLASH" 0 /end MEASUREMENT
/begin MEASUREMENT V_MCU_Data.PFLASH.0.ECC_MBC_TBF "" ULONG NO_COMPU_METHOD 0 0 0 4294967295 BIT_MASK 0x10 ECU_ADDRESS 0x7001173E FORMAT "%.15" SYMBOL_LINK "V_MCU_Data.PFLASH" 0 /end MEASUREMENT
/begin MEASUREMENT V_MCU_Data.PFLASH.0.ECC_SBC_TBF "" ULONG NO_COMPU_METHOD 0 0 0 4294967295 BIT_MASK 0x4 ECU_ADDRESS 0x7001173E FORMAT "%.15" SYMBOL_LINK "V_MCU_Data.PFLASH" 0 /end MEASUREMENT
/begin MEASUREMENT V_MCU_Data.PFLASH.0.ECC_ZBE_TBF "" ULONG NO_COMPU_METHOD 0 0 0 4294967295 BIT_MASK 0x20 ECU_ADDRESS 0x7001173E FORMAT "%.15" SYMBOL_LINK "V_MCU_Data.PFLASH" 0 /end MEASUREMENT
/begin MEASUREMENT V_MCU_Data.PFLASH.0.EDC_Error "" ULONG NO_COMPU_METHOD 0 0 0 4294967295 BIT_MASK 0x80 ECU_ADDRESS 0x7001173E FORMAT "%.15" SYMBOL_LINK "V_MCU_Data.PFLASH" 0 /end MEASUREMENT
/begin MEASUREMENT V_MCU_Data.PFLASH.0.FlashConfigErr "" ULONG NO_COMPU_METHOD 0 0 0 4294967295 BIT_MASK 0x100 ECU_ADDRESS 0x7001173E FORMAT "%.15" SYMBOL_LINK "V_MCU_Data.PFLASH" 0 /end MEASUREMENT
/begin MEASUREMENT V_MCU_Data.PFLASH.0.FlashStoredConfigErr "" ULONG NO_COMPU_METHOD 0 0 0 4294967295 BIT_MASK 0x200 ECU_ADDRESS 0x7001173E FORMAT "%.15" SYMBOL_LINK "V_MCU_Data.PFLASH" 0 /end MEASUREMENT
/begin MEASUREMENT V_MCU_Data.PFLASH.0.reserved "" ULONG NO_COMPU_METHOD 0 0 0 4294967295 BIT_MASK 0x7E00 ECU_ADDRESS 0x7001173E FORMAT "%.15" SYMBOL_LINK "V_MCU_Data.PFLASH" 0 /end MEASUREMENT
/begin MEASUREMENT V_MCU_Data.ResetType "MCU reset type" SLONG MCU_Reset_Type 0 0 -2147483648 2147483647 BIT_MASK 0xFFFFFFFF ECU_ADDRESS 0x70011730 FORMAT "%.15" /end MEASUREMENT
/begin MEASUREMENT V_MCU_Data.SFF.0.CBS_UCE "" ULONG NO_COMPU_METHOD 0 0 0 4294967295 BIT_MASK 0x80 ECU_ADDRESS 0x7001173A FORMAT "%.15" SYMBOL_LINK "V_MCU_Data.SFF" 0 /end MEASUREMENT
/begin MEASUREMENT V_MCU_Data.SFF.0.CCU_CE "" ULONG NO_COMPU_METHOD 0 0 0 4294967295 BIT_MASK 0x100 ECU_ADDRESS 0x7001173A FORMAT "%.15" SYMBOL_LINK "V_MCU_Data.SFF" 0 /end MEASUREMENT
/begin MEASUREMENT V_MCU_Data.SFF.0.CCU_UCE "" ULONG NO_COMPU_METHOD 0 0 0 4294967295 BIT_MASK 0x200 ECU_ADDRESS 0x7001173A FORMAT "%.15" SYMBOL_LINK "V_MCU_Data.SFF" 0 /end MEASUREMENT
/begin MEASUREMENT V_MCU_Data.SFF.0.DMA_UCE "" ULONG NO_COMPU_METHOD 0 0 0 4294967295 BIT_MASK 0x20 ECU_ADDRESS 0x7001173A FORMAT "%.15" SYMBOL_LINK "V_MCU_Data.SFF" 0 /end MEASUREMENT
/begin MEASUREMENT V_MCU_Data.SFF.0.INT_UCE "" ULONG NO_COMPU_METHOD 0 0 0 4294967295 BIT_MASK 0x4 ECU_ADDRESS 0x7001173A FORMAT "%.15" SYMBOL_LINK "V_MCU_Data.SFF" 0 /end MEASUREMENT
/begin MEASUREMENT V_MCU_Data.SFF.0.IOM_UCE "" ULONG NO_COMPU_METHOD 0 0 0 4294967295 BIT_MASK 0x2 ECU_ADDRESS 0x7001173A FORMAT "%.15" SYMBOL_LINK "V_MCU_Data.SFF" 0 /end MEASUREMENT
/begin MEASUREMENT V_MCU_Data.SFF.0.MTU_UCE "" ULONG NO_COMPU_METHOD 0 0 0 4294967295 BIT_MASK 0x1 ECU_ADDRESS 0x7001173A FORMAT "%.15" SYMBOL_LINK "V_MCU_Data.SFF" 0 /end MEASUREMENT
/begin MEASUREMENT V_MCU_Data.SFF.0.PMS_UCE "" ULONG NO_COMPU_METHOD 0 0 0 4294967295 BIT_MASK 0x10 ECU_ADDRESS 0x7001173A FORMAT "%.15" SYMBOL_LINK "V_MCU_Data.SFF" 0 /end MEASUREMENT
/begin MEASUREMENT V_MCU_Data.SFF.0.SCU_UCE "" ULONG NO_COMPU_METHOD 0 0 0 4294967295 BIT_MASK 0x8 ECU_ADDRESS 0x7001173A FORMAT "%.15" SYMBOL_LINK "V_MCU_Data.SFF" 0 /end MEASUREMENT
/begin MEASUREMENT V_MCU_Data.SFF.0.SMU_CORE_UCE "" ULONG NO_COMPU_METHOD 0 0 0 4294967295 BIT_MASK 0x40 ECU_ADDRESS 0x7001173A FORMAT "%.15" SYMBOL_LINK "V_MCU_Data.SFF" 0 /end MEASUREMENT
/begin MEASUREMENT V_MCU_Data.SFF.0.reserved "" ULONG NO_COMPU_METHOD 0 0 0 4294967295 BIT_MASK 0x7C00 ECU_ADDRESS 0x7001173A FORMAT "%.15" SYMBOL_LINK "V_MCU_Data.SFF" 0 /end MEASUREMENT
/begin MEASUREMENT V_MCU_Data.SRI.0.CONV_PSE "" ULONG NO_COMPU_METHOD 0 0 0 4294967295 BIT_MASK 0x4000 ECU_ADDRESS 0x70011738 FORMAT "%.15" SYMBOL_LINK "V_MCU_Data.SRI" 0 /end MEASUREMENT
/begin MEASUREMENT V_MCU_Data.SRI.0.CPU0_DIE "" ULONG NO_COMPU_METHOD 0 0 0 4294967295 BIT_MASK 0x2 ECU_ADDRESS 0x70011738 FORMAT "%.15" SYMBOL_LINK "V_MCU_Data.SRI" 0 /end MEASUREMENT
/begin MEASUREMENT V_MCU_Data.SRI.0.CPU0_IFE "" ULONG NO_COMPU_METHOD 0 0 0 4294967295 BIT_MASK 0x1 ECU_ADDRESS 0x70011738 FORMAT "%.15" SYMBOL_LINK "V_MCU_Data.SRI" 0 /end MEASUREMENT
/begin MEASUREMENT V_MCU_Data.SRI.0.CPU1_DIE "" ULONG NO_COMPU_METHOD 0 0 0 4294967295 BIT_MASK 0x8 ECU_ADDRESS 0x70011738 FORMAT "%.15" SYMBOL_LINK "V_MCU_Data.SRI" 0 /end MEASUREMENT
/begin MEASUREMENT V_MCU_Data.SRI.0.CPU1_IFE "" ULONG NO_COMPU_METHOD 0 0 0 4294967295 BIT_MASK 0x4 ECU_ADDRESS 0x70011738 FORMAT "%.15" SYMBOL_LINK "V_MCU_Data.SRI" 0 /end MEASUREMENT
/begin MEASUREMENT V_MCU_Data.SRI.0.DMA_ECC_Err "" ULONG NO_COMPU_METHOD 0 0 0 4294967295 BIT_MASK 0x20 ECU_ADDRESS 0x70011738 FORMAT "%.15" SYMBOL_LINK "V_MCU_Data.SRI" 0 /end MEASUREMENT
/begin MEASUREMENT V_MCU_Data.SRI.0.DMU_APE "" ULONG NO_COMPU_METHOD 0 0 0 4294967295 BIT_MASK 0x400 ECU_ADDRESS 0x70011738 FORMAT "%.15" SYMBOL_LINK "V_MCU_Data.SRI" 0 /end MEASUREMENT
/begin MEASUREMENT V_MCU_Data.SRI.0.DMU_WPE "" ULONG NO_COMPU_METHOD 0 0 0 4294967295 BIT_MASK 0x800 ECU_ADDRESS 0x70011738 FORMAT "%.15" SYMBOL_LINK "V_MCU_Data.SRI" 0 /end MEASUREMENT
/begin MEASUREMENT V_MCU_Data.SRI.0.HSSLO_RPE "" ULONG NO_COMPU_METHOD 0 0 0 4294967295 BIT_MASK 0x2000 ECU_ADDRESS 0x70011738 FORMAT "%.15" SYMBOL_LINK "V_MCU_Data.SRI" 0 /end MEASUREMENT
/begin MEASUREMENT V_MCU_Data.SRI.0.LMU_APE "" ULONG NO_COMPU_METHOD 0 0 0 4294967295 BIT_MASK 0x40 ECU_ADDRESS 0x70011738 FORMAT "%.15" SYMBOL_LINK "V_MCU_Data.SRI" 0 /end MEASUREMENT
/begin MEASUREMENT V_MCU_Data.SRI.0.LMU_WPE "" ULONG NO_COMPU_METHOD 0 0 0 4294967295 BIT_MASK 0x80 ECU_ADDRESS 0x70011738 FORMAT "%.15" SYMBOL_LINK "V_MCU_Data.SRI" 0 /end MEASUREMENT
/begin MEASUREMENT V_MCU_Data.SRI.0.SFIBRIDGE1_RPE "" ULONG NO_COMPU_METHOD 0 0 0 4294967295 BIT_MASK 0x1000 ECU_ADDRESS 0x70011738 FORMAT "%.15" SYMBOL_LINK "V_MCU_Data.SRI" 0 /end MEASUREMENT
/begin MEASUREMENT V_MCU_Data.SRI.0.SOTA_SwapErr "" ULONG NO_COMPU_METHOD 0 0 0 4294967295 BIT_MASK 0x8000 ECU_ADDRESS 0x70011738 FORMAT "%.15" SYMBOL_LINK "V_MCU_Data.SRI" 0 /end MEASUREMENT
/begin MEASUREMENT V_MCU_Data.SRI.0.SRI_APE "" ULONG NO_COMPU_METHOD 0 0 0 4294967295 BIT_MASK 0x100 ECU_ADDRESS 0x70011738 FORMAT "%.15" SYMBOL_LINK "V_MCU_Data.SRI" 0 /end MEASUREMENT
/begin MEASUREMENT V_MCU_Data.SRI.0.SRI_WPE "" ULONG NO_COMPU_METHOD 0 0 0 4294967295 BIT_MASK 0x200 ECU_ADDRESS 0x70011738 FORMAT "%.15" SYMBOL_LINK "V_MCU_Data.SRI" 0 /end MEASUREMENT
/begin MEASUREMENT V_MCU_Data.SRI.0.XBAR_BEE "" ULONG NO_COMPU_METHOD 0 0 0 4294967295 BIT_MASK 0x10 ECU_ADDRESS 0x70011738 FORMAT "%.15" SYMBOL_LINK "V_MCU_Data.SRI" 0 /end MEASUREMENT
/begin MEASUREMENT V_MCU_Data.SVM.0.VCORE_OV "" ULONG NO_COMPU_METHOD 0 0 0 4294967295 BIT_MASK 0x10 ECU_ADDRESS 0x70011736 FORMAT "%.15" SYMBOL_LINK "V_MCU_Data.SVM" 0 /end MEASUREMENT
/begin MEASUREMENT V_MCU_Data.SVM.0.VCORE_UV "" ULONG NO_COMPU_METHOD 0 0 0 4294967295 BIT_MASK 0x20 ECU_ADDRESS 0x70011736 FORMAT "%.15" SYMBOL_LINK "V_MCU_Data.SVM" 0 /end MEASUREMENT
/begin MEASUREMENT V_MCU_Data.SVM.0.VDDM_OV "" ULONG NO_COMPU_METHOD 0 0 0 4294967295 BIT_MASK 0x1 ECU_ADDRESS 0x70011736 FORMAT "%.15" SYMBOL_LINK "V_MCU_Data.SVM" 0 /end MEASUREMENT
/begin MEASUREMENT V_MCU_Data.SVM.0.VDDM_UV "" ULONG NO_COMPU_METHOD 0 0 0 4294967295 BIT_MASK 0x2 ECU_ADDRESS 0x70011736 FORMAT "%.15" SYMBOL_LINK "V_MCU_Data.SVM" 0 /end MEASUREMENT
/begin MEASUREMENT V_MCU_Data.SVM.0.VEXT_OV "" ULONG NO_COMPU_METHOD 0 0 0 4294967295 BIT_MASK 0x4 ECU_ADDRESS 0x70011736 FORMAT "%.15" SYMBOL_LINK "V_MCU_Data.SVM" 0 /end MEASUREMENT
/begin MEASUREMENT V_MCU_Data.SVM.0.VEXT_UV "" ULONG NO_COMPU_METHOD 0 0 0 4294967295 BIT_MASK 0x8 ECU_ADDRESS 0x70011736 FORMAT "%.15" SYMBOL_LINK "V_MCU_Data.SVM" 0 /end MEASUREMENT
/begin MEASUREMENT V_MCU_Data.SVM.0.reserved "" ULONG NO_COMPU_METHOD 0 0 0 4294967295 BIT_MASK 0xFFC0 ECU_ADDRESS 0x70011736 FORMAT "%.15" SYMBOL_LINK "V_MCU_Data.SVM" 0 /end MEASUREMENT
/begin MEASUREMENT V_MCU_Data.StartUpResults.0.CORE_SRAM_REG_MON_NOK "" ULONG NO_COMPU_METHOD 0 0 0 4294967295 BIT_MASK 0x400 ECU_ADDRESS 0x70011734 FORMAT "%.15" SYMBOL_LINK "V_MCU_Data.StartUpResults" 0 /end MEASUREMENT
/begin MEASUREMENT V_MCU_Data.StartUpResults.0.FIRMWARE_NOK "" ULONG NO_COMPU_METHOD 0 0 0 4294967295 BIT_MASK 0x4 ECU_ADDRESS 0x70011734 FORMAT "%.15" SYMBOL_LINK "V_MCU_Data.StartUpResults" 0 /end MEASUREMENT
/begin MEASUREMENT V_MCU_Data.StartUpResults.0.LBIST_NOK "" ULONG NO_COMPU_METHOD 0 0 0 4294967295 BIT_MASK 0x1 ECU_ADDRESS 0x70011734 FORMAT "%.15" SYMBOL_LINK "V_MCU_Data.StartUpResults" 0 /end MEASUREMENT
/begin MEASUREMENT V_MCU_Data.StartUpResults.0.MBIST_GANG0_CHECK_NOK "" ULONG NO_COMPU_METHOD 0 0 0 4294967295 BIT_MASK 0x40 ECU_ADDRESS 0x70011734 FORMAT "%.15" SYMBOL_LINK "V_MCU_Data.StartUpResults" 0 /end MEASUREMENT
/begin MEASUREMENT V_MCU_Data.StartUpResults.0.MBIST_GANG1_CHECK_NOK "" ULONG NO_COMPU_METHOD 0 0 0 4294967295 BIT_MASK 0x80 ECU_ADDRESS 0x70011734 FORMAT "%.15" SYMBOL_LINK "V_MCU_Data.StartUpResults" 0 /end MEASUREMENT
/begin MEASUREMENT V_MCU_Data.StartUpResults.0.MBIST_GANG2_CHECK_NOK "" ULONG NO_COMPU_METHOD 0 0 0 4294967295 BIT_MASK 0x100 ECU_ADDRESS 0x70011734 FORMAT "%.15" SYMBOL_LINK "V_MCU_Data.StartUpResults" 0 /end MEASUREMENT
/begin MEASUREMENT V_MCU_Data.StartUpResults.0.MBIST_GANG3_CHECK_NOK "" ULONG NO_COMPU_METHOD 0 0 0 4294967295 BIT_MASK 0x200 ECU_ADDRESS 0x70011734 FORMAT "%.15" SYMBOL_LINK "V_MCU_Data.StartUpResults" 0 /end MEASUREMENT
/begin MEASUREMENT V_MCU_Data.StartUpResults.0.PERI_SRAM_REG_MON_NOK "" ULONG NO_COMPU_METHOD 0 0 0 4294967295 BIT_MASK 0x800 ECU_ADDRESS 0x70011734 FORMAT "%.15" SYMBOL_LINK "V_MCU_Data.StartUpResults" 0 /end MEASUREMENT
/begin MEASUREMENT V_MCU_Data.StartUpResults.0.PMS_MONBIST_NOK "" ULONG NO_COMPU_METHOD 0 0 0 4294967295 BIT_MASK 0x2 ECU_ADDRESS 0x70011734 FORMAT "%.15" SYMBOL_LINK "V_MCU_Data.StartUpResults" 0 /end MEASUREMENT
/begin MEASUREMENT V_MCU_Data.StartUpResults.0.SAFETY_REGISTER_NOK "" ULONG NO_COMPU_METHOD 0 0 0 4294967295 BIT_MASK 0x8 ECU_ADDRESS 0x70011734 FORMAT "%.15" SYMBOL_LINK "V_MCU_Data.StartUpResults" 0 /end MEASUREMENT
/begin MEASUREMENT V_MCU_Data.StartUpResults.0.SMU_ALIVE_ALARM_NOK "" ULONG NO_COMPU_METHOD 0 0 0 4294967295 BIT_MASK 0x10 ECU_ADDRESS 0x70011734 FORMAT "%.15" SYMBOL_LINK "V_MCU_Data.StartUpResults" 0 /end MEASUREMENT
/begin MEASUREMENT V_MCU_Data.StartUpResults.0.SMU_REG_MON_NOK "" ULONG NO_COMPU_METHOD 0 0 0 4294967295 BIT_MASK 0x20 ECU_ADDRESS 0x70011734 FORMAT "%.15" SYMBOL_LINK "V_MCU_Data.StartUpResults" 0 /end MEASUREMENT
/begin MEASUREMENT V_MCU_Data.StartUpResults.0.STSTAT_HWCFG_1 "" ULONG NO_COMPU_METHOD 0 0 0 4294967295 BIT_MASK 0x1000 ECU_ADDRESS 0x70011734 FORMAT "%.15" SYMBOL_LINK "V_MCU_Data.StartUpResults" 0 /end MEASUREMENT
/begin MEASUREMENT V_MCU_Data.StartUpResults.0.STSTAT_HWCFG_2 "" ULONG NO_COMPU_METHOD 0 0 0 4294967295 BIT_MASK 0x2000 ECU_ADDRESS 0x70011734 FORMAT "%.15" SYMBOL_LINK "V_MCU_Data.StartUpResults" 0 /end MEASUREMENT
/begin MEASUREMENT V_MCU_Data.StartUpResults.0.STSTAT_HWCFG_6 "" ULONG NO_COMPU_METHOD 0 0 0 4294967295 BIT_MASK 0x4000 ECU_ADDRESS 0x70011734 FORMAT "%.15" SYMBOL_LINK "V_MCU_Data.StartUpResults" 0 /end MEASUREMENT
/begin MEASUREMENT V_MCU_Data.StartUpResults.0.reserved "" ULONG NO_COMPU_METHOD 0 0 0 4294967295 BIT_MASK 0x8000 ECU_ADDRESS 0x70011734 FORMAT "%.15" SYMBOL_LINK "V_MCU_Data.StartUpResults" 0 /end MEASUREMENT
/begin MEASUREMENT V_MCU_Data.State "MCU State" SLONG MCU_State_Method 0 0 -2147483648 2147483647 BIT_MASK 0xFFFFFFFF ECU_ADDRESS 0x70011748 FORMAT "%.15" /end MEASUREMENT
/begin MEASUREMENT V_MCU_Data.State_Inv "MCU State inverse" UBYTE NO_COMPU_METHOD 0 0 0 255 BIT_MASK 0xFF ECU_ADDRESS 0x7001174C FORMAT "%.15" /end MEASUREMENT
/begin MEASUREMENT V_MCU_Data.TempMon.0.CPU_DIE_TEMP_HIGH "" ULONG NO_COMPU_METHOD 0 0 0 4294967295 BIT_MASK 0x1 ECU_ADDRESS 0x70011746 FORMAT "%.15" SYMBOL_LINK "V_MCU_Data.TempMon" 0 /end MEASUREMENT
/begin MEASUREMENT V_MCU_Data.TempMon.0.DIE_TEMP_CROSS "" ULONG NO_COMPU_METHOD 0 0 0 4294967295 BIT_MASK 0x4 ECU_ADDRESS 0x70011746 FORMAT "%.15" SYMBOL_LINK "V_MCU_Data.TempMon" 0 /end MEASUREMENT
/begin MEASUREMENT V_MCU_Data.TempMon.0.DIE_TEMP_GRADIENT "" ULONG NO_COMPU_METHOD 0 0 0 4294967295 BIT_MASK 0x8 ECU_ADDRESS 0x70011746 FORMAT "%.15" SYMBOL_LINK "V_MCU_Data.TempMon" 0 /end MEASUREMENT
/begin MEASUREMENT V_MCU_Data.TempMon.0.PMS_DIE_TEMP_HIGH "" ULONG NO_COMPU_METHOD 0 0 0 4294967295 BIT_MASK 0x2 ECU_ADDRESS 0x70011746 FORMAT "%.15" SYMBOL_LINK "V_MCU_Data.TempMon" 0 /end MEASUREMENT
/begin MEASUREMENT V_MCU_Data.TempMon.0.reserved "" ULONG NO_COMPU_METHOD 0 0 0 4294967295 BIT_MASK 0xF0 ECU_ADDRESS 0x70011746 FORMAT "%.15" SYMBOL_LINK "V_MCU_Data.TempMon" 0 /end MEASUREMENT
/begin MEASUREMENT V_SBC_Data.State "SBC State" SLONG SBC_State_Method 0 0 -2147483648 2147483647 BIT_MASK 0xFFFFFFFF ECU_ADDRESS 0x70011A3C FORMAT "%.15" /end MEASUREMENT
/begin MEASUREMENT V_SMU_AlarmGroup_10 "SMU core registers saved in case of SMU interrupt" ULONG NO_COMPU_METHOD 0 0 0 4294967295 BIT_MASK 0xFFFFFFFF ECU_ADDRESS 0xB001A008 FORMAT "%.15" SYMBOL_LINK "V_SMU_AlarmGroup" 40 /end MEASUREMENT
/begin COMPU_METHOD MCU_Reset_Type "MCU_Reset_Type" TAB_VERB "%2.1" "" COMPU_TAB_REF MCU_Reset_Type /end COMPU_METHOD
/begin COMPU_METHOD MCU_State_Method "MCU_State_Method" TAB_VERB "%2.1" "" COMPU_TAB_REF MCU_State_Method /end COMPU_METHOD
/begin COMPU_METHOD PS.EQ_LSB_1_a "" LINEAR "%5.0" "10 ms" COEFFS_LINEAR 1 0 /end COMPU_METHOD
/begin COMPU_METHOD PS.EQ_LSB_1_b "" LINEAR "%10.0" "mm" COEFFS_LINEAR 1 0 /end COMPU_METHOD
/begin COMPU_METHOD PS.EQ_LSB_1_c "" LINEAR "%3.0" "mm" COEFFS_LINEAR 1 0 /end COMPU_METHOD
/begin COMPU_METHOD PS.EQ_LSB_1_d "" LINEAR "%5.0" "mm" COEFFS_LINEAR 1 0 /end COMPU_METHOD
/begin COMPU_METHOD PS.EQ_LSB_1_e "" LINEAR "%5.0" "2 ms" COEFFS_LINEAR 1 0 /end COMPU_METHOD
/begin COMPU_METHOD PS.EQ_LSB_3_0517578125em5 "" LINEAR "%17.15" "" COEFFS_LINEAR 3.0517578125E-05 0 /end COMPU_METHOD
/begin COMPU_METHOD PS.TLE_GearStateS02_curState "TargetLink Scaling Type GearStateS02_curstate" TAB_VERB "%3.0" "" COMPU_TAB_REF PS.CONV_TAB_TLE_GearStateS02_curState /end COMPU_METHOD
/begin COMPU_METHOD PS.TLE_Global_reqCompstate "TargetLink Scaling Type MainY10_stCompState" TAB_VERB "%3.0" "" COMPU_TAB_REF PS.CONV_TAB_TLE_Global_reqCompstate /end COMPU_METHOD
/begin COMPU_METHOD PS.TLE_Global_stCompstate "TargetLink Scaling Type InputY10_reqCompstate" TAB_VERB "%3.0" "" COMPU_TAB_REF PS.CONV_TAB_TLE_Global_stCompstate /end COMPU_METHOD
/begin COMPU_METHOD PS.TLE_PosCorrS02_curStateGearSens "TargetLink Scaling Type current state of the sensor gear evaluation" TAB_VERB "%3.0" "" COMPU_TAB_REF PS.CONV_TAB_TLE_PosCorrS02_curStateGearSens /end COMPU_METHOD
/begin COMPU_METHOD PS.TLE_QF "TargetLink enumeration for qualifier signals" TAB_VERB "%3.0" "" COMPU_TAB_REF PS.CONV_TAB_TLE_QF /end COMPU_METHOD
/begin COMPU_METHOD PS.TLE_SvcJobS02_stEOLPos "TargetLink Scaling Type SvcJobS02_stEOLPos" TAB_VERB "%3.0" "" COMPU_TAB_REF PS.CONV_TAB_TLE_SvcJobS02_stEOLPos /end COMPU_METHOD
/begin COMPU_METHOD PS.TLE_cmdEmReq "Enumeration for requested controller state" TAB_VERB "%3.0" "" COMPU_TAB_REF PS.CONV_TAB_TLE_cmdEmReq /end COMPU_METHOD
/begin COMPU_METHOD PS.TLE_stDCUCalib "Enumeration for DCU Calibration and position learning states" TAB_VERB "%3.0" "" COMPU_TAB_REF PS.CONV_TAB_TLE_stDCUCalib /end COMPU_METHOD
/begin COMPU_METHOD PS.TLE_stGear "Enumeration for gear state" TAB_VERB "%3.0" "" COMPU_TAB_REF PS.CONV_TAB_TLE_stGear /end COMPU_METHOD
/begin COMPU_METHOD PS.TLE_stPhiActShtdwn "TargetLink Scaling Type Main_curState" TAB_VERB "%3.0" "" COMPU_TAB_REF PS.CONV_TAB_TLE_stPhiActShtdwn /end COMPU_METHOD
/begin COMPU_METHOD PS.TLE_stPosMon "TargetLink Scaling Type PosMonS02_curstate" TAB_VERB "%3.0" "" COMPU_TAB_REF PS.CONV_TAB_TLE_stPosMon /end COMPU_METHOD
/begin COMPU_METHOD PS.TLS_revolutionsAccurate "TargetLink Scaling Type revolutions" LINEAR "%19.15" "revolutions" COEFFS_LINEAR 2.98023223877E-08 0 /end COMPU_METHOD
/begin COMPU_METHOD PS.TLS_time02ms "TargetLink Scaling Type time 2ms" LINEAR "%5.0" "2ms" COEFFS_LINEAR 1 0 /end COMPU_METHOD
/begin COMPU_METHOD PS.TLS_trq "Target Link Scaling Type Torque in Nm" LINEAR "%7.2" "Nm" COEFFS_LINEAR 0.25 0 /end COMPU_METHOD
/begin COMPU_METHOD PS.TLS_trqInt "TargetLink Scaling Type integrated torque over time" LINEAR "%19.15" "Nms" COEFFS_LINEAR 2.98023223877E-08 0 /end COMPU_METHOD
/begin COMPU_METHOD PS.TLS_trqInt_float32 "TargetLink Scaling Type integrated torque over time" LINEAR "%12.6" "Nms" COEFFS_LINEAR 1 0 /end COMPU_METHOD
/begin COMPU_METHOD PWM_cycles_to_milliseconds "time in PWM cycles / time in milliseconds" RAT_FUNC "%3.4" "ms" COEFFS 0 7.35294117647 0 0 0 1 /end COMPU_METHOD
/begin COMPU_METHOD RTE.CM_ART_AVL_SIG_AGE "" LINEAR "%.15" "NoUnit" COEFFS_LINEAR 5 0 /end COMPU_METHOD
/begin COMPU_METHOD RTE.CM_ART_BCS_WhlRPM_Lim_Max_Axle_R_ST3 "" LINEAR "%.15" "NoUnit" COEFFS_LINEAR 0.5 0 /end COMPU_METHOD
/begin COMPU_METHOD RTE.CM_ART_BCS_WhlRPM_Lim_Min_Axle_R_ST3 "" LINEAR "%.15" "NoUnit" COEFFS_LINEAR 0.5 0 /end COMPU_METHOD
/begin COMPU_METHOD RTE.CM_ART_EdiClt_EmInletFlow "" LINEAR "%.15" "NoUnit" COEFFS_LINEAR 0.05 0 /end COMPU_METHOD
/begin COMPU_METHOD RTE.CM_ART_EdiClt_EmInletTemp "" LINEAR "%.15" "NoUnit" COEFFS_LINEAR 0.25 80 /end COMPU_METHOD
/begin COMPU_METHOD RTE.CM_ART_EdiClt_InvInletFlow "" LINEAR "%.15" "NoUnit" COEFFS_LINEAR 0.05 0 /end COMPU_METHOD
/begin COMPU_METHOD RTE.CM_ART_EdiClt_InvInletTemp "" LINEAR "%.15" "NoUnit" COEFFS_LINEAR 0.25 80 /end COMPU_METHOD
/begin COMPU_METHOD RTE.CM_ART_EdiEdrv_AngReq "" LINEAR "%.15" "NoUnit" COEFFS_LINEAR 0.125 0 /end COMPU_METHOD
/begin COMPU_METHOD RTE.CM_ART_EdiEdrv_CurrReq "" LINEAR "%.15" "NoUnit" COEFFS_LINEAR 0.625 0 /end COMPU_METHOD
/begin COMPU_METHOD RTE.CM_ART_EdiEdrv_DcLinkCapDeltaTemp "" LINEAR "%.15" "NoUnit" COEFFS_LINEAR 0.25 80 /end COMPU_METHOD
/begin COMPU_METHOD RTE.CM_ART_EdiEdrv_DcLinkCapTemp "" LINEAR "%.15" "NoUnit" COEFFS_LINEAR 0.25 80 /end COMPU_METHOD
/begin COMPU_METHOD RTE.CM_ART_EdiEdrv_DcLinkCurr "" LINEAR "%.15" "NoUnit" COEFFS_LINEAR 0.625 0 /end COMPU_METHOD
/begin COMPU_METHOD RTE.CM_ART_EdiEdrv_DcLinkCurrRippleCurr "" LINEAR "%.15" "NoUnit" COEFFS_LINEAR 0.625 0 /end COMPU_METHOD
/begin COMPU_METHOD RTE.CM_ART_EdiEdrv_DcLinkVolt "" LINEAR "%.15" "NoUnit" COEFFS_LINEAR 0.03125 0 /end COMPU_METHOD
/begin COMPU_METHOD RTE.CM_ART_EdiEdrv_DcLinkVoltRednt "" LINEAR "%.15" "NoUnit" COEFFS_LINEAR 0.03125 0 /end COMPU_METHOD
/begin COMPU_METHOD RTE.CM_ART_EdiEdrv_DrctCurr "" LINEAR "%.15" "NoUnit" COEFFS_LINEAR 0.625 0 /end COMPU_METHOD
/begin COMPU_METHOD RTE.CM_ART_EdiEdrv_DrctCurr2 "" LINEAR "%.15" "NoUnit" COEFFS_LINEAR 0.625 0 /end COMPU_METHOD
/begin COMPU_METHOD RTE.CM_ART_EdiEdrv_DrctVolt "" LINEAR "%.15" "NoUnit" COEFFS_LINEAR 0.03125 0 /end COMPU_METHOD
/begin COMPU_METHOD RTE.CM_ART_EdiEdrv_DrctVolt2 "" LINEAR "%.15" "NoUnit" COEFFS_LINEAR 0.03125 0 /end COMPU_METHOD
/begin COMPU_METHOD RTE.CM_ART_EdiEdrv_ElecAng "" LINEAR "%.15" "NoUnit" COEFFS_LINEAR 0.351906 0 /end COMPU_METHOD
/begin COMPU_METHOD RTE.CM_ART_EdiEdrv_EmPwrLoss "" LINEAR "%.15" "NoUnit" COEFFS_LINEAR 2 0 /end COMPU_METHOD
/begin COMPU_METHOD RTE.CM_ART_EdiEdrv_ExtSnsrFreq1 "" LINEAR "%.15" "NoUnit" COEFFS_LINEAR 0.5 0 /end COMPU_METHOD
/begin COMPU_METHOD RTE.CM_ART_EdiEdrv_ExtSnsrFreq2 "" LINEAR "%.15" "NoUnit" COEFFS_LINEAR 0.5 0 /end COMPU_METHOD
/begin COMPU_METHOD RTE.CM_ART_EdiEdrv_IndMotPsiD "" LINEAR "%.15" "NoUnit" COEFFS_LINEAR 6.103515625E-05 0 /end COMPU_METHOD
/begin COMPU_METHOD RTE.CM_ART_EdiEdrv_IndMotSlipAngVel "" LINEAR "%.15" "NoUnit" COEFFS_LINEAR 0.0325 0 /end COMPU_METHOD
/begin COMPU_METHOD RTE.CM_ART_EdiEdrv_IndMotStatorAngVel "" LINEAR "%.15" "NoUnit" COEFFS_LINEAR 0.25 0 /end COMPU_METHOD
/begin COMPU_METHOD RTE.CM_ART_EdiEdrv_InvJuncTempEstMax "" LINEAR "%.15" "NoUnit" COEFFS_LINEAR 0.25 80 /end COMPU_METHOD
/begin COMPU_METHOD RTE.CM_ART_EdiEdrv_InvPhaseCurr1 "" LINEAR "%.15" "NoUnit" COEFFS_LINEAR 0.625 0 /end COMPU_METHOD
/begin COMPU_METHOD RTE.CM_ART_EdiEdrv_InvPhaseCurr1AdcVolt "" LINEAR "%.15" "NoUnit" COEFFS_LINEAR 0.00125 0 /end COMPU_METHOD
/begin COMPU_METHOD RTE.CM_ART_EdiEdrv_InvPhaseCurr2 "" LINEAR "%.15" "NoUnit" COEFFS_LINEAR 0.625 0 /end COMPU_METHOD
/begin COMPU_METHOD RTE.CM_ART_EdiEdrv_InvPhaseCurr2AdcVolt "" LINEAR "%.15" "NoUnit" COEFFS_LINEAR 0.00125 0 /end COMPU_METHOD
/begin COMPU_METHOD RTE.CM_ART_EdiEdrv_InvPhaseCurr3 "" LINEAR "%.15" "NoUnit" COEFFS_LINEAR 0.625 0 /end COMPU_METHOD
/begin COMPU_METHOD RTE.CM_ART_EdiEdrv_InvPhaseCurr3AdcVolt "" LINEAR "%.15" "NoUnit" COEFFS_LINEAR 0.00125 0 /end COMPU_METHOD
/begin COMPU_METHOD RTE.CM_ART_EdiEdrv_InvPhaseCurr4 "" LINEAR "%.15" "NoUnit" COEFFS_LINEAR 0.625 0 /end COMPU_METHOD
/begin COMPU_METHOD RTE.CM_ART_EdiEdrv_InvPhaseCurr4AdcVolt "" LINEAR "%.15" "NoUnit" COEFFS_LINEAR 0.00125 0 /end COMPU_METHOD
/begin COMPU_METHOD RTE.CM_ART_EdiEdrv_InvPhaseCurr5 "" LINEAR "%.15" "NoUnit" COEFFS_LINEAR 0.625 0 /end COMPU_METHOD
/begin COMPU_METHOD RTE.CM_ART_EdiEdrv_InvPhaseCurr5AdcVolt "" LINEAR "%.15" "NoUnit" COEFFS_LINEAR 0.00125 0 /end COMPU_METHOD
/begin COMPU_METHOD RTE.CM_ART_EdiEdrv_InvPhaseCurr6 "" LINEAR "%.15" "NoUnit" COEFFS_LINEAR 0.625 0 /end COMPU_METHOD
/begin COMPU_METHOD RTE.CM_ART_EdiEdrv_InvPhaseCurr6AdcVolt "" LINEAR "%.15" "NoUnit" COEFFS_LINEAR 0.00125 0 /end COMPU_METHOD
/begin COMPU_METHOD RTE.CM_ART_EdiEdrv_InvTempU "" LINEAR "%.15" "NoUnit" COEFFS_LINEAR 0.25 80 /end COMPU_METHOD
/begin COMPU_METHOD RTE.CM_ART_EdiEdrv_InvTempV "" LINEAR "%.15" "NoUnit" COEFFS_LINEAR 0.25 80 /end COMPU_METHOD
/begin COMPU_METHOD RTE.CM_ART_EdiEdrv_InvTempW "" LINEAR "%.15" "NoUnit" COEFFS_LINEAR 0.25 80 /end COMPU_METHOD
/begin COMPU_METHOD RTE.CM_ART_EdiEdrv_InvTempX "" LINEAR "%.15" "NoUnit" COEFFS_LINEAR 0.25 80 /end COMPU_METHOD
/begin COMPU_METHOD RTE.CM_ART_EdiEdrv_InvTempY "" LINEAR "%.15" "NoUnit" COEFFS_LINEAR 0.25 80 /end COMPU_METHOD
/begin COMPU_METHOD RTE.CM_ART_EdiEdrv_InvTempZ "" LINEAR "%.15" "NoUnit" COEFFS_LINEAR 0.25 80 /end COMPU_METHOD
/begin COMPU_METHOD RTE.CM_ART_EdiEdrv_MotTemp1 "" LINEAR "%.15" "NoUnit" COEFFS_LINEAR 0.25 80 /end COMPU_METHOD
/begin COMPU_METHOD RTE.CM_ART_EdiEdrv_MotTemp2 "" LINEAR "%.15" "NoUnit" COEFFS_LINEAR 0.25 80 /end COMPU_METHOD
/begin COMPU_METHOD RTE.CM_ART_EdiEdrv_PcbaTemp "" LINEAR "%.15" "NoUnit" COEFFS_LINEAR 0.25 80 /end COMPU_METHOD
/begin COMPU_METHOD RTE.CM_ART_EdiEdrv_PmFluxFact "" LINEAR "%.15" "NoUnit" COEFFS_LINEAR 0.05 0 /end COMPU_METHOD
/begin COMPU_METHOD RTE.CM_ART_EdiEdrv_QuadCurr "" LINEAR "%.15" "NoUnit" COEFFS_LINEAR 0.625 0 /end COMPU_METHOD
/begin COMPU_METHOD RTE.CM_ART_EdiEdrv_QuadCurr2 "" LINEAR "%.15" "NoUnit" COEFFS_LINEAR 0.625 0 /end COMPU_METHOD
/begin COMPU_METHOD RTE.CM_ART_EdiEdrv_QuadVolt "" LINEAR "%.15" "NoUnit" COEFFS_LINEAR 0.03125 0 /end COMPU_METHOD
/begin COMPU_METHOD RTE.CM_ART_EdiEdrv_QuadVolt2 "" LINEAR "%.15" "NoUnit" COEFFS_LINEAR 0.03125 0 /end COMPU_METHOD
/begin COMPU_METHOD RTE.CM_ART_EdiEdrv_RotorTempEstMax "" LINEAR "%.15" "NoUnit" COEFFS_LINEAR 0.25 80 /end COMPU_METHOD
/begin COMPU_METHOD RTE.CM_ART_EdiEdrv_SpdMotShaft "" LINEAR "%.15" "NoUnit" COEFFS_LINEAR 2 0 /end COMPU_METHOD
/begin COMPU_METHOD RTE.CM_ART_EdiEdrv_SpdReqMotShaft "" LINEAR "%.15" "NoUnit" COEFFS_LINEAR 2 0 /end COMPU_METHOD
/begin COMPU_METHOD RTE.CM_ART_EdiEdrv_StatorTempEstMax "" LINEAR "%.15" "NoUnit" COEFFS_LINEAR 0.25 80 /end COMPU_METHOD
/begin COMPU_METHOD RTE.CM_ART_EdiEdrv_TrqMotShaft "" LINEAR "%.15" "NoUnit" COEFFS_LINEAR 0.03125 0 /end COMPU_METHOD
/begin COMPU_METHOD RTE.CM_ART_EdiEdrv_TrqNegAvlShaft "" LINEAR "%.15" "NoUnit" COEFFS_LINEAR 0.03125 -2047.96875 /end COMPU_METHOD
/begin COMPU_METHOD RTE.CM_ART_EdiEdrv_TrqPosAvlShaft "" LINEAR "%.15" "NoUnit" COEFFS_LINEAR 0.03125 0 /end COMPU_METHOD
/begin COMPU_METHOD RTE.CM_ART_EdiEdrv_TrqReqLimMax "" LINEAR "%.15" "NoUnit" COEFFS_LINEAR 0.03125 0 /end COMPU_METHOD
/begin COMPU_METHOD RTE.CM_ART_EdiEdrv_TrqReqLimMin "" LINEAR "%.15" "NoUnit" COEFFS_LINEAR 0.03125 0 /end COMPU_METHOD
/begin COMPU_METHOD RTE.CM_ART_EdiEdrv_TrqReqLimSpdCtrlMax "" LINEAR "%.15" "NoUnit" COEFFS_LINEAR 0.03125 0 /end COMPU_METHOD
/begin COMPU_METHOD RTE.CM_ART_EdiEdrv_TrqReqLimSpdCtrlMin "" LINEAR "%.15" "NoUnit" COEFFS_LINEAR 0.03125 0 /end COMPU_METHOD
/begin COMPU_METHOD RTE.CM_ART_EdiEdrv_TrqReqShaft "" LINEAR "%.15" "NoUnit" COEFFS_LINEAR 0.03125 0 /end COMPU_METHOD
/begin COMPU_METHOD RTE.CM_ART_EdiEdrv_VoltReq "" LINEAR "%.15" "NoUnit" COEFFS_LINEAR 0.03125 0 /end COMPU_METHOD
/begin COMPU_METHOD RTE.CM_ART_EdiEdrv_dutyCycleHvil "" LINEAR "%.15" "NoUnit" COEFFS_LINEAR 0.5 0 /end COMPU_METHOD
/begin COMPU_METHOD RTE.CM_ART_EdiEdrv_frqHvil "" LINEAR "%.15" "NoUnit" COEFFS_LINEAR 0.25 0 /end COMPU_METHOD
/begin COMPU_METHOD RTE.CM_ART_EdiEdrv_nMainShaft "" LINEAR "%.15" "NoUnit" COEFFS_LINEAR 1 -32768 /end COMPU_METHOD
/begin COMPU_METHOD RTE.CM_ART_EdiEdrv_uSolReq "" LINEAR "%.15" "NoUnit" COEFFS_LINEAR 0.0009765625 -32 /end COMPU_METHOD
/begin COMPU_METHOD RTE.CM_ART_EdiSys_BattCurrMinDyn "" LINEAR "%.15" "NoUnit" COEFFS_LINEAR 1 -1023 /end COMPU_METHOD
/begin COMPU_METHOD RTE.CM_ART_EdiSys_BattVoltMax "" LINEAR "%.15" "NoUnit" COEFFS_LINEAR 0.03125 0 /end COMPU_METHOD
/begin COMPU_METHOD RTE.CM_ART_EdiSys_BattVoltMin "" LINEAR "%.15" "NoUnit" COEFFS_LINEAR 0.03125 0 /end COMPU_METHOD
/begin COMPU_METHOD RTE.CM_ART_EdiSys_SpdSlopMax "" LINEAR "%.15" "NoUnit" COEFFS_LINEAR 10 0 /end COMPU_METHOD
/begin COMPU_METHOD RTE.CM_ART_EdiSys_WhlSpdLe "" LINEAR "%.15" "NoUnit" COEFFS_LINEAR 0.15 0 /end COMPU_METHOD
/begin COMPU_METHOD RTE.CM_ART_EdiSys_WhlSpdRi "" LINEAR "%.15" "NoUnit" COEFFS_LINEAR 0.15 0 /end COMPU_METHOD
/begin COMPU_METHOD RTE.CM_ART_Odo_ST3 "" LINEAR "%.15" "NoUnit" COEFFS_LINEAR 0.1 0 /end COMPU_METHOD
/begin COMPU_METHOD RTE.CM_ART_PN14_SupBat_Volt_ST3 "" LINEAR "%.15" "NoUnit" COEFFS_LINEAR 0.025 0 /end COMPU_METHOD
/begin COMPU_METHOD RTE.CM_ART_PT4_INV1Ctrl_TrqAvl_Max_ST3 "" LINEAR "%.15" "NoUnit" COEFFS_LINEAR 0.0625 -2047.9375 /end COMPU_METHOD
/begin COMPU_METHOD RTE.CM_ART_PT4_INV1Ctrl_TrqAvl_Min_ST3 "" LINEAR "%.15" "NoUnit" COEFFS_LINEAR 0.0625 -2047.9375 /end COMPU_METHOD
/begin COMPU_METHOD RTE.CM_ART_PT4_PTCoor_HDC_IdealSpdTrj_INV1_ST3 "" LINEAR "%.15" "NoUnit" COEFFS_LINEAR 0.25 -131071.75 /end COMPU_METHOD
/begin COMPU_METHOD RTE.CM_ART_PT4_PTCoor_HDC_Intrvntn_DampFctr_INV1_ST3 "" LINEAR "%.15" "NoUnit" COEFFS_LINEAR 0.02 0 /end COMPU_METHOD
/begin COMPU_METHOD RTE.CM_ART_PT4_TMPT_LowTemp_Circ1_AfterRun_Dur_ST3 "" LINEAR "%.15" "NoUnit" COEFFS_LINEAR 20 0 /end COMPU_METHOD
/begin COMPU_METHOD RTE.CM_ART_PT4_TMPT_LowTemp_FlowVol_Circ1_INV1_ST3 "" LINEAR "%.15" "" COEFFS_LINEAR 0.1 0 /end COMPU_METHOD
/begin COMPU_METHOD RTE.CM_ART_PT4_TrsmCtrl_OutRPM_ST3 "" LINEAR "%.15" "NoUnit" COEFFS_LINEAR 4 0 /end COMPU_METHOD
/begin COMPU_METHOD RTE.CM_ART_PT4_VEPM_INV1_ChrgVolt_Rq_ST3 "" LINEAR "%.15" "NoUnit" COEFFS_LINEAR 0.025 0 /end COMPU_METHOD
/begin COMPU_METHOD RTE.CM_ART_PT4_VEPM_INV1_Curr_Max_ST3 "" LINEAR "%.15" "NoUnit" COEFFS_LINEAR 0.1 -1638.2 /end COMPU_METHOD
/begin COMPU_METHOD RTE.CM_ART_PT4_VEPM_INV1_Curr_Min_ST3 "" LINEAR "%.15" "NoUnit" COEFFS_LINEAR 0.1 -1638.2 /end COMPU_METHOD
/begin COMPU_METHOD RTE.CM_ART_PT4_VEPM_PNHV_Bat_ResistChrg_ST3 "" LINEAR "%.15" "NoUnit" COEFFS_LINEAR 0.0005 0 /end COMPU_METHOD
/begin COMPU_METHOD RTE.CM_ART_PT4_VEPM_PNHV_Bat_ResistDschrg_ST3 "" LINEAR "%.15" "NoUnit" COEFFS_LINEAR 0.0005 0 /end COMPU_METHOD
/begin COMPU_METHOD RTE.CM_ART_PT4_VEPM_Pmax_PredDCLinkVolt_ST3 "" LINEAR "%.15" "NoUnit" COEFFS_LINEAR 0.025 0 /end COMPU_METHOD
/begin COMPU_METHOD RTE.CM_ART_Signal_Age "" LINEAR "%.15" "ms" COEFFS_LINEAR 5 0 /end COMPU_METHOD
/begin COMPU_METHOD RTE.CM_ART_VehSpd_Disp_ST3 "" LINEAR "%.15" "NoUnit" COEFFS_LINEAR 0.1 0 /end COMPU_METHOD
/begin COMPU_METHOD RTE.CM_ART_WhlRPM_RL_ST3 "" LINEAR "%.15" "NoUnit" COEFFS_LINEAR 0.5 0 /end COMPU_METHOD
/begin COMPU_METHOD RTE.CM_ART_WhlRPM_RR_ST3 "" LINEAR "%.15" "NoUnit" COEFFS_LINEAR 0.5 0 /end COMPU_METHOD
/begin COMPU_METHOD RTE.CM_Asw_AvailyState_cm "" TAB_VERB "%.15" "-" COMPU_TAB_REF Asw_AvailyState /end COMPU_METHOD
/begin COMPU_METHOD RTE.CM_Asw_RunState_cm "" TAB_VERB "%.15" "-" COMPU_TAB_REF Asw_RunState /end COMPU_METHOD
/begin COMPU_METHOD RTE.CM_Asw_SigQly_cm "" TAB_VERB "%.15" "-" COMPU_TAB_REF Asw_SigQly /end COMPU_METHOD
/begin COMPU_METHOD RTE.CM_CMP_REQSTATE_cm "" TAB_VERB "%.15" "-" COMPU_TAB_REF CMP_REQSTATE /end COMPU_METHOD
/begin COMPU_METHOD RTE.CM_CM_FIM_RequestStatus_cm "" TAB_VERB "%.15" "-" COMPU_TAB_REF CM_FIM_RequestStatus /end COMPU_METHOD
/begin COMPU_METHOD RTE.CM_CM_SecOC_VerificationResultType_cm "" TAB_VERB "%.15" "-" COMPU_TAB_REF CM_SecOC_VerificationResultType /end COMPU_METHOD
/begin COMPU_METHOD RTE.CM_ComVarCfgId_cm "" TAB_VERB "%.15" "-" COMPU_TAB_REF ComVarCfgId /end COMPU_METHOD
/begin COMPU_METHOD RTE.CM_DCM_CFG_ServiceCommand_cm "" TAB_VERB "%.15" "-" COMPU_TAB_REF DCM_CFG_ServiceCommand /end COMPU_METHOD
/begin COMPU_METHOD RTE.CM_ECUM_ApplicationRequest_cm "" TAB_VERB "%.15" "-" COMPU_TAB_REF ECUM_ApplicationRequest /end COMPU_METHOD
/begin COMPU_METHOD RTE.CM_EOL_State_cm "" TAB_VERB "%.15" "-" COMPU_TAB_REF EOL_State /end COMPU_METHOD
/begin COMPU_METHOD RTE.CM_Edp_EmPwrStgIoCtrlMode_cm "" TAB_VERB "%.15" "-" COMPU_TAB_REF Edp_EmPwrStgIoCtrlMode /end COMPU_METHOD
/begin COMPU_METHOD RTE.CM_Edp_EmRpsCalnFltRsn_cm "" TAB_VERB "%.15" "-" COMPU_TAB_REF Edp_EmRpsCalnFltRsn /end COMPU_METHOD
/begin COMPU_METHOD RTE.CM_Edp_MptSignalState_cm "" TAB_VERB "%.15" "-" COMPU_TAB_REF Edp_MptSignalState /end COMPU_METHOD
/begin COMPU_METHOD RTE.CM_Edp_TrqLimRsn_cm "" TAB_VERB "%.15" "-" COMPU_TAB_REF Edp_TrqLimRsn /end COMPU_METHOD
/begin COMPU_METHOD RTE.CM_Edp_cmdActOutpStg_cm "" TAB_VERB "%.15" "-" COMPU_TAB_REF Edp_cmdActOutpStg /end COMPU_METHOD
/begin COMPU_METHOD RTE.CM_Edp_cmdBckFcn1_cm "" TAB_VERB "%.15" "-" COMPU_TAB_REF Edp_cmdBckFcn1 /end COMPU_METHOD
/begin COMPU_METHOD RTE.CM_Edp_cmdBckFcn2_cm "" TAB_VERB "%.15" "-" COMPU_TAB_REF Edp_cmdBckFcn2 /end COMPU_METHOD
/begin COMPU_METHOD RTE.CM_Edp_cmdBckFcn3_cm "" TAB_VERB "%.15" "-" COMPU_TAB_REF Edp_cmdBckFcn3 /end COMPU_METHOD
/begin COMPU_METHOD RTE.CM_Edp_cmdEm_cm "" TAB_VERB "%.15" "-" COMPU_TAB_REF Edp_cmdEm /end COMPU_METHOD
/begin COMPU_METHOD RTE.CM_Edp_stCoolDwn_cm "" TAB_VERB "%.15" "-" COMPU_TAB_REF Edp_stCoolDwn /end COMPU_METHOD
/begin COMPU_METHOD RTE.CM_Edp_stSolPlk_cm "" TAB_VERB "%.15" "-" COMPU_TAB_REF Edp_stSolPlk /end COMPU_METHOD
/begin COMPU_METHOD RTE.CM_EmCtrl_MdltnType_cm "" TAB_VERB "%.15" "-" COMPU_TAB_REF EmCtrl_MdltnType /end COMPU_METHOD
/begin COMPU_METHOD RTE.CM_Em_AscMode_cm "" TAB_VERB "%.15" "-" COMPU_TAB_REF Em_AscMode /end COMPU_METHOD
/begin COMPU_METHOD RTE.CM_Em_CmtMode_cm "" TAB_VERB "%.15" "-" COMPU_TAB_REF Em_CmtMode /end COMPU_METHOD
/begin COMPU_METHOD RTE.CM_Em_CtrlModeExtd_cm "" TAB_VERB "%.15" "-" COMPU_TAB_REF Em_CtrlModeExtd /end COMPU_METHOD
/begin COMPU_METHOD RTE.CM_Em_CtrlReqSrc_cm "" TAB_VERB "%.15" "-" COMPU_TAB_REF Em_CtrlReqSrc /end COMPU_METHOD
/begin COMPU_METHOD RTE.CM_Em_MdltnType_cm "" TAB_VERB "%.15" "-" COMPU_TAB_REF Em_MdltnType /end COMPU_METHOD
/begin COMPU_METHOD RTE.CM_Em_PwrStgHwCtrlMode_cm "" TAB_VERB "%.15" "-" COMPU_TAB_REF Em_PwrStgHwCtrlMode /end COMPU_METHOD
/begin COMPU_METHOD RTE.CM_Em_RpsAngOffsState_cm "" TAB_VERB "%.15" "-" COMPU_TAB_REF Em_RpsAngOffsState /end COMPU_METHOD
/begin COMPU_METHOD RTE.CM_FBS_RTE_Clearance_t_cm "" TAB_VERB "%.15" "-" COMPU_TAB_REF FBS_RTE_Clearance_t /end COMPU_METHOD
/begin COMPU_METHOD RTE.CM_FF_FreezeFrame_Struct_ED_CONSECUTIVE_SHFT_D_ERR__13 "" LINEAR "%.15" "" COEFFS_LINEAR 4 -508 /end COMPU_METHOD
/begin COMPU_METHOD RTE.CM_FF_FreezeFrame_Struct_ED_CONSECUTIVE_SHFT_D_ERR__15 "" LINEAR "%.15" "" COEFFS_LINEAR 4 -508 /end COMPU_METHOD
/begin COMPU_METHOD RTE.CM_FF_FreezeFrame_Struct_ED_CONSECUTIVE_SHFT_D_ERR__4 "" LINEAR "%.15" "" COEFFS_LINEAR 1 -32767 /end COMPU_METHOD
/begin COMPU_METHOD RTE.CM_FF_FreezeFrame_Struct_ED_CONSECUTIVE_SHFT_D_ERR__5 "" LINEAR "%.15" "" COEFFS_LINEAR 4 -508 /end COMPU_METHOD
/begin COMPU_METHOD RTE.CM_FF_FreezeFrame_Struct_ED_CONSECUTIVE_SHFT_D_ERR__7 "" LINEAR "%.15" "" COEFFS_LINEAR 4 -508 /end COMPU_METHOD
/begin COMPU_METHOD RTE.CM_FF_FreezeFrame_Struct_ED_CONSECUTIVE_SHFT_D_ERR__9 "" LINEAR "%.15" "" COEFFS_LINEAR 4 -508 /end COMPU_METHOD
/begin COMPU_METHOD RTE.CM_FF_FreezeFrame_Struct_ED_CONSECUTIVE_SHFT_N_ERR__13 "" LINEAR "%.15" "" COEFFS_LINEAR 4 -508 /end COMPU_METHOD
/begin COMPU_METHOD RTE.CM_FF_FreezeFrame_Struct_ED_CONSECUTIVE_SHFT_N_ERR__15 "" LINEAR "%.15" "" COEFFS_LINEAR 4 -508 /end COMPU_METHOD
/begin COMPU_METHOD RTE.CM_FF_FreezeFrame_Struct_ED_CONSECUTIVE_SHFT_N_ERR__4 "" LINEAR "%.15" "" COEFFS_LINEAR 1 -32767 /end COMPU_METHOD
/begin COMPU_METHOD RTE.CM_FF_FreezeFrame_Struct_ED_CONSECUTIVE_SHFT_N_ERR__5 "" LINEAR "%.15" "" COEFFS_LINEAR 4 -508 /end COMPU_METHOD
/begin COMPU_METHOD RTE.CM_FF_FreezeFrame_Struct_ED_CONSECUTIVE_SHFT_N_ERR__7 "" LINEAR "%.15" "" COEFFS_LINEAR 4 -508 /end COMPU_METHOD
/begin COMPU_METHOD RTE.CM_FF_FreezeFrame_Struct_ED_CONSECUTIVE_SHFT_N_ERR__9 "" LINEAR "%.15" "" COEFFS_LINEAR 4 -508 /end COMPU_METHOD
/begin COMPU_METHOD RTE.CM_FF_FreezeFrame_Struct_ED_COUPLE_TIMEOUT_ERR__13 "" LINEAR "%.15" "" COEFFS_LINEAR 4 -508 /end COMPU_METHOD
/begin COMPU_METHOD RTE.CM_FF_FreezeFrame_Struct_ED_COUPLE_TIMEOUT_ERR__15 "" LINEAR "%.15" "" COEFFS_LINEAR 4 -508 /end COMPU_METHOD
/begin COMPU_METHOD RTE.CM_FF_FreezeFrame_Struct_ED_COUPLE_TIMEOUT_ERR__4 "" LINEAR "%.15" "" COEFFS_LINEAR 1 -32767 /end COMPU_METHOD
/begin COMPU_METHOD RTE.CM_FF_FreezeFrame_Struct_ED_COUPLE_TIMEOUT_ERR__5 "" LINEAR "%.15" "" COEFFS_LINEAR 4 -508 /end COMPU_METHOD
/begin COMPU_METHOD RTE.CM_FF_FreezeFrame_Struct_ED_COUPLE_TIMEOUT_ERR__7 "" LINEAR "%.15" "" COEFFS_LINEAR 4 -508 /end COMPU_METHOD
/begin COMPU_METHOD RTE.CM_FF_FreezeFrame_Struct_ED_COUPLE_TIMEOUT_ERR__9 "" LINEAR "%.15" "" COEFFS_LINEAR 4 -508 /end COMPU_METHOD
/begin COMPU_METHOD RTE.CM_FF_FreezeFrame_Struct_ED_DECOUPLE_TIMEOUT_ERR__13 "" LINEAR "%.15" "" COEFFS_LINEAR 4 -508 /end COMPU_METHOD
/begin COMPU_METHOD RTE.CM_FF_FreezeFrame_Struct_ED_DECOUPLE_TIMEOUT_ERR__15 "" LINEAR "%.15" "" COEFFS_LINEAR 4 -508 /end COMPU_METHOD
/begin COMPU_METHOD RTE.CM_FF_FreezeFrame_Struct_ED_DECOUPLE_TIMEOUT_ERR__4 "" LINEAR "%.15" "" COEFFS_LINEAR 1 -32767 /end COMPU_METHOD
/begin COMPU_METHOD RTE.CM_FF_FreezeFrame_Struct_ED_DECOUPLE_TIMEOUT_ERR__5 "" LINEAR "%.15" "" COEFFS_LINEAR 4 -508 /end COMPU_METHOD
/begin COMPU_METHOD RTE.CM_FF_FreezeFrame_Struct_ED_DECOUPLE_TIMEOUT_ERR__7 "" LINEAR "%.15" "" COEFFS_LINEAR 4 -508 /end COMPU_METHOD
/begin COMPU_METHOD RTE.CM_FF_FreezeFrame_Struct_ED_DECOUPLE_TIMEOUT_ERR__9 "" LINEAR "%.15" "" COEFFS_LINEAR 4 -508 /end COMPU_METHOD
/begin COMPU_METHOD RTE.CM_FF_FreezeFrame_Struct_ED_LUBRICATION_REVERSEDRIVE__4 "" LINEAR "%.15" "" COEFFS_LINEAR 1 -32767 /end COMPU_METHOD
/begin COMPU_METHOD RTE.CM_FF_FreezeFrame_Struct_ED_LUBRICATION_REVERSEDRIVE__5 "" LINEAR "%.15" "" COEFFS_LINEAR 4 -508 /end COMPU_METHOD
/begin COMPU_METHOD RTE.CM_FF_FreezeFrame_Struct_ED_LUBRICATION_REVERSEDRIVE__7 "" LINEAR "%.15" "" COEFFS_LINEAR 4 -508 /end COMPU_METHOD
/begin COMPU_METHOD RTE.CM_FF_FreezeFrame_Struct_ED_LUBRICATION_REVERSEDRIVE__9 "" LINEAR "%.15" "" COEFFS_LINEAR 4 -508 /end COMPU_METHOD
/begin COMPU_METHOD RTE.CM_FF_FreezeFrame_Struct_ED_PWRUPDOWN_TOUT__13 "" LINEAR "%.15" "" COEFFS_LINEAR 4 -508 /end COMPU_METHOD
/begin COMPU_METHOD RTE.CM_FF_FreezeFrame_Struct_ED_PWRUPDOWN_TOUT__15 "" LINEAR "%.15" "" COEFFS_LINEAR 4 -508 /end COMPU_METHOD
/begin COMPU_METHOD RTE.CM_FF_FreezeFrame_Struct_ED_PWRUPDOWN_TOUT__4 "" LINEAR "%.15" "" COEFFS_LINEAR 1 -32767 /end COMPU_METHOD
/begin COMPU_METHOD RTE.CM_FF_FreezeFrame_Struct_ED_PWRUPDOWN_TOUT__5 "" LINEAR "%.15" "" COEFFS_LINEAR 4 -508 /end COMPU_METHOD
/begin COMPU_METHOD RTE.CM_FF_FreezeFrame_Struct_ED_PWRUPDOWN_TOUT__7 "" LINEAR "%.15" "" COEFFS_LINEAR 4 -508 /end COMPU_METHOD
/begin COMPU_METHOD RTE.CM_FF_FreezeFrame_Struct_ED_PWRUPDOWN_TOUT__9 "" LINEAR "%.15" "" COEFFS_LINEAR 4 -508 /end COMPU_METHOD
/begin COMPU_METHOD RTE.CM_FF_FreezeFrame_Struct_PA_ACTUATOR_STUCK__10 "" LINEAR "%.15" "" COEFFS_LINEAR 0.125 0 /end COMPU_METHOD
/begin COMPU_METHOD RTE.CM_FF_FreezeFrame_Struct_PA_ACTUATOR_STUCK__11 "" LINEAR "%.15" "" COEFFS_LINEAR 2 0 /end COMPU_METHOD
/begin COMPU_METHOD RTE.CM_FF_FreezeFrame_Struct_PA_ACTUATOR_STUCK__13 "" LINEAR "%.15" "" COEFFS_LINEAR 1 -32767 /end COMPU_METHOD
/begin COMPU_METHOD RTE.CM_FF_FreezeFrame_Struct_PA_ACTUATOR_STUCK__14 "" LINEAR "%.15" "" COEFFS_LINEAR 0.015625 -511.984375 /end COMPU_METHOD
/begin COMPU_METHOD RTE.CM_FF_FreezeFrame_Struct_PA_ACTUATOR_STUCK__19 "" LINEAR "%.15" "" COEFFS_LINEAR 0.015625 -511.984375 /end COMPU_METHOD
/begin COMPU_METHOD RTE.CM_FF_FreezeFrame_Struct_PA_ACTUATOR_STUCK__4 "" LINEAR "%.15" "" COEFFS_LINEAR 0.015625 -511.984375 /end COMPU_METHOD
/begin COMPU_METHOD RTE.CM_FF_FreezeFrame_Struct_PA_ACTUATOR_STUCK__7 "" LINEAR "%.15" "" COEFFS_LINEAR 0.125 0 /end COMPU_METHOD
/begin COMPU_METHOD RTE.CM_FF_FreezeFrame_Struct_PA_ACTUATOR_STUCK__8 "" LINEAR "%.15" "" COEFFS_LINEAR 0.125 0 /end COMPU_METHOD
/begin COMPU_METHOD RTE.CM_FF_FreezeFrame_Struct_PA_ACTUATOR_STUCK__9 "" LINEAR "%.15" "" COEFFS_LINEAR 0.125 0 /end COMPU_METHOD
/begin COMPU_METHOD RTE.CM_FF_FreezeFrame_Struct_PA_FUSE_ENERGY_LIMIT_ERROR__10 "" LINEAR "%.15" "" COEFFS_LINEAR 2 0 /end COMPU_METHOD
/begin COMPU_METHOD RTE.CM_FF_FreezeFrame_Struct_PA_FUSE_ENERGY_LIMIT_ERROR__11 "" LINEAR "%.15" "" COEFFS_LINEAR 1 -32767 /end COMPU_METHOD
/begin COMPU_METHOD RTE.CM_FF_FreezeFrame_Struct_PA_FUSE_ENERGY_LIMIT_ERROR__12 "" LINEAR "%.15" "" COEFFS_LINEAR 0.015625 -511.984375 /end COMPU_METHOD
/begin COMPU_METHOD RTE.CM_FF_FreezeFrame_Struct_PA_FUSE_ENERGY_LIMIT_ERROR__15 "" LINEAR "%.15" "" COEFFS_LINEAR 0.015625 -511.984375 /end COMPU_METHOD
/begin COMPU_METHOD RTE.CM_FF_FreezeFrame_Struct_PA_FUSE_ENERGY_LIMIT_ERROR__4 "" LINEAR "%.15" "" COEFFS_LINEAR 0.015625 -511.984375 /end COMPU_METHOD
/begin COMPU_METHOD RTE.CM_FF_FreezeFrame_Struct_PA_FUSE_ENERGY_LIMIT_ERROR__5 "" LINEAR "%.15" "" COEFFS_LINEAR 0.015625 -1.984375 /end COMPU_METHOD
/begin COMPU_METHOD RTE.CM_FF_FreezeFrame_Struct_PA_FUSE_ENERGY_LIMIT_ERROR__6 "" LINEAR "%.15" "" COEFFS_LINEAR 4 -508 /end COMPU_METHOD
/begin COMPU_METHOD RTE.CM_FF_FreezeFrame_Struct_PA_FUSE_ENERGY_LIMIT_ERROR__8 "" LINEAR "%.15" "" COEFFS_LINEAR 4 -508 /end COMPU_METHOD
/begin COMPU_METHOD RTE.CM_FF_FreezeFrame_Struct_PA_HSV_ERROR__10 "" LINEAR "%.15" "" COEFFS_LINEAR 0.125 0 /end COMPU_METHOD
/begin COMPU_METHOD RTE.CM_FF_FreezeFrame_Struct_PA_HSV_ERROR__11 "" LINEAR "%.15" "" COEFFS_LINEAR 2 0 /end COMPU_METHOD
/begin COMPU_METHOD RTE.CM_FF_FreezeFrame_Struct_PA_HSV_ERROR__13 "" LINEAR "%.15" "" COEFFS_LINEAR 1 -32767 /end COMPU_METHOD
/begin COMPU_METHOD RTE.CM_FF_FreezeFrame_Struct_PA_HSV_ERROR__14 "" LINEAR "%.15" "" COEFFS_LINEAR 0.015625 -511.984375 /end COMPU_METHOD
/begin COMPU_METHOD RTE.CM_FF_FreezeFrame_Struct_PA_HSV_ERROR__19 "" LINEAR "%.15" "" COEFFS_LINEAR 0.015625 -511.984375 /end COMPU_METHOD
/begin COMPU_METHOD RTE.CM_FF_FreezeFrame_Struct_PA_HSV_ERROR__4 "" LINEAR "%.15" "" COEFFS_LINEAR 0.015625 -511.984375 /end COMPU_METHOD
/begin COMPU_METHOD RTE.CM_FF_FreezeFrame_Struct_PA_HSV_ERROR__7 "" LINEAR "%.15" "" COEFFS_LINEAR 0.125 0 /end COMPU_METHOD
/begin COMPU_METHOD RTE.CM_FF_FreezeFrame_Struct_PA_HSV_ERROR__8 "" LINEAR "%.15" "" COEFFS_LINEAR 0.125 0 /end COMPU_METHOD
/begin COMPU_METHOD RTE.CM_FF_FreezeFrame_Struct_PA_HSV_ERROR__9 "" LINEAR "%.15" "" COEFFS_LINEAR 0.125 0 /end COMPU_METHOD
/begin COMPU_METHOD RTE.CM_FF_FreezeFrame_Struct_PS_GEAR_VERIFICATION_ERROR__0 "" LINEAR "%.15" "" COEFFS_LINEAR 0.015625 -511.984375 /end COMPU_METHOD
/begin COMPU_METHOD RTE.CM_FF_FreezeFrame_Struct_PS_GEAR_VERIFICATION_ERROR__1 "" LINEAR "%.15" "" COEFFS_LINEAR 0.125 0 /end COMPU_METHOD
/begin COMPU_METHOD RTE.CM_FF_FreezeFrame_Struct_PS_GEAR_VERIFICATION_ERROR__10 "" LINEAR "%.15" "" COEFFS_LINEAR 4 -508 /end COMPU_METHOD
/begin COMPU_METHOD RTE.CM_FF_FreezeFrame_Struct_PS_GEAR_VERIFICATION_ERROR__12 "" LINEAR "%.15" "" COEFFS_LINEAR 4 -508 /end COMPU_METHOD
/begin COMPU_METHOD RTE.CM_FF_FreezeFrame_Struct_PS_GEAR_VERIFICATION_ERROR__2 "" LINEAR "%.15" "" COEFFS_LINEAR 0.125 0 /end COMPU_METHOD
/begin COMPU_METHOD RTE.CM_FF_FreezeFrame_Struct_PS_GEAR_VERIFICATION_ERROR__3 "" LINEAR "%.15" "" COEFFS_LINEAR 0.125 0 /end COMPU_METHOD
/begin COMPU_METHOD RTE.CM_FF_FreezeFrame_Struct_PS_GEAR_VERIFICATION_ERROR__4 "" LINEAR "%.15" "" COEFFS_LINEAR 0.125 0 /end COMPU_METHOD
/begin COMPU_METHOD RTE.CM_FF_FreezeFrame_Struct_PS_NVMDATA_CORRUPT__10 "" LINEAR "%.15" "" COEFFS_LINEAR 0.125 0 /end COMPU_METHOD
/begin COMPU_METHOD RTE.CM_FF_FreezeFrame_Struct_PS_NVMDATA_CORRUPT__11 "" LINEAR "%.15" "" COEFFS_LINEAR 2 0 /end COMPU_METHOD
/begin COMPU_METHOD RTE.CM_FF_FreezeFrame_Struct_PS_NVMDATA_CORRUPT__13 "" LINEAR "%.15" "" COEFFS_LINEAR 1 -32767 /end COMPU_METHOD
/begin COMPU_METHOD RTE.CM_FF_FreezeFrame_Struct_PS_NVMDATA_CORRUPT__14 "" LINEAR "%.15" "" COEFFS_LINEAR 0.015625 -511.984375 /end COMPU_METHOD
/begin COMPU_METHOD RTE.CM_FF_FreezeFrame_Struct_PS_NVMDATA_CORRUPT__4 "" LINEAR "%.15" "" COEFFS_LINEAR 0.015625 -511.984375 /end COMPU_METHOD
/begin COMPU_METHOD RTE.CM_FF_FreezeFrame_Struct_PS_NVMDATA_CORRUPT__7 "" LINEAR "%.15" "" COEFFS_LINEAR 0.125 0 /end COMPU_METHOD
/begin COMPU_METHOD RTE.CM_FF_FreezeFrame_Struct_PS_NVMDATA_CORRUPT__8 "" LINEAR "%.15" "" COEFFS_LINEAR 0.125 0 /end COMPU_METHOD
/begin COMPU_METHOD RTE.CM_FF_FreezeFrame_Struct_PS_NVMDATA_CORRUPT__9 "" LINEAR "%.15" "" COEFFS_LINEAR 0.125 0 /end COMPU_METHOD
/begin COMPU_METHOD RTE.CM_FF_FreezeFrame_Struct_PS_OFFSET_CALIBRATION_NOT_DONE__4 "" LINEAR "%.15" "" COEFFS_LINEAR 1 -32767 /end COMPU_METHOD
/begin COMPU_METHOD RTE.CM_FF_FreezeFrame_Struct_PS_OFFSET_CALIBRATION_NOT_DONE__5 "" LINEAR "%.15" "" COEFFS_LINEAR 4 -508 /end COMPU_METHOD
/begin COMPU_METHOD RTE.CM_FF_FreezeFrame_Struct_PS_OFFSET_CALIBRATION_NOT_DONE__7 "" LINEAR "%.15" "" COEFFS_LINEAR 4 -508 /end COMPU_METHOD
/begin COMPU_METHOD RTE.CM_FF_FreezeFrame_Struct_PS_OFFSET_CALIBRATION_NOT_DONE__9 "" LINEAR "%.15" "" COEFFS_LINEAR 4 -508 /end COMPU_METHOD
/begin COMPU_METHOD RTE.CM_FF_FreezeFrame_Struct_PS_PHI_OFFSET_ERROR__10 "" LINEAR "%.15" "" COEFFS_LINEAR 0.125 0 /end COMPU_METHOD
/begin COMPU_METHOD RTE.CM_FF_FreezeFrame_Struct_PS_PHI_OFFSET_ERROR__11 "" LINEAR "%.15" "" COEFFS_LINEAR 2 0 /end COMPU_METHOD
/begin COMPU_METHOD RTE.CM_FF_FreezeFrame_Struct_PS_PHI_OFFSET_ERROR__13 "" LINEAR "%.15" "" COEFFS_LINEAR 1 -32767 /end COMPU_METHOD
/begin COMPU_METHOD RTE.CM_FF_FreezeFrame_Struct_PS_PHI_OFFSET_ERROR__14 "" LINEAR "%.15" "" COEFFS_LINEAR 0.015625 -511.984375 /end COMPU_METHOD
/begin COMPU_METHOD RTE.CM_FF_FreezeFrame_Struct_PS_PHI_OFFSET_ERROR__18 "" LINEAR "%.15" "" COEFFS_LINEAR 0.015625 -511.984375 /end COMPU_METHOD
/begin COMPU_METHOD RTE.CM_FF_FreezeFrame_Struct_PS_PHI_OFFSET_ERROR__4 "" LINEAR "%.15" "" COEFFS_LINEAR 0.015625 -511.984375 /end COMPU_METHOD
/begin COMPU_METHOD RTE.CM_FF_FreezeFrame_Struct_PS_PHI_OFFSET_ERROR__7 "" LINEAR "%.15" "" COEFFS_LINEAR 0.125 0 /end COMPU_METHOD
/begin COMPU_METHOD RTE.CM_FF_FreezeFrame_Struct_PS_PHI_OFFSET_ERROR__8 "" LINEAR "%.15" "" COEFFS_LINEAR 0.125 0 /end COMPU_METHOD
/begin COMPU_METHOD RTE.CM_FF_FreezeFrame_Struct_PS_PHI_OFFSET_ERROR__9 "" LINEAR "%.15" "" COEFFS_LINEAR 0.125 0 /end COMPU_METHOD
/begin COMPU_METHOD RTE.CM_FF_FreezeFrame_Struct_PS_POSITION_CONTROL_ERROR__10 "" LINEAR "%.15" "" COEFFS_LINEAR 0.125 0 /end COMPU_METHOD
/begin COMPU_METHOD RTE.CM_FF_FreezeFrame_Struct_PS_POSITION_CONTROL_ERROR__11 "" LINEAR "%.15" "" COEFFS_LINEAR 2 0 /end COMPU_METHOD
/begin COMPU_METHOD RTE.CM_FF_FreezeFrame_Struct_PS_POSITION_CONTROL_ERROR__13 "" LINEAR "%.15" "" COEFFS_LINEAR 1 -32767 /end COMPU_METHOD
/begin COMPU_METHOD RTE.CM_FF_FreezeFrame_Struct_PS_POSITION_CONTROL_ERROR__14 "" LINEAR "%.15" "" COEFFS_LINEAR 0.015625 -511.984375 /end COMPU_METHOD
/begin COMPU_METHOD RTE.CM_FF_FreezeFrame_Struct_PS_POSITION_CONTROL_ERROR__18 "" LINEAR "%.15" "" COEFFS_LINEAR 0.015625 -511.984375 /end COMPU_METHOD
/begin COMPU_METHOD RTE.CM_FF_FreezeFrame_Struct_PS_POSITION_CONTROL_ERROR__4 "" LINEAR "%.15" "" COEFFS_LINEAR 0.015625 -511.984375 /end COMPU_METHOD
/begin COMPU_METHOD RTE.CM_FF_FreezeFrame_Struct_PS_POSITION_CONTROL_ERROR__7 "" LINEAR "%.15" "" COEFFS_LINEAR 0.125 0 /end COMPU_METHOD
/begin COMPU_METHOD RTE.CM_FF_FreezeFrame_Struct_PS_POSITION_CONTROL_ERROR__8 "" LINEAR "%.15" "" COEFFS_LINEAR 0.125 0 /end COMPU_METHOD
/begin COMPU_METHOD RTE.CM_FF_FreezeFrame_Struct_PS_POSITION_CONTROL_ERROR__9 "" LINEAR "%.15" "" COEFFS_LINEAR 0.125 0 /end COMPU_METHOD
/begin COMPU_METHOD RTE.CM_FF_FreezeFrame_Struct_PS_SYSTEM_CLASSIFICATION_NOT_DONE__4 "" LINEAR "%.15" "" COEFFS_LINEAR 1 -32767 /end COMPU_METHOD
/begin COMPU_METHOD RTE.CM_FF_FreezeFrame_Struct_PS_SYSTEM_CLASSIFICATION_NOT_DONE__5 "" LINEAR "%.15" "" COEFFS_LINEAR 4 -508 /end COMPU_METHOD
/begin COMPU_METHOD RTE.CM_FF_FreezeFrame_Struct_PS_SYSTEM_CLASSIFICATION_NOT_DONE__7 "" LINEAR "%.15" "" COEFFS_LINEAR 4 -508 /end COMPU_METHOD
/begin COMPU_METHOD RTE.CM_FF_FreezeFrame_Struct_PS_SYSTEM_CLASSIFICATION_NOT_DONE__9 "" LINEAR "%.15" "" COEFFS_LINEAR 4 -508 /end COMPU_METHOD
/begin COMPU_METHOD RTE.CM_FF_FreezeFrame_Struct_PS_UNINTENDED_SLEEVE_POSITION_MOVEMENT__10 "" LINEAR "%.15" "" COEFFS_LINEAR 0.125 0 /end COMPU_METHOD
/begin COMPU_METHOD RTE.CM_FF_FreezeFrame_Struct_PS_UNINTENDED_SLEEVE_POSITION_MOVEMENT__11 "" LINEAR "%.15" "" COEFFS_LINEAR 2 0 /end COMPU_METHOD
/begin COMPU_METHOD RTE.CM_FF_FreezeFrame_Struct_PS_UNINTENDED_SLEEVE_POSITION_MOVEMENT__13 "" LINEAR "%.15" "" COEFFS_LINEAR 1 -32767 /end COMPU_METHOD
/begin COMPU_METHOD RTE.CM_FF_FreezeFrame_Struct_PS_UNINTENDED_SLEEVE_POSITION_MOVEMENT__14 "" LINEAR "%.15" "" COEFFS_LINEAR 0.015625 -511.984375 /end COMPU_METHOD
/begin COMPU_METHOD RTE.CM_FF_FreezeFrame_Struct_PS_UNINTENDED_SLEEVE_POSITION_MOVEMENT__4 "" LINEAR "%.15" "" COEFFS_LINEAR 0.015625 -511.984375 /end COMPU_METHOD
/begin COMPU_METHOD RTE.CM_FF_FreezeFrame_Struct_PS_UNINTENDED_SLEEVE_POSITION_MOVEMENT__7 "" LINEAR "%.15" "" COEFFS_LINEAR 0.125 0 /end COMPU_METHOD
/begin COMPU_METHOD RTE.CM_FF_FreezeFrame_Struct_PS_UNINTENDED_SLEEVE_POSITION_MOVEMENT__8 "" LINEAR "%.15" "" COEFFS_LINEAR 0.125 0 /end COMPU_METHOD
/begin COMPU_METHOD RTE.CM_FF_FreezeFrame_Struct_PS_UNINTENDED_SLEEVE_POSITION_MOVEMENT__9 "" LINEAR "%.15" "" COEFFS_LINEAR 0.125 0 /end COMPU_METHOD
/begin COMPU_METHOD RTE.CM_FF_FreezeFrame_Struct_SI_DTRQ_EXT_OVERSHOOT__0 "" LINEAR "%.15" "" COEFFS_LINEAR 1 -32767 /end COMPU_METHOD
/begin COMPU_METHOD RTE.CM_FF_FreezeFrame_Struct_SI_DTRQ_EXT_OVERSHOOT__1 "" LINEAR "%.15" "" COEFFS_LINEAR 4 -508 /end COMPU_METHOD
/begin COMPU_METHOD RTE.CM_FF_FreezeFrame_Struct_SI_DTRQ_EXT_OVERSHOOT__4 "" LINEAR "%.15" "" COEFFS_LINEAR 2 -255 /end COMPU_METHOD
/begin COMPU_METHOD RTE.CM_FF_FreezeFrame_Struct_SI_DTRQ_EXT_OVERSHOOT__5 "" LINEAR "%.15" "" COEFFS_LINEAR 2 -255 /end COMPU_METHOD
/begin COMPU_METHOD RTE.CM_FF_FreezeFrame_Struct_SI_DTRQ_EXT_OVERSHOOT__6 "" LINEAR "%.15" "" COEFFS_LINEAR 2 -255 /end COMPU_METHOD
/begin COMPU_METHOD RTE.CM_FF_FreezeFrame_Struct_SI_DTRQ_EXT_OVERSHOOT__7 "" LINEAR "%.15" "" COEFFS_LINEAR 2 -255 /end COMPU_METHOD
/begin COMPU_METHOD RTE.CM_FF_FreezeFrame_Struct_SI_DTRQ_EXT_OVERSHOOT__8 "" LINEAR "%.15" "" COEFFS_LINEAR 2 -255 /end COMPU_METHOD
/begin COMPU_METHOD RTE.CM_FF_FreezeFrame_Struct_SI_DTRQ_EXT_OVERSHOOT__9 "" LINEAR "%.15" "" COEFFS_LINEAR 2 -255 /end COMPU_METHOD
/begin COMPU_METHOD RTE.CM_FF_FreezeFrame_Struct_SI_OVERSPEED_OTHER_AXLE__0 "" LINEAR "%.15" "" COEFFS_LINEAR 1 -32767 /end COMPU_METHOD
/begin COMPU_METHOD RTE.CM_FF_FreezeFrame_Struct_SI_OVERSPEED_OTHER_AXLE__1 "" LINEAR "%.15" "" COEFFS_LINEAR 4 -508 /end COMPU_METHOD
/begin COMPU_METHOD RTE.CM_FF_FreezeFrame_Struct_SI_OVERSPEED_OTHER_AXLE__6 "" LINEAR "%.15" "" COEFFS_LINEAR 4 -508 /end COMPU_METHOD
/begin COMPU_METHOD RTE.CM_FF_FreezeFrame_Struct_SI_OVERSPEED_OTHER_AXLE__7 "" LINEAR "%.15" "" COEFFS_LINEAR 2 -255 /end COMPU_METHOD
/begin COMPU_METHOD RTE.CM_FF_FreezeFrame_Struct_SI_OVERSPEED_OTHER_AXLE__9 "" LINEAR "%.15" "" COEFFS_LINEAR 4 -508 /end COMPU_METHOD
/begin COMPU_METHOD RTE.CM_FF_FreezeFrame_Struct_SI_SECINVFAULTBF202__0 "" LINEAR "%.15" "" COEFFS_LINEAR 1 -32767 /end COMPU_METHOD
/begin COMPU_METHOD RTE.CM_FF_FreezeFrame_Struct_SI_SECINVFAULTBF202__1 "" LINEAR "%.15" "" COEFFS_LINEAR 4 -508 /end COMPU_METHOD
/begin COMPU_METHOD RTE.CM_FF_FreezeFrame_Struct_SI_SECINVFAULTBF202__6 "" LINEAR "%.15" "" COEFFS_LINEAR 4 -508 /end COMPU_METHOD
/begin COMPU_METHOD RTE.CM_FF_FreezeFrame_Struct_SI_SECINVFAULTBF202__7 "" LINEAR "%.15" "" COEFFS_LINEAR 2 -255 /end COMPU_METHOD
/begin COMPU_METHOD RTE.CM_FF_FreezeFrame_Struct_SI_SECINVFAULTBF202__9 "" LINEAR "%.15" "" COEFFS_LINEAR 4 -508 /end COMPU_METHOD
/begin COMPU_METHOD RTE.CM_FF_FreezeFrame_Struct_SI_SECINVFAULTBF203__0 "" LINEAR "%.15" "" COEFFS_LINEAR 1 -32767 /end COMPU_METHOD
/begin COMPU_METHOD RTE.CM_FF_FreezeFrame_Struct_SI_SECINVFAULTBF203__1 "" LINEAR "%.15" "" COEFFS_LINEAR 4 -508 /end COMPU_METHOD
/begin COMPU_METHOD RTE.CM_FF_FreezeFrame_Struct_SI_SECINVFAULTBF203__6 "" LINEAR "%.15" "" COEFFS_LINEAR 4 -508 /end COMPU_METHOD
/begin COMPU_METHOD RTE.CM_FF_FreezeFrame_Struct_SI_SECINVFAULTBF203__7 "" LINEAR "%.15" "" COEFFS_LINEAR 2 -255 /end COMPU_METHOD
/begin COMPU_METHOD RTE.CM_FF_FreezeFrame_Struct_SI_SECINVFAULTBF203__9 "" LINEAR "%.15" "" COEFFS_LINEAR 4 -508 /end COMPU_METHOD
/begin COMPU_METHOD RTE.CM_FF_FreezeFrame_Struct_SI_SECINVFAULTBF204__0 "" LINEAR "%.15" "" COEFFS_LINEAR 1 -32767 /end COMPU_METHOD
/begin COMPU_METHOD RTE.CM_FF_FreezeFrame_Struct_SI_SECINVFAULTBF204__1 "" LINEAR "%.15" "" COEFFS_LINEAR 4 -508 /end COMPU_METHOD
/begin COMPU_METHOD RTE.CM_FF_FreezeFrame_Struct_SI_SECINVFAULTBF204__6 "" LINEAR "%.15" "" COEFFS_LINEAR 4 -508 /end COMPU_METHOD
/begin COMPU_METHOD RTE.CM_FF_FreezeFrame_Struct_SI_SECINVFAULTBF204__7 "" LINEAR "%.15" "" COEFFS_LINEAR 2 -255 /end COMPU_METHOD
/begin COMPU_METHOD RTE.CM_FF_FreezeFrame_Struct_SI_SECINVFAULTBF204__9 "" LINEAR "%.15" "" COEFFS_LINEAR 4 -508 /end COMPU_METHOD
/begin COMPU_METHOD RTE.CM_FF_FreezeFrame_Struct_SI_SECINVFAULTBF205__0 "" LINEAR "%.15" "" COEFFS_LINEAR 1 -32767 /end COMPU_METHOD
/begin COMPU_METHOD RTE.CM_FF_FreezeFrame_Struct_SI_SECINVFAULTBF205__1 "" LINEAR "%.15" "" COEFFS_LINEAR 4 -508 /end COMPU_METHOD
/begin COMPU_METHOD RTE.CM_FF_FreezeFrame_Struct_SI_SECINVFAULTBF205__6 "" LINEAR "%.15" "" COEFFS_LINEAR 4 -508 /end COMPU_METHOD
/begin COMPU_METHOD RTE.CM_FF_FreezeFrame_Struct_SI_SECINVFAULTBF205__7 "" LINEAR "%.15" "" COEFFS_LINEAR 2 -255 /end COMPU_METHOD
/begin COMPU_METHOD RTE.CM_FF_FreezeFrame_Struct_SI_SECINVFAULTBF205__9 "" LINEAR "%.15" "" COEFFS_LINEAR 4 -508 /end COMPU_METHOD
/begin COMPU_METHOD RTE.CM_FF_FreezeFrame_Struct_SI_SECINVFAULTBF206__0 "" LINEAR "%.15" "" COEFFS_LINEAR 1 -32767 /end COMPU_METHOD
/begin COMPU_METHOD RTE.CM_FF_FreezeFrame_Struct_SI_SECINVFAULTBF206__1 "" LINEAR "%.15" "" COEFFS_LINEAR 4 -508 /end COMPU_METHOD
/begin COMPU_METHOD RTE.CM_FF_FreezeFrame_Struct_SI_SECINVFAULTBF206__6 "" LINEAR "%.15" "" COEFFS_LINEAR 4 -508 /end COMPU_METHOD
/begin COMPU_METHOD RTE.CM_FF_FreezeFrame_Struct_SI_SECINVFAULTBF206__7 "" LINEAR "%.15" "" COEFFS_LINEAR 2 -255 /end COMPU_METHOD
/begin COMPU_METHOD RTE.CM_FF_FreezeFrame_Struct_SI_SECINVFAULTBF206__9 "" LINEAR "%.15" "" COEFFS_LINEAR 4 -508 /end COMPU_METHOD
/begin COMPU_METHOD RTE.CM_FF_FreezeFrame_Struct_SI_SECINVFAULTBF207__0 "" LINEAR "%.15" "" COEFFS_LINEAR 1 -32767 /end COMPU_METHOD
/begin COMPU_METHOD RTE.CM_FF_FreezeFrame_Struct_SI_SECINVFAULTBF207__1 "" LINEAR "%.15" "" COEFFS_LINEAR 4 -508 /end COMPU_METHOD
/begin COMPU_METHOD RTE.CM_FF_FreezeFrame_Struct_SI_SECINVFAULTBF207__6 "" LINEAR "%.15" "" COEFFS_LINEAR 4 -508 /end COMPU_METHOD
/begin COMPU_METHOD RTE.CM_FF_FreezeFrame_Struct_SI_SECINVFAULTBF207__7 "" LINEAR "%.15" "" COEFFS_LINEAR 2 -255 /end COMPU_METHOD
/begin COMPU_METHOD RTE.CM_FF_FreezeFrame_Struct_SI_SECINVFAULTBF207__9 "" LINEAR "%.15" "" COEFFS_LINEAR 4 -508 /end COMPU_METHOD
/begin COMPU_METHOD RTE.CM_FF_FreezeFrame_Struct_SI_SECINVFAULTBF208__0 "" LINEAR "%.15" "" COEFFS_LINEAR 1 -32767 /end COMPU_METHOD
/begin COMPU_METHOD RTE.CM_FF_FreezeFrame_Struct_SI_SECINVFAULTBF208__1 "" LINEAR "%.15" "" COEFFS_LINEAR 4 -508 /end COMPU_METHOD
/begin COMPU_METHOD RTE.CM_FF_FreezeFrame_Struct_SI_SECINVFAULTBF208__6 "" LINEAR "%.15" "" COEFFS_LINEAR 4 -508 /end COMPU_METHOD
/begin COMPU_METHOD RTE.CM_FF_FreezeFrame_Struct_SI_SECINVFAULTBF208__7 "" LINEAR "%.15" "" COEFFS_LINEAR 2 -255 /end COMPU_METHOD
/begin COMPU_METHOD RTE.CM_FF_FreezeFrame_Struct_SI_SECINVFAULTBF208__9 "" LINEAR "%.15" "" COEFFS_LINEAR 4 -508 /end COMPU_METHOD
/begin COMPU_METHOD RTE.CM_FF_FreezeFrame_Struct_SI_SECINVFAULTBF209__0 "" LINEAR "%.15" "" COEFFS_LINEAR 1 -32767 /end COMPU_METHOD
/begin COMPU_METHOD RTE.CM_FF_FreezeFrame_Struct_SI_SECINVFAULTBF209__1 "" LINEAR "%.15" "" COEFFS_LINEAR 4 -508 /end COMPU_METHOD
/begin COMPU_METHOD RTE.CM_FF_FreezeFrame_Struct_SI_SECINVFAULTBF209__6 "" LINEAR "%.15" "" COEFFS_LINEAR 4 -508 /end COMPU_METHOD
/begin COMPU_METHOD RTE.CM_FF_FreezeFrame_Struct_SI_SECINVFAULTBF209__7 "" LINEAR "%.15" "" COEFFS_LINEAR 2 -255 /end COMPU_METHOD
/begin COMPU_METHOD RTE.CM_FF_FreezeFrame_Struct_SI_SECINVFAULTBF209__9 "" LINEAR "%.15" "" COEFFS_LINEAR 4 -508 /end COMPU_METHOD
/begin COMPU_METHOD RTE.CM_FF_FreezeFrame_Struct_SI_SECINVFAULTBF212__0 "" LINEAR "%.15" "" COEFFS_LINEAR 1 -32767 /end COMPU_METHOD
/begin COMPU_METHOD RTE.CM_FF_FreezeFrame_Struct_SI_SECINVFAULTBF212__1 "" LINEAR "%.15" "" COEFFS_LINEAR 4 -508 /end COMPU_METHOD
/begin COMPU_METHOD RTE.CM_FF_FreezeFrame_Struct_SI_SECINVFAULTBF212__6 "" LINEAR "%.15" "" COEFFS_LINEAR 4 -508 /end COMPU_METHOD
/begin COMPU_METHOD RTE.CM_FF_FreezeFrame_Struct_SI_SECINVFAULTBF212__7 "" LINEAR "%.15" "" COEFFS_LINEAR 2 -255 /end COMPU_METHOD
/begin COMPU_METHOD RTE.CM_FF_FreezeFrame_Struct_SI_SECINVFAULTBF212__9 "" LINEAR "%.15" "" COEFFS_LINEAR 4 -508 /end COMPU_METHOD
/begin COMPU_METHOD RTE.CM_FF_FreezeFrame_Struct_SI_SECINVFAULTBF213__0 "" LINEAR "%.15" "" COEFFS_LINEAR 1 -32767 /end COMPU_METHOD
/begin COMPU_METHOD RTE.CM_FF_FreezeFrame_Struct_SI_SECINVFAULTBF213__1 "" LINEAR "%.15" "" COEFFS_LINEAR 4 -508 /end COMPU_METHOD
/begin COMPU_METHOD RTE.CM_FF_FreezeFrame_Struct_SI_SECINVFAULTBF213__6 "" LINEAR "%.15" "" COEFFS_LINEAR 4 -508 /end COMPU_METHOD
/begin COMPU_METHOD RTE.CM_FF_FreezeFrame_Struct_SI_SECINVFAULTBF213__7 "" LINEAR "%.15" "" COEFFS_LINEAR 2 -255 /end COMPU_METHOD
/begin COMPU_METHOD RTE.CM_FF_FreezeFrame_Struct_SI_SECINVFAULTBF213__9 "" LINEAR "%.15" "" COEFFS_LINEAR 4 -508 /end COMPU_METHOD
/begin COMPU_METHOD RTE.CM_FF_FreezeFrame_Struct_SI_SECINVFAULTBF214__0 "" LINEAR "%.15" "" COEFFS_LINEAR 1 -32767 /end COMPU_METHOD
/begin COMPU_METHOD RTE.CM_FF_FreezeFrame_Struct_SI_SECINVFAULTBF214__1 "" LINEAR "%.15" "" COEFFS_LINEAR 4 -508 /end COMPU_METHOD
/begin COMPU_METHOD RTE.CM_FF_FreezeFrame_Struct_SI_SECINVFAULTBF214__6 "" LINEAR "%.15" "" COEFFS_LINEAR 4 -508 /end COMPU_METHOD
/begin COMPU_METHOD RTE.CM_FF_FreezeFrame_Struct_SI_SECINVFAULTBF214__7 "" LINEAR "%.15" "" COEFFS_LINEAR 2 -255 /end COMPU_METHOD
/begin COMPU_METHOD RTE.CM_FF_FreezeFrame_Struct_SI_SECINVFAULTBF214__9 "" LINEAR "%.15" "" COEFFS_LINEAR 4 -508 /end COMPU_METHOD
/begin COMPU_METHOD RTE.CM_FF_FreezeFrame_Struct_SI_SECINVFAULTBF215__0 "" LINEAR "%.15" "" COEFFS_LINEAR 1 -32767 /end COMPU_METHOD
/begin COMPU_METHOD RTE.CM_FF_FreezeFrame_Struct_SI_SECINVFAULTBF215__1 "" LINEAR "%.15" "" COEFFS_LINEAR 4 -508 /end COMPU_METHOD
/begin COMPU_METHOD RTE.CM_FF_FreezeFrame_Struct_SI_SECINVFAULTBF215__6 "" LINEAR "%.15" "" COEFFS_LINEAR 4 -508 /end COMPU_METHOD
/begin COMPU_METHOD RTE.CM_FF_FreezeFrame_Struct_SI_SECINVFAULTBF215__7 "" LINEAR "%.15" "" COEFFS_LINEAR 2 -255 /end COMPU_METHOD
/begin COMPU_METHOD RTE.CM_FF_FreezeFrame_Struct_SI_SECINVFAULTBF215__9 "" LINEAR "%.15" "" COEFFS_LINEAR 4 -508 /end COMPU_METHOD
/begin COMPU_METHOD RTE.CM_FF_FreezeFrame_Struct_SI_SECINVFAULTBF216__0 "" LINEAR "%.15" "" COEFFS_LINEAR 1 -32767 /end COMPU_METHOD
/begin COMPU_METHOD RTE.CM_FF_FreezeFrame_Struct_SI_SECINVFAULTBF216__1 "" LINEAR "%.15" "" COEFFS_LINEAR 4 -508 /end COMPU_METHOD
/begin COMPU_METHOD RTE.CM_FF_FreezeFrame_Struct_SI_SECINVFAULTBF216__6 "" LINEAR "%.15" "" COEFFS_LINEAR 4 -508 /end COMPU_METHOD
/begin COMPU_METHOD RTE.CM_FF_FreezeFrame_Struct_SI_SECINVFAULTBF216__7 "" LINEAR "%.15" "" COEFFS_LINEAR 2 -255 /end COMPU_METHOD
/begin COMPU_METHOD RTE.CM_FF_FreezeFrame_Struct_SI_SECINVFAULTBF216__9 "" LINEAR "%.15" "" COEFFS_LINEAR 4 -508 /end COMPU_METHOD
/begin COMPU_METHOD RTE.CM_FF_FreezeFrame_Struct_SI_SECINVFAULTBF219__0 "" LINEAR "%.15" "" COEFFS_LINEAR 1 -32767 /end COMPU_METHOD
/begin COMPU_METHOD RTE.CM_FF_FreezeFrame_Struct_SI_SECINVFAULTBF219__1 "" LINEAR "%.15" "" COEFFS_LINEAR 4 -508 /end COMPU_METHOD
/begin COMPU_METHOD RTE.CM_FF_FreezeFrame_Struct_SI_SECINVFAULTBF219__6 "" LINEAR "%.15" "" COEFFS_LINEAR 4 -508 /end COMPU_METHOD
/begin COMPU_METHOD RTE.CM_FF_FreezeFrame_Struct_SI_SECINVFAULTBF219__7 "" LINEAR "%.15" "" COEFFS_LINEAR 2 -255 /end COMPU_METHOD
/begin COMPU_METHOD RTE.CM_FF_FreezeFrame_Struct_SI_SECINVFAULTBF219__9 "" LINEAR "%.15" "" COEFFS_LINEAR 4 -508 /end COMPU_METHOD
/begin COMPU_METHOD RTE.CM_FF_FreezeFrame_Struct_SI_SECINVFAULTBF221__0 "" LINEAR "%.15" "" COEFFS_LINEAR 1 -32767 /end COMPU_METHOD
/begin COMPU_METHOD RTE.CM_FF_FreezeFrame_Struct_SI_SECINVFAULTBF221__1 "" LINEAR "%.15" "" COEFFS_LINEAR 4 -508 /end COMPU_METHOD
/begin COMPU_METHOD RTE.CM_FF_FreezeFrame_Struct_SI_SECINVFAULTBF221__6 "" LINEAR "%.15" "" COEFFS_LINEAR 4 -508 /end COMPU_METHOD
/begin COMPU_METHOD RTE.CM_FF_FreezeFrame_Struct_SI_SECINVFAULTBF221__7 "" LINEAR "%.15" "" COEFFS_LINEAR 2 -255 /end COMPU_METHOD
/begin COMPU_METHOD RTE.CM_FF_FreezeFrame_Struct_SI_SECINVFAULTBF221__9 "" LINEAR "%.15" "" COEFFS_LINEAR 4 -508 /end COMPU_METHOD
/begin COMPU_METHOD RTE.CM_FF_FreezeFrame_Struct_SI_TRQ_DIFGEAR_OVERSHOOT__0 "" LINEAR "%.15" "" COEFFS_LINEAR 1 -32767 /end COMPU_METHOD
/begin COMPU_METHOD RTE.CM_FF_FreezeFrame_Struct_SI_TRQ_DIFGEAR_OVERSHOOT__1 "" LINEAR "%.15" "" COEFFS_LINEAR 4 -508 /end COMPU_METHOD
/begin COMPU_METHOD RTE.CM_FF_FreezeFrame_Struct_SI_TRQ_DIFGEAR_OVERSHOOT__4 "" LINEAR "%.15" "" COEFFS_LINEAR 2 -255 /end COMPU_METHOD
/begin COMPU_METHOD RTE.CM_FF_FreezeFrame_Struct_SI_TRQ_DIFGEAR_OVERSHOOT__5 "" LINEAR "%.15" "" COEFFS_LINEAR 2 -255 /end COMPU_METHOD
/begin COMPU_METHOD RTE.CM_FF_FreezeFrame_Struct_SI_TRQ_DIFGEAR_OVERSHOOT__6 "" LINEAR "%.15" "" COEFFS_LINEAR 2 -255 /end COMPU_METHOD
/begin COMPU_METHOD RTE.CM_FF_FreezeFrame_Struct_SI_TRQ_DIFGEAR_OVERSHOOT__7 "" LINEAR "%.15" "" COEFFS_LINEAR 2 -255 /end COMPU_METHOD
/begin COMPU_METHOD RTE.CM_FF_FreezeFrame_Struct_SI_TRQ_DIFGEAR_OVERSHOOT__8 "" LINEAR "%.15" "" COEFFS_LINEAR 2 -255 /end COMPU_METHOD
/begin COMPU_METHOD RTE.CM_FF_FreezeFrame_Struct_SI_TRQ_DIFGEAR_OVERSHOOT__9 "" LINEAR "%.15" "" COEFFS_LINEAR 2 -255 /end COMPU_METHOD
/begin COMPU_METHOD RTE.CM_IoHwAb_CalnState_cm "" TAB_VERB "%.15" "-" COMPU_TAB_REF IoHwAb_CalnState /end COMPU_METHOD
/begin COMPU_METHOD RTE.CM_IoHwAb_PwrStgDrvrInactvState_cm "" TAB_VERB "%.15" "-" COMPU_TAB_REF IoHwAb_PwrStgDrvrInactvState /end COMPU_METHOD
/begin COMPU_METHOD RTE.CM_IoHwAb_StrtupState_cm "" TAB_VERB "%.15" "-" COMPU_TAB_REF IoHwAb_StrtupState /end COMPU_METHOD
/begin COMPU_METHOD RTE.CM_LibTlHwIo_PwrStgFbOpnMode_cm "" TAB_VERB "%.15" "-" COMPU_TAB_REF LibTlHwIo_PwrStgFbOpnMode /end COMPU_METHOD
/begin COMPU_METHOD RTE.CM_LibTlHwIo_PwrStgOpnMode_cm "" TAB_VERB "%.15" "-" COMPU_TAB_REF LibTlHwIo_PwrStgOpnMode /end COMPU_METHOD
/begin COMPU_METHOD RTE.CM_LibTlSrvc_CmpntState_cm "" TAB_VERB "%.15" "-" COMPU_TAB_REF LibTlSrvc_CmpntState /end COMPU_METHOD
/begin COMPU_METHOD RTE.CM_LibTlSrvc_DcmIfCmd_cm "" TAB_VERB "%.15" "-" COMPU_TAB_REF LibTlSrvc_DcmIfCmd /end COMPU_METHOD
/begin COMPU_METHOD RTE.CM_LibTlSrvc_DcmIfRoutnState_cm "" TAB_VERB "%.15" "-" COMPU_TAB_REF LibTlSrvc_DcmIfRoutnState /end COMPU_METHOD
/begin COMPU_METHOD RTE.CM_LibTlSrvc_DiagEventBf_cm "" TAB_VERB "%.15" "-" COMPU_TAB_REF LibTlSrvc_DiagEventBf /end COMPU_METHOD
/begin COMPU_METHOD RTE.CM_MCU_ResetType_t_cm "" TAB_VERB "%.15" "-" COMPU_TAB_REF MCU_ResetType_t /end COMPU_METHOD
/begin COMPU_METHOD RTE.CM_MCU_State_cm "" TAB_VERB "%.15" "-" COMPU_TAB_REF MCU_State /end COMPU_METHOD
/begin COMPU_METHOD RTE.CM_MptEcuvarSelect_Variant_cm "" TAB_VERB "%.15" "-" COMPU_TAB_REF MptEcuvarSelect_Variant /end COMPU_METHOD
/begin COMPU_METHOD RTE.CM_Nm_StateType_t_cm "" TAB_VERB "%.15" "-" COMPU_TAB_REF Nm_StateType_t /end COMPU_METHOD
/begin COMPU_METHOD RTE.CM_OS_IF_NLSC_ErrorStatus_cm "" TAB_VERB "%.15" "-" COMPU_TAB_REF OS_IF_NLSC_ErrorStatus /end COMPU_METHOD
/begin COMPU_METHOD RTE.CM_PORT_HW_INVERTER_t_cm "" TAB_VERB "%.15" "-" COMPU_TAB_REF PORT_HW_INVERTER_t /end COMPU_METHOD
/begin COMPU_METHOD RTE.CM_PS_stGear_cm "" TAB_VERB "%.15" "-" COMPU_TAB_REF PS_stGear /end COMPU_METHOD
/begin COMPU_METHOD RTE.CM_PS_stPosMon_cm "" TAB_VERB "%.15" "-" COMPU_TAB_REF PS_stPosMon /end COMPU_METHOD
/begin COMPU_METHOD RTE.CM_RTE_IF_MCU_Temperature_t__0 "" LINEAR "%.15" "degreeCelcius" COEFFS_LINEAR 0.0625 0 /end COMPU_METHOD
/begin COMPU_METHOD RTE.CM_RTE_IF_MCU_Temperature_t__2 "" LINEAR "%.15" "degreeCelcius" COEFFS_LINEAR 0.0625 0 /end COMPU_METHOD
/begin COMPU_METHOD RTE.CM_RTE_IF_PMS_Voltages_t__0 "" LINEAR "%.15" "Voltage" COEFFS_LINEAR 0.0009765625 0 /end COMPU_METHOD
/begin COMPU_METHOD RTE.CM_RTE_IF_PMS_Voltages_t__10 "" LINEAR "%.15" "Voltage" COEFFS_LINEAR 0.0009765625 0 /end COMPU_METHOD
/begin COMPU_METHOD RTE.CM_RTE_IF_PMS_Voltages_t__2 "" LINEAR "%.15" "Voltage" COEFFS_LINEAR 0.0009765625 0 /end COMPU_METHOD
/begin COMPU_METHOD RTE.CM_RTE_IF_PMS_Voltages_t__4 "" LINEAR "%.15" "Voltage" COEFFS_LINEAR 0.0009765625 0 /end COMPU_METHOD
/begin COMPU_METHOD RTE.CM_RTE_IF_PMS_Voltages_t__6 "" LINEAR "%.15" "Voltage" COEFFS_LINEAR 0.0009765625 0 /end COMPU_METHOD
/begin COMPU_METHOD RTE.CM_RTE_IF_PMS_Voltages_t__8 "" LINEAR "%.15" "Voltage" COEFFS_LINEAR 0.0009765625 0 /end COMPU_METHOD
/begin COMPU_METHOD RTE.CM_SBC_Mux_cm "" TAB_VERB "%.15" "-" COMPU_TAB_REF SBC_Mux /end COMPU_METHOD
/begin COMPU_METHOD RTE.CM_SBC_State_cm "" TAB_VERB "%.15" "-" COMPU_TAB_REF SBC_State /end COMPU_METHOD
/begin COMPU_METHOD RTE.CM_SBC_nFault_FSXb1_cm "" TAB_VERB "%.15" "-" COMPU_TAB_REF SBC_nFault_FSXb1 /end COMPU_METHOD
/begin COMPU_METHOD RTE.CM_SBC_nSSP3_cm "" TAB_VERB "%.15" "-" COMPU_TAB_REF SBC_nSSP3 /end COMPU_METHOD
/begin COMPU_METHOD RTE.CM_SI_OrrdCdnWhlSpdBsdTrqLimCalcn_cm "" TAB_VERB "%.15" "-" COMPU_TAB_REF SI_OrrdCdnWhlSpdBsdTrqLimCalcn /end COMPU_METHOD
/begin COMPU_METHOD RTE.CM_SI_cmdEmReq_cm "" TAB_VERB "%.15" "-" COMPU_TAB_REF SI_cmdEmReq /end COMPU_METHOD
/begin COMPU_METHOD RTE.CM_SI_stGear_cm "" TAB_VERB "%.15" "-" COMPU_TAB_REF SI_stGear /end COMPU_METHOD
/begin COMPU_METHOD RTE.CM_SI_statePwrNet_cm "" TAB_VERB "%.15" "-" COMPU_TAB_REF SI_statePwrNet /end COMPU_METHOD
/begin COMPU_METHOD RTE.CM_SMU_NLSC_ErrorStatus_cm "" TAB_VERB "%.15" "-" COMPU_TAB_REF SMU_NLSC_ErrorStatus /end COMPU_METHOD
/begin COMPU_METHOD RTE.CM_Struct_DCU_CALIB_CONFIRM__0 "" LINEAR "%.15" "mm" COEFFS_LINEAR 1 0 /end COMPU_METHOD
/begin COMPU_METHOD RTE.CM_Struct_DCU_CALIB_CONFIRM__1 "" LINEAR "%.15" "mm" COEFFS_LINEAR 1 0 /end COMPU_METHOD
/begin COMPU_METHOD RTE.CM_Struct_DCU_CALIB_CONFIRM__2 "" LINEAR "%.15" "mm" COEFFS_LINEAR 1 0 /end COMPU_METHOD
/begin COMPU_METHOD RTE.CM_Struct_DCU_CALIB_VALUES__0 "" LINEAR "%.15" "mm" COEFFS_LINEAR 1 0 /end COMPU_METHOD
/begin COMPU_METHOD RTE.CM_Struct_DCU_CALIB_VALUES__1 "" LINEAR "%.15" "mm" COEFFS_LINEAR 1 0 /end COMPU_METHOD
/begin COMPU_METHOD RTE.CM_Struct_DCU_CALIB_VALUES__2 "" LINEAR "%.15" "mm" COEFFS_LINEAR 1 0 /end COMPU_METHOD
/begin COMPU_METHOD RTE.CM_Struct_DCU_CALIB_VALUES__3 "" LINEAR "%.15" "mm" COEFFS_LINEAR 1 0 /end COMPU_METHOD
/begin COMPU_METHOD RTE.CM_Struct_DCU_CALIB_VALUES__4 "" LINEAR "%.15" "mm" COEFFS_LINEAR 1 0 /end COMPU_METHOD
/begin COMPU_METHOD RTE.CM_Struct_DCU_CALIB_VALUES__5 "" LINEAR "%.15" "mm" COEFFS_LINEAR 1 0 /end COMPU_METHOD
/begin COMPU_METHOD RTE.CM_TLT_AVL_SIG_AGE "" LINEAR "%.15" "NoUnit" COEFFS_LINEAR 5 0 /end COMPU_METHOD
/begin COMPU_METHOD RTE.CM_TLT_PT4_INV1Ctrl_Cltch_RPM_diff_ST3 "" LINEAR "%.15" "NoUnit" COEFFS_LINEAR 0.5 -127 /end COMPU_METHOD
/begin COMPU_METHOD RTE.CM_TLT_PT4_INV1Ctrl_DC_Curr_ST3 "" LINEAR "%.15" "NoUnit" COEFFS_LINEAR 0.1 -1638.2 /end COMPU_METHOD
/begin COMPU_METHOD RTE.CM_TLT_PT4_INV1Ctrl_DC_Volt_ST3 "" LINEAR "%.15" "NoUnit" COEFFS_LINEAR 0.025 0 /end COMPU_METHOD
/begin COMPU_METHOD RTE.CM_TLT_PT4_INV1Ctrl_EMTrqLoss_ST3 "" LINEAR "%.15" "NoUnit" COEFFS_LINEAR 0.0625 0 /end COMPU_METHOD
/begin COMPU_METHOD RTE.CM_TLT_PT4_INV1Ctrl_LowTemp_FlowVolCirc1_Rq_ST3 "" LINEAR "%.15" "NoUnit" COEFFS_LINEAR 0.1 0 /end COMPU_METHOD
/begin COMPU_METHOD RTE.CM_TLT_PT4_INV1Ctrl_OilCool_Rotor_Rq_ST3 "" LINEAR "%.15" "NoUnit" COEFFS_LINEAR 0.1 0 /end COMPU_METHOD
/begin COMPU_METHOD RTE.CM_TLT_PT4_INV1Ctrl_OilCool_Stator_Rq_ST3 "" LINEAR "%.15" "NoUnit" COEFFS_LINEAR 0.1 0 /end COMPU_METHOD
/begin COMPU_METHOD RTE.CM_TLT_PT4_INV1Ctrl_PhaseAC_Curr_ST3 "" LINEAR "%.15" "NoUnit" COEFFS_LINEAR 0.1 0 /end COMPU_METHOD
/begin COMPU_METHOD RTE.CM_TLT_PT4_INV1Ctrl_PredTrqAvl_Max_ST3 "" LINEAR "%.15" "NoUnit" COEFFS_LINEAR 0.0625 -2047.9375 /end COMPU_METHOD
/begin COMPU_METHOD RTE.CM_TLT_PT4_INV1Ctrl_PredTrqAvl_Min_ST3 "" LINEAR "%.15" "NoUnit" COEFFS_LINEAR 0.0625 -2047.9375 /end COMPU_METHOD
/begin COMPU_METHOD RTE.CM_TLT_PT4_INV1Ctrl_PwrLoss_ST3 "" LINEAR "%.15" "NoUnit" COEFFS_LINEAR 20 0 /end COMPU_METHOD
/begin COMPU_METHOD RTE.CM_TLT_PT4_INV1Ctrl_RPM_ST3 "" LINEAR "%.15" "NoUnit" COEFFS_LINEAR 0.25 -131071.75 /end COMPU_METHOD
/begin COMPU_METHOD RTE.CM_TLT_PT4_INV1Ctrl_Temp_Cpctr_ST3 "" LINEAR "%.15" "NoUnit" COEFFS_LINEAR 1 -40 /end COMPU_METHOD
/begin COMPU_METHOD RTE.CM_TLT_PT4_INV1Ctrl_Temp_InvCool_Inlet_ST3 "" LINEAR "%.15" "NoUnit" COEFFS_LINEAR 1 -40 /end COMPU_METHOD
/begin COMPU_METHOD RTE.CM_TLT_PT4_INV1Ctrl_Temp_InvCool_ST3 "" LINEAR "%.15" "NoUnit" COEFFS_LINEAR 1 -40 /end COMPU_METHOD
/begin COMPU_METHOD RTE.CM_TLT_PT4_INV1Ctrl_Temp_Invrt_ST3 "" LINEAR "%.15" "NoUnit" COEFFS_LINEAR 1 -40 /end COMPU_METHOD
/begin COMPU_METHOD RTE.CM_TLT_PT4_INV1Ctrl_Temp_RotorObsrv_ST3 "" LINEAR "%.15" "NoUnit" COEFFS_LINEAR 1 -40 /end COMPU_METHOD
/begin COMPU_METHOD RTE.CM_TLT_PT4_INV1Ctrl_Temp_Stator_ST3 "" LINEAR "%.15" "NoUnit" COEFFS_LINEAR 1 -40 /end COMPU_METHOD
/begin COMPU_METHOD RTE.CM_TLT_PT4_INV1Ctrl_TrqAvl_Max_ST3 "" LINEAR "%.15" "NoUnit" COEFFS_LINEAR 0.0625 -2047.9375 /end COMPU_METHOD
/begin COMPU_METHOD RTE.CM_TLT_PT4_INV1Ctrl_TrqAvl_Min_ST3 "" LINEAR "%.15" "NoUnit" COEFFS_LINEAR 0.0625 -2047.9375 /end COMPU_METHOD
/begin COMPU_METHOD RTE.CM_TLT_PT4_INV1Ctrl_TrqComf_ST3 "" LINEAR "%.15" "NoUnit" COEFFS_LINEAR 0.0625 -2047.9375 /end COMPU_METHOD
/begin COMPU_METHOD RTE.CM_TLT_PT4_INV1Ctrl_Trq_ST3 "" LINEAR "%.15" "NoUnit" COEFFS_LINEAR 0.0625 -2047.9375 /end COMPU_METHOD
/begin COMPU_METHOD RTE.CM_T_Asw_Ang_deg "" LINEAR "%.15" "deg" COEFFS_LINEAR 1 0 /end COMPU_METHOD
/begin COMPU_METHOD RTE.CM_T_Asw_Ang_deg_Qfd__0 "" LINEAR "%.15" "deg" COEFFS_LINEAR 1 0 /end COMPU_METHOD
/begin COMPU_METHOD RTE.CM_T_Asw_AngrVel_radps "" LINEAR "%.15" "radps" COEFFS_LINEAR 1 0 /end COMPU_METHOD
/begin COMPU_METHOD RTE.CM_T_Asw_AngrVel_radps_Qfd__0 "" LINEAR "%.15" "radps" COEFFS_LINEAR 1 0 /end COMPU_METHOD
/begin COMPU_METHOD RTE.CM_T_Asw_Curr_A "" LINEAR "%.15" "A" COEFFS_LINEAR 1 0 /end COMPU_METHOD
/begin COMPU_METHOD RTE.CM_T_Asw_Curr_A_Qfd__0 "" LINEAR "%.15" "A" COEFFS_LINEAR 1 0 /end COMPU_METHOD
/begin COMPU_METHOD RTE.CM_T_Asw_Curr_Apeak "" LINEAR "%.15" "Apeak" COEFFS_LINEAR 1 0 /end COMPU_METHOD
/begin COMPU_METHOD RTE.CM_T_Asw_Curr_Arms "" LINEAR "%.15" "Arms" COEFFS_LINEAR 1 0 /end COMPU_METHOD
/begin COMPU_METHOD RTE.CM_T_Asw_Curr_Arms_Qfd__0 "" LINEAR "%.15" "Arms" COEFFS_LINEAR 1 0 /end COMPU_METHOD
/begin COMPU_METHOD RTE.CM_T_Asw_Flux_Wb "" LINEAR "%.15" "Wb" COEFFS_LINEAR 1 0 /end COMPU_METHOD
/begin COMPU_METHOD RTE.CM_T_Asw_Frq_Hz "" LINEAR "%.15" "Hz" COEFFS_LINEAR 1 0 /end COMPU_METHOD
/begin COMPU_METHOD RTE.CM_T_Asw_Ind_H "" LINEAR "%.15" "H" COEFFS_LINEAR 1 0 /end COMPU_METHOD
/begin COMPU_METHOD RTE.CM_T_Asw_Len_km_Qfd__0 "" LINEAR "%.15" "km" COEFFS_LINEAR 1 0 /end COMPU_METHOD
/begin COMPU_METHOD RTE.CM_T_Asw_Len_mm "" LINEAR "%.15" "mm" COEFFS_LINEAR 1 0 /end COMPU_METHOD
/begin COMPU_METHOD RTE.CM_T_Asw_Len_mm_Qfd__0 "" LINEAR "%.15" "mm" COEFFS_LINEAR 1 0 /end COMPU_METHOD
/begin COMPU_METHOD RTE.CM_T_Asw_Pwr_W "" LINEAR "%.15" "W" COEFFS_LINEAR 1 0 /end COMPU_METHOD
/begin COMPU_METHOD RTE.CM_T_Asw_Pwr_W_Qfd__0 "" LINEAR "%.15" "W" COEFFS_LINEAR 1 0 /end COMPU_METHOD
/begin COMPU_METHOD RTE.CM_T_Asw_Rstc_Ohm "" LINEAR "%.15" "Ohm" COEFFS_LINEAR 1 0 /end COMPU_METHOD
/begin COMPU_METHOD RTE.CM_T_Asw_SpdRate_rpmps "" LINEAR "%.15" "rpmps" COEFFS_LINEAR 1 0 /end COMPU_METHOD
/begin COMPU_METHOD RTE.CM_T_Asw_SpdRate_rpmps_Qfd__0 "" LINEAR "%.15" "rpmps" COEFFS_LINEAR 1 0 /end COMPU_METHOD
/begin COMPU_METHOD RTE.CM_T_Asw_Spd_rpm "" LINEAR "%.15" "rpm" COEFFS_LINEAR 1 0 /end COMPU_METHOD
/begin COMPU_METHOD RTE.CM_T_Asw_Spd_rpm_Qfd__0 "" LINEAR "%.15" "rpm" COEFFS_LINEAR 1 0 /end COMPU_METHOD
/begin COMPU_METHOD RTE.CM_T_Asw_Temp_degC "" LINEAR "%.15" "degC" COEFFS_LINEAR 1 0 /end COMPU_METHOD
/begin COMPU_METHOD RTE.CM_T_Asw_Temp_degC_Qfd__0 "" LINEAR "%.15" "degC" COEFFS_LINEAR 1 0 /end COMPU_METHOD
/begin COMPU_METHOD RTE.CM_T_Asw_Time_s "" LINEAR "%.15" "s" COEFFS_LINEAR 1 0 /end COMPU_METHOD
/begin COMPU_METHOD RTE.CM_T_Asw_Time_s_Qfd__0 "" LINEAR "%.15" "s" COEFFS_LINEAR 1 0 /end COMPU_METHOD
/begin COMPU_METHOD RTE.CM_T_Asw_Time_us "" LINEAR "%.15" "us" COEFFS_LINEAR 1 0 /end COMPU_METHOD
/begin COMPU_METHOD RTE.CM_T_Asw_TrqRate_Nmps_Qfd__0 "" LINEAR "%.15" "Nmps" COEFFS_LINEAR 1 0 /end COMPU_METHOD
/begin COMPU_METHOD RTE.CM_T_Asw_Trq_Nm "" LINEAR "%.15" "Nm" COEFFS_LINEAR 1 0 /end COMPU_METHOD
/begin COMPU_METHOD RTE.CM_T_Asw_Trq_Nm_Qfd__0 "" LINEAR "%.15" "Nm" COEFFS_LINEAR 1 0 /end COMPU_METHOD
/begin COMPU_METHOD RTE.CM_T_Asw_Vel_kmh "" LINEAR "%.15" "kmh" COEFFS_LINEAR 1 0 /end COMPU_METHOD
/begin COMPU_METHOD RTE.CM_T_Asw_Vel_kmh_Qfd__0 "" LINEAR "%.15" "kmh" COEFFS_LINEAR 1 0 /end COMPU_METHOD
/begin COMPU_METHOD RTE.CM_T_Asw_Vof_lpmin "" LINEAR "%.15" "lpmin" COEFFS_LINEAR 1 0 /end COMPU_METHOD
/begin COMPU_METHOD RTE.CM_T_Asw_Vof_lpmin_Qfd__0 "" LINEAR "%.15" "lpmin" COEFFS_LINEAR 1 0 /end COMPU_METHOD
/begin COMPU_METHOD RTE.CM_T_Asw_Volt_V "" LINEAR "%.15" "V" COEFFS_LINEAR 1 0 /end COMPU_METHOD
/begin COMPU_METHOD RTE.CM_T_Asw_Volt_V_Qfd__0 "" LINEAR "%.15" "V" COEFFS_LINEAR 1 0 /end COMPU_METHOD
/begin COMPU_METHOD RTE.CM_T_Asw_Volt_Vpeak "" LINEAR "%.15" "Vpeak" COEFFS_LINEAR 1 0 /end COMPU_METHOD
/begin COMPU_METHOD RTE.CM_T_Edp_EcuTemp__0 "" LINEAR "%.15" "degC" COEFFS_LINEAR 0.0625 0 /end COMPU_METHOD
/begin COMPU_METHOD RTE.CM_T_Edp_EcuTemp__1 "" LINEAR "%.15" "degC" COEFFS_LINEAR 0.0625 0 /end COMPU_METHOD
/begin COMPU_METHOD RTE.CM_T_Edp_EcuVolt__0 "" LINEAR "%.15" "V" COEFFS_LINEAR 0.0009765625 0 /end COMPU_METHOD
/begin COMPU_METHOD RTE.CM_T_Edp_EcuVolt__1 "" LINEAR "%.15" "V" COEFFS_LINEAR 0.0009765625 0 /end COMPU_METHOD
/begin COMPU_METHOD RTE.CM_T_Edp_EcuVolt__2 "" LINEAR "%.15" "V" COEFFS_LINEAR 0.0009765625 0 /end COMPU_METHOD
/begin COMPU_METHOD RTE.CM_T_Edp_EcuVolt__3 "" LINEAR "%.15" "V" COEFFS_LINEAR 0.0009765625 0 /end COMPU_METHOD
/begin COMPU_METHOD RTE.CM_T_Edp_EmRpsCalnFb__2 "" LINEAR "%.15" "deg" COEFFS_LINEAR 1 0 /end COMPU_METHOD
/begin COMPU_METHOD RTE.CM_T_Edp_EmRpsCalnNvm__3 "" LINEAR "%.15" "deg" COEFFS_LINEAR 1 0 /end COMPU_METHOD
/begin COMPU_METHOD RTE.CM_T_Edp_EmShdnStateNvm__10 "" LINEAR "%.15" "degC" COEFFS_LINEAR 0.015625 0 /end COMPU_METHOD
/begin COMPU_METHOD RTE.CM_T_Edp_EmShdnStateNvm__11 "" LINEAR "%.15" "degC" COEFFS_LINEAR 0.015625 0 /end COMPU_METHOD
/begin COMPU_METHOD RTE.CM_T_Edp_EmShdnStateNvm__12 "" LINEAR "%.15" "degC" COEFFS_LINEAR 0.015625 0 /end COMPU_METHOD
/begin COMPU_METHOD RTE.CM_T_Edp_EmShdnStateNvm__13 "" LINEAR "%.15" "degC" COEFFS_LINEAR 0.015625 0 /end COMPU_METHOD
/begin COMPU_METHOD RTE.CM_T_Edp_EmShdnStateNvm__2 "" LINEAR "%.15" "degC" COEFFS_LINEAR 0.015625 0 /end COMPU_METHOD
/begin COMPU_METHOD RTE.CM_T_Edp_EmShdnStateNvm__3 "" LINEAR "%.15" "degC" COEFFS_LINEAR 0.015625 0 /end COMPU_METHOD
/begin COMPU_METHOD RTE.CM_T_Edp_EmShdnStateNvm__4 "" LINEAR "%.15" "degC" COEFFS_LINEAR 0.015625 0 /end COMPU_METHOD
/begin COMPU_METHOD RTE.CM_T_Edp_EmShdnStateNvm__5 "" LINEAR "%.15" "degC" COEFFS_LINEAR 0.015625 0 /end COMPU_METHOD
/begin COMPU_METHOD RTE.CM_T_Edp_EmShdnStateNvm__6 "" LINEAR "%.15" "degC" COEFFS_LINEAR 0.015625 0 /end COMPU_METHOD
/begin COMPU_METHOD RTE.CM_T_Edp_EmShdnStateNvm__7 "" LINEAR "%.15" "degC" COEFFS_LINEAR 0.015625 0 /end COMPU_METHOD
/begin COMPU_METHOD RTE.CM_T_Edp_EmShdnStateNvm__8 "" LINEAR "%.15" "degC" COEFFS_LINEAR 0.015625 0 /end COMPU_METHOD
/begin COMPU_METHOD RTE.CM_T_Edp_EmShdnStateNvm__9 "" LINEAR "%.15" "degC" COEFFS_LINEAR 0.015625 0 /end COMPU_METHOD
/begin COMPU_METHOD RTE.CM_T_Edp_InvPhaseCurrAdcVoltOffs "" LINEAR "%.15" "V" COEFFS_LINEAR 1 0 /end COMPU_METHOD
/begin COMPU_METHOD RTE.CM_T_Edp_iAct_Qfd__0 "" LINEAR "%.15" "A" COEFFS_LINEAR 1 0 /end COMPU_METHOD
/begin COMPU_METHOD RTE.CM_T_Edp_iAct_Qfd__1 "" LINEAR "%.15" "A" COEFFS_LINEAR 1 0 /end COMPU_METHOD
/begin COMPU_METHOD RTE.CM_T_Edp_iAct_Qfd__2 "" LINEAR "%.15" "us" COEFFS_LINEAR 1 0 /end COMPU_METHOD
/begin COMPU_METHOD RTE.CM_T_EmCtrl_NoiseShapReq__0 "" LINEAR "%.15" "Vpeak" COEFFS_LINEAR 1 0 /end COMPU_METHOD
/begin COMPU_METHOD RTE.CM_T_EmCtrl_NoiseShapReq__1 "" LINEAR "%.15" "Vpeak" COEFFS_LINEAR 1 0 /end COMPU_METHOD
/begin COMPU_METHOD RTE.CM_T_EmCtrl_NoiseShapReq__2 "" LINEAR "%.15" "deg" COEFFS_LINEAR 1 0 /end COMPU_METHOD
/begin COMPU_METHOD RTE.CM_T_EmCtrl_NoiseShapReq__3 "" LINEAR "%.15" "deg" COEFFS_LINEAR 1 0 /end COMPU_METHOD
/begin COMPU_METHOD RTE.CM_T_EmInvEstn_HvParBus__0 "" LINEAR "%.15" "V" COEFFS_LINEAR 1 0 /end COMPU_METHOD
/begin COMPU_METHOD RTE.CM_T_EmInvEstn_HvParBus__10 "" LINEAR "%.15" "degC" COEFFS_LINEAR 1 0 /end COMPU_METHOD
/begin COMPU_METHOD RTE.CM_T_EmInvEstn_HvParBus__11 "" LINEAR "%.15" "A" COEFFS_LINEAR 1 0 /end COMPU_METHOD
/begin COMPU_METHOD RTE.CM_T_EmInvEstn_HvParBus__12 "" LINEAR "%.15" "Arms" COEFFS_LINEAR 1 0 /end COMPU_METHOD
/begin COMPU_METHOD RTE.CM_T_EmInvEstn_HvParBus__3 "" LINEAR "%.15" "Arms" COEFFS_LINEAR 1 0 /end COMPU_METHOD
/begin COMPU_METHOD RTE.CM_T_EmInvEstn_HvParBus__4 "" LINEAR "%.15" "Apeak" COEFFS_LINEAR 1 0 /end COMPU_METHOD
/begin COMPU_METHOD RTE.CM_T_EmInvEstn_HvParBus__5 "" LINEAR "%.15" "radps" COEFFS_LINEAR 1 0 /end COMPU_METHOD
/begin COMPU_METHOD RTE.CM_T_EmInvEstn_HvParBus__6 "" LINEAR "%.15" "Vrms" COEFFS_LINEAR 1 0 /end COMPU_METHOD
/begin COMPU_METHOD RTE.CM_T_EmInvEstn_HvParBus__7 "" LINEAR "%.15" "Hz" COEFFS_LINEAR 1 0 /end COMPU_METHOD
/begin COMPU_METHOD RTE.CM_T_EmInvEstn_Inv3PhaseCurrVect "" LINEAR "%.15" "A" COEFFS_LINEAR 1 0 /end COMPU_METHOD
/begin COMPU_METHOD RTE.CM_T_EmInvEstn_PwrLossTotalHvBus__0 "" LINEAR "%.15" "W" COEFFS_LINEAR 1 0 /end COMPU_METHOD
/begin COMPU_METHOD RTE.CM_T_EmInvEstn_PwrLossTotalHvBus__1 "" LINEAR "%.15" "W" COEFFS_LINEAR 1 0 /end COMPU_METHOD
/begin COMPU_METHOD RTE.CM_T_EmInvEstn_PwrLossTotalHvBus__2 "" LINEAR "%.15" "W" COEFFS_LINEAR 1 0 /end COMPU_METHOD
/begin COMPU_METHOD RTE.CM_T_EmLimn_Trq_Nm "" LINEAR "%.15" "Nm" COEFFS_LINEAR 1 0 /end COMPU_METHOD
/begin COMPU_METHOD RTE.CM_T_Em_AcValIrv__4 "" LINEAR "%.15" "V" COEFFS_LINEAR 1 0 /end COMPU_METHOD
/begin COMPU_METHOD RTE.CM_T_Em_AcValIrv__5 "" LINEAR "%.15" "radps" COEFFS_LINEAR 1 0 /end COMPU_METHOD
/begin COMPU_METHOD RTE.CM_T_Em_AcValQfd__7 "" LINEAR "%.15" "V" COEFFS_LINEAR 1 0 /end COMPU_METHOD
/begin COMPU_METHOD RTE.CM_T_Em_AcValQfd__9 "" LINEAR "%.15" "radps" COEFFS_LINEAR 1 0 /end COMPU_METHOD
/begin COMPU_METHOD RTE.CM_T_Em_CtrlReqPrivt__6 "" LINEAR "%.15" "Nm" COEFFS_LINEAR 1 0 /end COMPU_METHOD
/begin COMPU_METHOD RTE.CM_T_Em_CtrlReqPrivt__7 "" LINEAR "%.15" "rpm" COEFFS_LINEAR 1 0 /end COMPU_METHOD
/begin COMPU_METHOD RTE.CM_T_Em_MotTempNvm__1 "" LINEAR "%.15" "degC" COEFFS_LINEAR 1 0 /end COMPU_METHOD
/begin COMPU_METHOD RTE.CM_T_Em_MotTempNvm__10 "" LINEAR "%.15" "degC" COEFFS_LINEAR 1 0 /end COMPU_METHOD
/begin COMPU_METHOD RTE.CM_T_Em_MotTempNvm__11 "" LINEAR "%.15" "degC" COEFFS_LINEAR 1 0 /end COMPU_METHOD
/begin COMPU_METHOD RTE.CM_T_Em_MotTempNvm__12 "" LINEAR "%.15" "degC" COEFFS_LINEAR 1 0 /end COMPU_METHOD
/begin COMPU_METHOD RTE.CM_T_Em_MotTempNvm__2 "" LINEAR "%.15" "degC" COEFFS_LINEAR 1 0 /end COMPU_METHOD
/begin COMPU_METHOD RTE.CM_T_Em_MotTempNvm__3 "" LINEAR "%.15" "degC" COEFFS_LINEAR 1 0 /end COMPU_METHOD
/begin COMPU_METHOD RTE.CM_T_Em_MotTempNvm__4 "" LINEAR "%.15" "degC" COEFFS_LINEAR 1 0 /end COMPU_METHOD
/begin COMPU_METHOD RTE.CM_T_Em_MotTempNvm__5 "" LINEAR "%.15" "degC" COEFFS_LINEAR 1 0 /end COMPU_METHOD
/begin COMPU_METHOD RTE.CM_T_Em_MotTempNvm__6 "" LINEAR "%.15" "degC" COEFFS_LINEAR 1 0 /end COMPU_METHOD
/begin COMPU_METHOD RTE.CM_T_Em_MotTempNvm__7 "" LINEAR "%.15" "degC" COEFFS_LINEAR 1 0 /end COMPU_METHOD
/begin COMPU_METHOD RTE.CM_T_Em_MotTempNvm__8 "" LINEAR "%.15" "degC" COEFFS_LINEAR 1 0 /end COMPU_METHOD
/begin COMPU_METHOD RTE.CM_T_Em_MotTempNvm__9 "" LINEAR "%.15" "degC" COEFFS_LINEAR 1 0 /end COMPU_METHOD
/begin COMPU_METHOD RTE.CM_T_Em_PhaseCurr3Ph "" LINEAR "%.15" "A" COEFFS_LINEAR 1 0 /end COMPU_METHOD
/begin COMPU_METHOD RTE.CM_T_Em_PhasePwrLoss "" LINEAR "%.15" "W" COEFFS_LINEAR 1 0 /end COMPU_METHOD
/begin COMPU_METHOD RTE.CM_T_Em_PwrSwtPwrLossVect "" LINEAR "%.15" "W" COEFFS_LINEAR 1 0 /end COMPU_METHOD
/begin COMPU_METHOD RTE.CM_T_Em_PwrSwtPwrLoss__4 "" LINEAR "%.15" "W" COEFFS_LINEAR 1 0 /end COMPU_METHOD
/begin COMPU_METHOD RTE.CM_T_Em_PwrSwtPwrLoss__5 "" LINEAR "%.15" "W" COEFFS_LINEAR 1 0 /end COMPU_METHOD
/begin COMPU_METHOD RTE.CM_T_Em_PwrSwtTempVect "" LINEAR "%.15" "degC" COEFFS_LINEAR 1 0 /end COMPU_METHOD
/begin COMPU_METHOD RTE.CM_T_Em_RpsCalnResultIntrnl__2 "" LINEAR "%.15" "deg" COEFFS_LINEAR 1 0 /end COMPU_METHOD
/begin COMPU_METHOD RTE.CM_T_Em_VoltVect__0 "" LINEAR "%.15" "Vpeak" COEFFS_LINEAR 1 0 /end COMPU_METHOD
/begin COMPU_METHOD RTE.CM_T_Em_VoltVect__1 "" LINEAR "%.15" "Vpeak" COEFFS_LINEAR 1 0 /end COMPU_METHOD
/begin COMPU_METHOD RTE.CM_T_IoActr_ActrPosnCalcPar__1 "" LINEAR "%.15" "mm" COEFFS_LINEAR 1 0 /end COMPU_METHOD
/begin COMPU_METHOD RTE.CM_T_IoActr_ActrPosnCalcPar__2 "" LINEAR "%.15" "mm" COEFFS_LINEAR 1 0 /end COMPU_METHOD
/begin COMPU_METHOD RTE.CM_T_IoEm_AvgCalcValSum__0 "" LINEAR "%.15" "V" COEFFS_LINEAR 1 0 /end COMPU_METHOD
/begin COMPU_METHOD RTE.CM_T_IoEm_AvgCalcValSum__1 "" LINEAR "%.15" "A" COEFFS_LINEAR 1 0 /end COMPU_METHOD
/begin COMPU_METHOD RTE.CM_T_IoEm_AvgCalcValSum__2 "" LINEAR "%.15" "deg" COEFFS_LINEAR 1 0 /end COMPU_METHOD
/begin COMPU_METHOD RTE.CM_T_IoEm_AvgCalcValSum__3 "" LINEAR "%.15" "V" COEFFS_LINEAR 1 0 /end COMPU_METHOD
/begin COMPU_METHOD RTE.CM_T_IoEm_RpsAmpOffsEstnResult__0 "" LINEAR "%.15" "V" COEFFS_LINEAR 1 0 /end COMPU_METHOD
/begin COMPU_METHOD RTE.CM_T_IoEm_RpsAmpOffsEstnResult__1 "" LINEAR "%.15" "V" COEFFS_LINEAR 1 0 /end COMPU_METHOD
/begin COMPU_METHOD RTE.CM_T_IoEm_RpsAmpOffsEstnResult__2 "" LINEAR "%.15" "V" COEFFS_LINEAR 1 0 /end COMPU_METHOD
/begin COMPU_METHOD RTE.CM_T_IoEm_RpsAmpOffsEstnResult__3 "" LINEAR "%.15" "V" COEFFS_LINEAR 1 0 /end COMPU_METHOD
/begin COMPU_METHOD RTE.CM_T_IoEm_RpsAmpOffsEstnResult__5 "" LINEAR "%.15" "V" COEFFS_LINEAR 1 0 /end COMPU_METHOD
/begin COMPU_METHOD RTE.CM_T_IoEm_RpsAmpOffsEstnResult__6 "" LINEAR "%.15" "V" COEFFS_LINEAR 1 0 /end COMPU_METHOD
/begin COMPU_METHOD RTE.CM_T_IoEm_RpsAmpOffsEstnResult__7 "" LINEAR "%.15" "V" COEFFS_LINEAR 1 0 /end COMPU_METHOD
/begin COMPU_METHOD RTE.CM_T_IoEm_RpsAmpOffsEstnResult__8 "" LINEAR "%.15" "V" COEFFS_LINEAR 1 0 /end COMPU_METHOD
/begin COMPU_METHOD RTE.CM_T_IoEm_RpsCalnAcVal__3 "" LINEAR "%.15" "Vpeak" COEFFS_LINEAR 1 0 /end COMPU_METHOD
/begin COMPU_METHOD RTE.CM_T_IoEm_RpsCalnAcVal__4 "" LINEAR "%.15" "Vpeak" COEFFS_LINEAR 1 0 /end COMPU_METHOD
/begin COMPU_METHOD RTE.CM_T_IoEm_RpsCalnAcVal__5 "" LINEAR "%.15" "deg" COEFFS_LINEAR 1 0 /end COMPU_METHOD
/begin COMPU_METHOD RTE.CM_T_IoEm_RpsCalnAcVal__7 "" LINEAR "%.15" "deg" COEFFS_LINEAR 1 0 /end COMPU_METHOD
/begin COMPU_METHOD RTE.CM_T_IoEm_RpsParTrackgResult__0 "" LINEAR "%.15" "V" COEFFS_LINEAR 1 0 /end COMPU_METHOD
/begin COMPU_METHOD RTE.CM_T_IoEm_RpsParTrackgResult__1 "" LINEAR "%.15" "V" COEFFS_LINEAR 1 0 /end COMPU_METHOD
/begin COMPU_METHOD RTE.CM_T_IoEm_RpsParTrackgResult__2 "" LINEAR "%.15" "V" COEFFS_LINEAR 1 0 /end COMPU_METHOD
/begin COMPU_METHOD RTE.CM_T_IoEm_RpsParTrackgResult__3 "" LINEAR "%.15" "V" COEFFS_LINEAR 1 0 /end COMPU_METHOD
/begin COMPU_METHOD RTE.CM_T_LibTlHwIo_MultiTempQfd__0 "" LINEAR "%.15" "degC" COEFFS_LINEAR 1 0 /end COMPU_METHOD
/begin COMPU_METHOD RTE.CM_T_LibTlHwIo_MultiTempQfd__1 "" LINEAR "%.15" "degC" COEFFS_LINEAR 1 0 /end COMPU_METHOD
/begin COMPU_METHOD RTE.CM_T_LibTlHwIo_MultiTempQfd__2 "" LINEAR "%.15" "degC" COEFFS_LINEAR 1 0 /end COMPU_METHOD
/begin COMPU_METHOD RTE.CM_cmCsmReq_cm "" TAB_VERB "%.15" "-" COMPU_TAB_REF cmCsmReq /end COMPU_METHOD
/begin COMPU_METHOD RTE.CM_cmDataQly_cm "" TAB_VERB "%.15" "-" COMPU_TAB_REF cmDataQly /end COMPU_METHOD
/begin COMPU_METHOD RTE.CM_cmMCUMod_cm "" TAB_VERB "%.15" "-" COMPU_TAB_REF cmMCUMod /end COMPU_METHOD
/begin COMPU_METHOD RTE.CM_cmSelftestOpenPhaSt_cm "" TAB_VERB "%.15" "-" COMPU_TAB_REF cmSelftestOpenPhaSt /end COMPU_METHOD
/begin COMPU_METHOD RTE.CM_cmSelftestStPwrSply_cm "" TAB_VERB "%.15" "-" COMPU_TAB_REF cmSelftestStPwrSply /end COMPU_METHOD
/begin COMPU_METHOD RTE.CM_cmSelftestSt_cm "" TAB_VERB "%.15" "-" COMPU_TAB_REF cmSelftestSt /end COMPU_METHOD
/begin COMPU_METHOD RTE.CM_cmSftyFltSt_cm "" TAB_VERB "%.15" "-" COMPU_TAB_REF cmSftyFltSt /end COMPU_METHOD
/begin COMPU_METHOD RTE.CM_cmSftyMonSt_cm "" TAB_VERB "%.15" "-" COMPU_TAB_REF cmSftyMonSt /end COMPU_METHOD
/begin COMPU_METHOD RTE.CM_cmSftyOperStEncod_cm "" TAB_VERB "%.15" "-" COMPU_TAB_REF cmSftyOperStEncod /end COMPU_METHOD
/begin COMPU_METHOD RTE.CM_cmSftyOperSt_cm "" TAB_VERB "%.15" "-" COMPU_TAB_REF cmSftyOperSt /end COMPU_METHOD
/begin COMPU_METHOD RTE.CM_cmSftyTestReq_cm "" TAB_VERB "%.15" "-" COMPU_TAB_REF cmSftyTestReq /end COMPU_METHOD
/begin COMPU_METHOD RTE.CM_itTQfd__0 "" LINEAR "%.15" "degC" COEFFS_LINEAR 1 0 /end COMPU_METHOD
/begin COMPU_METHOD RTE.CM_itTqRng__0 "" LINEAR "%.15" "Nm" COEFFS_LINEAR 1 0 /end COMPU_METHOD
/begin COMPU_METHOD RTE.CM_itTqRng__1 "" LINEAR "%.15" "Nm" COEFFS_LINEAR 1 0 /end COMPU_METHOD
/begin COMPU_METHOD SBC_CAN_Mode "SBC_CAN_Mode" TAB_VERB "%2.1" "" COMPU_TAB_REF SBC_CAN_Mode_tab /end COMPU_METHOD
/begin COMPU_METHOD SBC_RegRead_Method "SBC_RegRead_Method" TAB_VERB "%2.1" "" COMPU_TAB_REF SBC_RegRead /end COMPU_METHOD
/begin COMPU_METHOD SBC_StateMachine_method "SBC_StateMachine_method" TAB_VERB "%2.1" "" COMPU_TAB_REF SBC_StateMachine_method /end COMPU_METHOD
/begin COMPU_METHOD SBC_State_Method "SBC_State_Method" TAB_VERB "%2.1" "" COMPU_TAB_REF SBC_State_Method /end COMPU_METHOD
/begin COMPU_METHOD SBC_WDMode_method "SBC_WDMode_method" TAB_VERB "%2.1" "" COMPU_TAB_REF SBC_WDMode_method /end COMPU_METHOD
/begin COMPU_METHOD SBC_mux_Method "SBC_mux_Method" TAB_VERB "%2.1" "" COMPU_TAB_REF SBC_mux /end COMPU_METHOD
/begin COMPU_METHOD SI.Asw_AngrVel_radps "" IDENTICAL "%12.6" "rad/s" /end COMPU_METHOD
/begin COMPU_METHOD SI.Asw_Curr_A "" IDENTICAL "%12.6" "A" /end COMPU_METHOD
/begin COMPU_METHOD SI.Asw_Ind_H "" IDENTICAL "%3.10" "H" /end COMPU_METHOD
/begin COMPU_METHOD SI.Asw_Perc "" IDENTICAL "%12.6" "%" /end COMPU_METHOD
/begin COMPU_METHOD SI.Asw_Pwr_W "" IDENTICAL "%12.6" "W" /end COMPU_METHOD
/begin COMPU_METHOD SI.Asw_Rstc_Ohm "" IDENTICAL "%12.6" "Ohm" /end COMPU_METHOD
/begin COMPU_METHOD SI.Asw_SigQly "" TAB_VERB "%s" "" COMPU_TAB_REF SI.CONV_TAB_Asw_SigQly /end COMPU_METHOD
/begin COMPU_METHOD SI.Asw_SpdRate_rpmps "" IDENTICAL "%12.6" "rpm/s" /end COMPU_METHOD
/begin COMPU_METHOD SI.Asw_Spd_rpm "" IDENTICAL "%12.6" "rpm" /end COMPU_METHOD
/begin COMPU_METHOD SI.Asw_Temp_degC "" IDENTICAL "%6.1" "degC" /end COMPU_METHOD
/begin COMPU_METHOD SI.Asw_Time_s "" IDENTICAL "%12.6" "s" /end COMPU_METHOD
/begin COMPU_METHOD SI.Asw_TrqRate_Nmps "" IDENTICAL "%12.6" "Nm/s" /end COMPU_METHOD
/begin COMPU_METHOD SI.Asw_Trq_Nm "" IDENTICAL "%12.6" "Nm" /end COMPU_METHOD
/begin COMPU_METHOD SI.Asw_Vel_kmh "" IDENTICAL "%12.6" "km/h" /end COMPU_METHOD
/begin COMPU_METHOD SI.Asw_Vof_lpmin "" IDENTICAL "%12.6" "lpm" /end COMPU_METHOD
/begin COMPU_METHOD SI.Asw_Volt_V "" IDENTICAL "%12.6" "V" /end COMPU_METHOD
/begin COMPU_METHOD SI.EQ_LSB_1 "" LINEAR "%5.0" "sec" COEFFS_LINEAR 1 0 /end COMPU_METHOD
/begin COMPU_METHOD SI.EQ_LSB_10 "" LINEAR "%6.0" "ms" COEFFS_LINEAR 10 0 /end COMPU_METHOD
/begin COMPU_METHOD SI.EQ_LSB_1em5 "" LINEAR "%11.5" "Nms" COEFFS_LINEAR 1E-05 0 /end COMPU_METHOD
/begin COMPU_METHOD SI.EQ_LSB_5 "" LINEAR "%6.0" "ms" COEFFS_LINEAR 5 0 /end COMPU_METHOD
/begin COMPU_METHOD SI.TLE_ModeNSyncTarget "TargetLink Scaling Type MainD10_stCompState" TAB_VERB "%3.0" "" COMPU_TAB_REF SI.CONV_TAB_TLE_ModeNSyncTarget /end COMPU_METHOD
/begin COMPU_METHOD SI.TLE_cmdBckupFcn1 "Enumeration for requested controller state" TAB_VERB "%3.0" "" COMPU_TAB_REF SI.CONV_TAB_TLE_cmdBckupFcn1 /end COMPU_METHOD
/begin COMPU_METHOD SI.TLE_cmdEmReq "Enumeration for requested controller state" TAB_VERB "%3.0" "" COMPU_TAB_REF SI.CONV_TAB_TLE_cmdEmReq /end COMPU_METHOD
/begin COMPU_METHOD SI.TLE_stGear "Enumeration for gear state" TAB_VERB "%3.0" "" COMPU_TAB_REF SI.CONV_TAB_TLE_stGear /end COMPU_METHOD
/begin COMPU_METHOD SI.TLE_statePwrNet "Enumeration for requested controller state" TAB_VERB "%3.0" "" COMPU_TAB_REF SI.CONV_TAB_TLE_statePwrNet /end COMPU_METHOD
/begin COMPU_METHOD SI.TLS_AVL_SIG_AGE "" LINEAR "%6.0" "ms" COEFFS_LINEAR 5 0 /end COMPU_METHOD
/begin COMPU_METHOD SI.TLS_BCS_Brk_Ctrl_Md_Rq_ST3 "" LINEAR "%3.0" "" COEFFS_LINEAR 1 0 /end COMPU_METHOD
/begin COMPU_METHOD SI.TLS_BCS_WhlRPM_Ctrl_Md_Rq_ST3 "" LINEAR "%3.0" "" COEFFS_LINEAR 1 0 /end COMPU_METHOD
/begin COMPU_METHOD SI.TLS_ISw_Stat_ST3 "" LINEAR "%3.0" "" COEFFS_LINEAR 1 0 /end COMPU_METHOD
/begin COMPU_METHOD SI.TLS_PN14_DDP_Sw_Stat_ST3 "" LINEAR "%3.0" "" COEFFS_LINEAR 1 0 /end COMPU_METHOD
/begin COMPU_METHOD SI.TLS_PN14_ProdMd_Stat_ST3 "" LINEAR "%3.0" "" COEFFS_LINEAR 1 0 /end COMPU_METHOD
/begin COMPU_METHOD SI.TLS_PN14_SupBat_Volt_ST3 "" LINEAR "%8.3" "V" COEFFS_LINEAR 0.025 0 /end COMPU_METHOD
/begin COMPU_METHOD SI.TLS_PT4_PTCoor_AccelPdlPosn_OBD_ST3 "" LINEAR "%4.0" "perc" COEFFS_LINEAR 20 0 /end COMPU_METHOD
/begin COMPU_METHOD SI.TLS_PT4_PTCoor_AccelPdlPosn_Red_OBD_ST3 "" LINEAR "%4.0" "perc" COEFFS_LINEAR 20 0 /end COMPU_METHOD
/begin COMPU_METHOD SI.TLS_PT4_PTCoor_DrvPosn_Target_ST3 "" LINEAR "%3.0" "" COEFFS_LINEAR 1 0 /end COMPU_METHOD
/begin COMPU_METHOD SI.TLS_PT4_PTCoor_GbOpn_Rq_INV1_ST3 "" LINEAR "%3.0" "" COEFFS_LINEAR 1 0 /end COMPU_METHOD
/begin COMPU_METHOD SI.TLS_PT4_PTCoor_HDC_RPM_Rq_INV1_ST3 "" LINEAR "%13.2" "rpm" COEFFS_LINEAR 0.25 -131071.75 /end COMPU_METHOD
/begin COMPU_METHOD SI.TLS_PT4_PTCoor_RPM_Lim_Rq_INV1_ST3 "" LINEAR "%5.0" "rpm" COEFFS_LINEAR 1 0 /end COMPU_METHOD
/begin COMPU_METHOD SI.TLS_PT4_PTCoor_WhlRPM_Ctrl_Md_Rq_ST3 "" LINEAR "%3.0" "" COEFFS_LINEAR 1 0 /end COMPU_METHOD
/begin COMPU_METHOD SI.TLS_PT4_TMPT_AirTemp_Outsd_ST3 "" LINEAR "%5.1" "degC" COEFFS_LINEAR 0.5 -40 /end COMPU_METHOD
/begin COMPU_METHOD SI.TLS_PT4_TMPT_LowTemp_Circ1_AfterRun_Dur_ST3 "" LINEAR "%4.0" "s" COEFFS_LINEAR 20 0 /end COMPU_METHOD
/begin COMPU_METHOD SI.TLS_PT4_TMPT_LowTemp_FlowVol_Circ1_INV1_ST3 "" LINEAR "%6.1" "l_per_min" COEFFS_LINEAR 0.1 0 /end COMPU_METHOD
/begin COMPU_METHOD SI.TLS_PT4_TMPT_Low_Temp_SensTemp_ST3 "" LINEAR "%3.0" "degC" COEFFS_LINEAR 1 -40 /end COMPU_METHOD
/begin COMPU_METHOD SI.TLS_PT4_TMPT_TM_RefRun_Actv_ST3 "" LINEAR "%3.0" "" COEFFS_LINEAR 1 0 /end COMPU_METHOD
/begin COMPU_METHOD SI.TLS_PT4_TrsmCtrl_OutRPM_ST3 "" LINEAR "%6.0" "rpm" COEFFS_LINEAR 4 0 /end COMPU_METHOD
/begin COMPU_METHOD SI.TLS_PT4_TrsmCtrl_Ratio_Chg_Cont_Actv_ST3 "" LINEAR "%3.0" "" COEFFS_LINEAR 1 0 /end COMPU_METHOD
/begin COMPU_METHOD SI.TLS_PT4_VEPM_CySw_Rq_ST3 "" LINEAR "%3.0" "" COEFFS_LINEAR 1 0 /end COMPU_METHOD
/begin COMPU_METHOD SI.TLS_PT4_VEPM_INV1_ChrgVolt_Max_ST3 "" LINEAR "%8.3" "V" COEFFS_LINEAR 0.025 0 /end COMPU_METHOD
/begin COMPU_METHOD SI.TLS_PT4_VEPM_INV1_Curr_Max_ST3 "" LINEAR "%6.1" "A" COEFFS_LINEAR 0.1 -1638.2 /end COMPU_METHOD
/begin COMPU_METHOD SI.TLS_PT4_VEPM_INV1_Curr_Min_ST3 "" LINEAR "%6.1" "A" COEFFS_LINEAR 0.1 -1638.2 /end COMPU_METHOD
/begin COMPU_METHOD SI.TLS_PT4_VEPM_INV1_DschrgVolt_Min_ST3 "" LINEAR "%8.3" "V" COEFFS_LINEAR 0.025 0 /end COMPU_METHOD
/begin COMPU_METHOD SI.TLS_PT4_VEPM_INV1_MaxPwr_Chrg_ST3 "" LINEAR "%7.0" "W" COEFFS_LINEAR 20 0 /end COMPU_METHOD
/begin COMPU_METHOD SI.TLS_PT4_VEPM_INV1_MaxPwr_Dschrg_ST3 "" LINEAR "%7.0" "W" COEFFS_LINEAR 20 0 /end COMPU_METHOD
/begin COMPU_METHOD SI.TLS_PT4_VEPM_PNHV_Bat_ResistChrg_ST3 "" LINEAR "%7.4" "Ohm" COEFFS_LINEAR 0.0005 0 /end COMPU_METHOD
/begin COMPU_METHOD SI.TLS_PT4_VEPM_PNHV_Bat_ResistDschrg_ST3 "" LINEAR "%7.4" "Ohm" COEFFS_LINEAR 0.0005 0 /end COMPU_METHOD
/begin COMPU_METHOD SI.TLS_PT4_VEPM_Pmax_PredDCLinkVolt_ST3 "" LINEAR "%8.3" "V" COEFFS_LINEAR 0.025 0 /end COMPU_METHOD
/begin COMPU_METHOD SI.TLS_PT4_VEPM_TrctBat_BatCutSw_Stat_ST3 "" LINEAR "%3.0" "" COEFFS_LINEAR 1 0 /end COMPU_METHOD
/begin COMPU_METHOD SI.TLS_PT4_VEPM_TrctBat_Curr_ST3 "" LINEAR "%6.1" "A" COEFFS_LINEAR 0.1 -3276.6 /end COMPU_METHOD
/begin COMPU_METHOD SI.TLS_PT4_VEPM_TrctBat_Volt_ST3 "" LINEAR "%8.3" "V" COEFFS_LINEAR 0.025 0 /end COMPU_METHOD
/begin COMPU_METHOD SI.TLS_PT_ShutOffTm_ST3 "" LINEAR "%5.0" "min" COEFFS_LINEAR 1 0 /end COMPU_METHOD
/begin COMPU_METHOD SI.TLS_VehSpd_Disp_ST3 "" LINEAR "%6.1" "km/h" COEFFS_LINEAR 0.1 0 /end COMPU_METHOD
/begin COMPU_METHOD SIc.Asw_Ang_deg "" IDENTICAL "%12.6" "degree" /end COMPU_METHOD
/begin COMPU_METHOD SIc.Asw_SigQly "" TAB_VERB "%s" "" COMPU_TAB_REF SIc.CONV_TAB_Asw_SigQly /end COMPU_METHOD
/begin COMPU_METHOD SIc.Asw_Spd_rpm "" IDENTICAL "%12.6" "rpm" /end COMPU_METHOD
/begin COMPU_METHOD SIc.Asw_Temp_degC "" IDENTICAL "%6.1" "degC" /end COMPU_METHOD
/begin COMPU_METHOD SIc.Asw_TrqRate_Nmps "" IDENTICAL "%12.6" "Nm/s" /end COMPU_METHOD
/begin COMPU_METHOD SIc.Asw_Trq_Nm "" IDENTICAL "%12.6" "Nm" /end COMPU_METHOD
/begin COMPU_METHOD SIc.Asw_Volt_V "" IDENTICAL "%12.6" "V" /end COMPU_METHOD
/begin COMPU_METHOD SIc.EQ_LSB_0_001953125 "" LINEAR "%13.9" "" COEFFS_LINEAR 0.001953125 0 /end COMPU_METHOD
/begin COMPU_METHOD SIc.EQ_LSB_1 "" LINEAR "%10.0" "" COEFFS_LINEAR 1 0 /end COMPU_METHOD
/begin COMPU_METHOD SIc.EQ_LSB_10 "" LINEAR "%6.0" "ms" COEFFS_LINEAR 10 0 /end COMPU_METHOD
/begin COMPU_METHOD SIc.EQ_LSB_3_0517578125em5 "" LINEAR "%17.15" "" COEFFS_LINEAR 3.0517578125E-05 0 /end COMPU_METHOD
/begin COMPU_METHOD SIc.TLE_cmdBckupFcn1 "Enumeration for requested controller state" TAB_VERB "%3.0" "" COMPU_TAB_REF SIc.CONV_TAB_TLE_cmdBckupFcn1 /end COMPU_METHOD
/begin COMPU_METHOD SIc.TLE_cmdBckupFcn2 "Enumeration for Backupfunction Gear Shift / Park Lock" TAB_VERB "%3.0" "" COMPU_TAB_REF SIc.CONV_TAB_TLE_cmdBckupFcn2 /end COMPU_METHOD
/begin COMPU_METHOD SIc.TLE_cmdEmReq "Enumeration for requested controller state" TAB_VERB "%3.0" "" COMPU_TAB_REF SIc.CONV_TAB_TLE_cmdEmReq /end COMPU_METHOD
/begin COMPU_METHOD SIc.TLE_reqBoost "Enumeration for boost mode requests from VCU" TAB_VERB "%3.0" "" COMPU_TAB_REF SIc.CONV_TAB_TLE_reqBoost /end COMPU_METHOD
/begin COMPU_METHOD SIc.TLE_stGear "Enumeration for gear state" TAB_VERB "%3.0" "" COMPU_TAB_REF SIc.CONV_TAB_TLE_stGear /end COMPU_METHOD
/begin COMPU_METHOD SIc.TLE_statePwrNet "Enumeration for requested controller state" TAB_VERB "%3.0" "" COMPU_TAB_REF SIc.CONV_TAB_TLE_statePwrNet /end COMPU_METHOD
/begin COMPU_METHOD SIc.TLS_AVL_SIG_AGE "" LINEAR "%6.0" "ms" COEFFS_LINEAR 5 0 /end COMPU_METHOD
/begin COMPU_METHOD SIc.TLS_AVL_SIG_AGE_TB "" LINEAR "%6.0" "ms" COEFFS_LINEAR 5 0 /end COMPU_METHOD
/begin COMPU_METHOD SIc.TLS_BCS_PT_PwrFree_Rq_ST3 "" LINEAR "%3.0" "" COEFFS_LINEAR 1 0 /end COMPU_METHOD
/begin COMPU_METHOD SIc.TLS_BCS_WhlRPM_Lim_Max_Axle_F_ST3 "" LINEAR "%7.1" "rpm" COEFFS_LINEAR 0.5 0 /end COMPU_METHOD
/begin COMPU_METHOD SIc.TLS_BCS_WhlRPM_Lim_Max_Axle_R_ST3 "" LINEAR "%7.1" "rpm" COEFFS_LINEAR 0.5 0 /end COMPU_METHOD
/begin COMPU_METHOD SIc.TLS_BCS_WhlRPM_Lim_Max_Qual_ST3 "" LINEAR "%3.0" "" COEFFS_LINEAR 1 0 /end COMPU_METHOD
/begin COMPU_METHOD SIc.TLS_BCS_WhlRPM_Lim_Min_Axle_F_ST3 "" LINEAR "%7.1" "rpm" COEFFS_LINEAR 0.5 0 /end COMPU_METHOD
/begin COMPU_METHOD SIc.TLS_BCS_WhlRPM_Lim_Min_Axle_R_ST3 "" LINEAR "%7.1" "rpm" COEFFS_LINEAR 0.5 0 /end COMPU_METHOD
/begin COMPU_METHOD SIc.TLS_BCS_WhlRPM_Lim_Min_Qual_ST3 "" LINEAR "%3.0" "" COEFFS_LINEAR 1 0 /end COMPU_METHOD
/begin COMPU_METHOD SIc.TLS_EdiClt_EmInletFlow "" LINEAR "%5.2" "l/min" COEFFS_LINEAR 0.05 0 /end COMPU_METHOD
/begin COMPU_METHOD SIc.TLS_EdiClt_EmInletTemp "" LINEAR "%7.2" "ï¿½C" COEFFS_LINEAR 0.25 80 /end COMPU_METHOD
/begin COMPU_METHOD SIc.TLS_EdiClt_InvInletFlow "" LINEAR "%5.2" "l/min" COEFFS_LINEAR 0.05 0 /end COMPU_METHOD
/begin COMPU_METHOD SIc.TLS_EdiClt_InvInletTemp "" LINEAR "%7.2" "ï¿½C" COEFFS_LINEAR 0.25 80 /end COMPU_METHOD
/begin COMPU_METHOD SIc.TLS_EdiDcpl_reqDcpl "" LINEAR "%3.0" "-" COEFFS_LINEAR 1 0 /end COMPU_METHOD
/begin COMPU_METHOD SIc.TLS_EdiEdrv_ActvDchrgReq "" LINEAR "%3.0" "-" COEFFS_LINEAR 1 0 /end COMPU_METHOD
/begin COMPU_METHOD SIc.TLS_EdiEdrv_AngReq "" LINEAR "%8.3" "deg" COEFFS_LINEAR 0.125 0 /end COMPU_METHOD
/begin COMPU_METHOD SIc.TLS_EdiEdrv_CmtModeReq "" LINEAR "%3.0" "" COEFFS_LINEAR 1 0 /end COMPU_METHOD
/begin COMPU_METHOD SIc.TLS_EdiEdrv_CmtTestModeEn "" LINEAR "%3.0" "" COEFFS_LINEAR 1 0 /end COMPU_METHOD
/begin COMPU_METHOD SIc.TLS_EdiEdrv_CtlModeReq "" LINEAR "%3.0" "" COEFFS_LINEAR 1 0 /end COMPU_METHOD
/begin COMPU_METHOD SIc.TLS_EdiEdrv_CtlTestModeEn "" LINEAR "%3.0" "" COEFFS_LINEAR 1 0 /end COMPU_METHOD
/begin COMPU_METHOD SIc.TLS_EdiEdrv_CurrReq "" LINEAR "%9.3" "A" COEFFS_LINEAR 0.625 0 /end COMPU_METHOD
/begin COMPU_METHOD SIc.TLS_EdiEdrv_SpdReqMotShaft "" LINEAR "%5.0" "RPM" COEFFS_LINEAR 2 0 /end COMPU_METHOD
/begin COMPU_METHOD SIc.TLS_EdiEdrv_TrqReqLimMax "" LINEAR "%10.5" "Nm" COEFFS_LINEAR 0.03125 0 /end COMPU_METHOD
/begin COMPU_METHOD SIc.TLS_EdiEdrv_TrqReqLimMin "" LINEAR "%10.5" "Nm" COEFFS_LINEAR 0.03125 0 /end COMPU_METHOD
/begin COMPU_METHOD SIc.TLS_EdiEdrv_TrqReqLimSpdCtrlMax "" LINEAR "%10.5" "Nm" COEFFS_LINEAR 0.03125 0 /end COMPU_METHOD
/begin COMPU_METHOD SIc.TLS_EdiEdrv_TrqReqLimSpdCtrlMin "" LINEAR "%10.5" "Nm" COEFFS_LINEAR 0.03125 0 /end COMPU_METHOD
/begin COMPU_METHOD SIc.TLS_EdiEdrv_TrqReqShaft "" LINEAR "%10.5" "Nm" COEFFS_LINEAR 0.03125 0 /end COMPU_METHOD
/begin COMPU_METHOD SIc.TLS_EdiEdrv_VoltReq "" LINEAR "%10.5" "V" COEFFS_LINEAR 0.03125 0 /end COMPU_METHOD
/begin COMPU_METHOD SIc.TLS_EdiSys_BattCurrMaxDyn "" LINEAR "%5.0" "A" COEFFS_LINEAR 1 0 /end COMPU_METHOD
/begin COMPU_METHOD SIc.TLS_EdiSys_BattCurrMinDyn "" LINEAR "%5.0" "A" COEFFS_LINEAR 1 -1023 /end COMPU_METHOD
/begin COMPU_METHOD SIc.TLS_EdiSys_BattVoltMax "" LINEAR "%10.5" "V" COEFFS_LINEAR 0.03125 0 /end COMPU_METHOD
/begin COMPU_METHOD SIc.TLS_EdiSys_BattVoltMin "" LINEAR "%10.5" "V" COEFFS_LINEAR 0.03125 0 /end COMPU_METHOD
/begin COMPU_METHOD SIc.TLS_EdiSys_SpdSlopMax "" LINEAR "%4.0" "rpm/s" COEFFS_LINEAR 10 0 /end COMPU_METHOD
/begin COMPU_METHOD SIc.TLS_Odo_ST3 "" LINEAR "%11.1" "km" COEFFS_LINEAR 0.1 0 /end COMPU_METHOD
/begin COMPU_METHOD SIc.TLS_PT4_INV1Ctrl_TrqAvl_Max_ST3 "" LINEAR "%9.4" "Nm" COEFFS_LINEAR 0.0625 -2047.9375 /end COMPU_METHOD
/begin COMPU_METHOD SIc.TLS_PT4_INV1Ctrl_TrqAvl_Min_ST3 "" LINEAR "%9.4" "Nm" COEFFS_LINEAR 0.0625 -2047.9375 /end COMPU_METHOD
/begin COMPU_METHOD SIc.TLS_PT4_PTCoor_Dschrg_Rq_ST3 "" LINEAR "%3.0" "" COEFFS_LINEAR 1 0 /end COMPU_METHOD
/begin COMPU_METHOD SIc.TLS_PT4_PTCoor_GbDscnct_SpdType_Rq_ST3 "" LINEAR "%3.0" "" COEFFS_LINEAR 1 0 /end COMPU_METHOD
/begin COMPU_METHOD SIc.TLS_PT4_PTCoor_GbOpn_Rq_INV1_ST3 "" LINEAR "%3.0" "" COEFFS_LINEAR 1 0 /end COMPU_METHOD
/begin COMPU_METHOD SIc.TLS_PT4_PTCoor_HDC_IdealSpdTrj_INV1_ST3 "" LINEAR "%13.2" "rpm" COEFFS_LINEAR 0.25 -131071.75 /end COMPU_METHOD
/begin COMPU_METHOD SIc.TLS_PT4_PTCoor_HDC_IntrvntnDyn_Rq_INV1_ST3 "" LINEAR "%3.0" "" COEFFS_LINEAR 1 0 /end COMPU_METHOD
/begin COMPU_METHOD SIc.TLS_PT4_PTCoor_HDC_Intrvntn_DampFctr_INV1_ST3 "" LINEAR "%4.2" "-" COEFFS_LINEAR 0.02 0 /end COMPU_METHOD
/begin COMPU_METHOD SIc.TLS_PT4_PTCoor_HDC_Md_Rq_INV1_ST3 "" LINEAR "%3.0" "" COEFFS_LINEAR 1 0 /end COMPU_METHOD
/begin COMPU_METHOD SIc.TLS_PT4_PTCoor_HDC_RPM_Rq_INV1_ST3 "" LINEAR "%13.2" "rpm" COEFFS_LINEAR 0.25 -131071.75 /end COMPU_METHOD
/begin COMPU_METHOD SIc.TLS_PT4_PTCoor_HDC_TrqMax_Rq_INV1_ST3 "" LINEAR "%9.4" "Nm" COEFFS_LINEAR 0.0625 -2047.9375 /end COMPU_METHOD
/begin COMPU_METHOD SIc.TLS_PT4_PTCoor_HDC_TrqMin_Rq_INV1_ST3 "" LINEAR "%9.4" "Nm" COEFFS_LINEAR 0.0625 -2047.9375 /end COMPU_METHOD
/begin COMPU_METHOD SIc.TLS_PT4_VEPM_INV1_ChrgVolt_Rq_ST3 "" LINEAR "%8.3" "V" COEFFS_LINEAR 0.025 0 /end COMPU_METHOD
/begin COMPU_METHOD SIc.TLS_WhlDir_FL_Stat_ST3 "" LINEAR "%3.0" "" COEFFS_LINEAR 1 0 /end COMPU_METHOD
/begin COMPU_METHOD SIc.TLS_WhlDir_FR_Stat_ST3 "" LINEAR "%3.0" "" COEFFS_LINEAR 1 0 /end COMPU_METHOD
/begin COMPU_METHOD SIc.TLS_WhlDir_RL_Stat_ST3 "" LINEAR "%3.0" "" COEFFS_LINEAR 1 0 /end COMPU_METHOD
/begin COMPU_METHOD SIc.TLS_WhlDir_RR_Stat_ST3 "" LINEAR "%3.0" "" COEFFS_LINEAR 1 0 /end COMPU_METHOD
/begin COMPU_METHOD SIc.TLS_WhlRPM_FL_Qual_ST3 "" LINEAR "%3.0" "" COEFFS_LINEAR 1 0 /end COMPU_METHOD
/begin COMPU_METHOD SIc.TLS_WhlRPM_FL_ST3 "" LINEAR "%7.1" "rpm" COEFFS_LINEAR 0.5 0 /end COMPU_METHOD
/begin COMPU_METHOD SIc.TLS_WhlRPM_FR_Qual_ST3 "" LINEAR "%3.0" "" COEFFS_LINEAR 1 0 /end COMPU_METHOD
/begin COMPU_METHOD SIc.TLS_WhlRPM_FR_ST3 "" LINEAR "%7.1" "rpm" COEFFS_LINEAR 0.5 0 /end COMPU_METHOD
/begin COMPU_METHOD SIc.TLS_WhlRPM_RL_Qual_ST3 "" LINEAR "%3.0" "" COEFFS_LINEAR 1 0 /end COMPU_METHOD
/begin COMPU_METHOD SIc.TLS_WhlRPM_RL_ST3 "" LINEAR "%7.1" "rpm" COEFFS_LINEAR 0.5 0 /end COMPU_METHOD
/begin COMPU_METHOD SIc.TLS_WhlRPM_RR_Qual_ST3 "" LINEAR "%3.0" "" COEFFS_LINEAR 1 0 /end COMPU_METHOD
/begin COMPU_METHOD SIc.TLS_WhlRPM_RR_ST3 "" LINEAR "%7.1" "rpm" COEFFS_LINEAR 0.5 0 /end COMPU_METHOD
/begin COMPU_METHOD SN.Asw_Chrg_C "" IDENTICAL "%12.6" "C" /end COMPU_METHOD
/begin COMPU_METHOD SN.Asw_Curr_A "" IDENTICAL "%12.6" "A" /end COMPU_METHOD
/begin COMPU_METHOD SN.Asw_Frq_Hz "" IDENTICAL "%12.6" "Hz" /end COMPU_METHOD
/begin COMPU_METHOD SN.Asw_Len_mm "" IDENTICAL "%12.6" "mm" /end COMPU_METHOD
/begin COMPU_METHOD SN.Asw_Perc "" IDENTICAL "%12.6" "%" /end COMPU_METHOD
/begin COMPU_METHOD SN.Asw_QF "" TAB_VERB "%3.0" "" COMPU_TAB_REF SN.CONV_TAB_Asw_QF /end COMPU_METHOD
/begin COMPU_METHOD SN.Asw_Ratio "" IDENTICAL "%12.6" "ratio" /end COMPU_METHOD
/begin COMPU_METHOD SN.Asw_Rstc_Ohm "" IDENTICAL "%12.6" "Ohm" /end COMPU_METHOD
/begin COMPU_METHOD SN.Asw_SigQly "" TAB_VERB "%s" "" COMPU_TAB_REF SN.CONV_TAB_Asw_SigQly /end COMPU_METHOD
/begin COMPU_METHOD SN.Asw_Spd_rpm "" IDENTICAL "%12.6" "rpm" /end COMPU_METHOD
/begin COMPU_METHOD SN.Asw_Temp_degC "" IDENTICAL "%6.1" "degC" /end COMPU_METHOD
/begin COMPU_METHOD SN.Asw_Time10Millisec "" IDENTICAL "%5.0" "10 ms" /end COMPU_METHOD
/begin COMPU_METHOD SN.Asw_Time_ms "" IDENTICAL "%12.6" "ms" /end COMPU_METHOD
/begin COMPU_METHOD SN.Asw_Time_s "" IDENTICAL "%12.6" "s" /end COMPU_METHOD
/begin COMPU_METHOD SN.Asw_Vel_kmh "" IDENTICAL "%12.6" "km/h" /end COMPU_METHOD
/begin COMPU_METHOD SN.Asw_VoltTB_V "TargetLink Scaling Type voltage for testbench" LINEAR "%13.10" "V" COEFFS_LINEAR 0.0009765625 -32 /end COMPU_METHOD
/begin COMPU_METHOD SN.Asw_Volt_V "" IDENTICAL "%12.6" "V" /end COMPU_METHOD
/begin COMPU_METHOD SN.Asw_prcShuntLoadFactor "TargetLink Scaling Type ShuntLoadFactor in %" LINEAR "%13.8" "perc" COEFFS_LINEAR 0.09765625 0 /end COMPU_METHOD
/begin COMPU_METHOD SN.EQ_LSB_0_000244140625 "" LINEAR "%15.12" "" COEFFS_LINEAR 0.000244140625 0 /end COMPU_METHOD
/begin COMPU_METHOD SN.EQ_LSB_0_001953125 "" LINEAR "%13.9" "" COEFFS_LINEAR 0.001953125 0 /end COMPU_METHOD
/begin COMPU_METHOD SN.EQ_LSB_0_00390625 "" LINEAR "%12.8" "Ohm" COEFFS_LINEAR 0.00390625 0 /end COMPU_METHOD
/begin COMPU_METHOD SN.EQ_LSB_2_384185791015625em7 "" LINEAR "%19.14" "C" COEFFS_LINEAR 2.38418579102E-07 0 /end COMPU_METHOD
/begin COMPU_METHOD SN.EQ_LSB_3_0517578125em5 "" LINEAR "%17.15" "" COEFFS_LINEAR 3.0517578125E-05 0 /end COMPU_METHOD
/begin COMPU_METHOD SN.TLE_Global_reqCompstate "TargetLink Scaling Type MainY10_stCompState" TAB_VERB "%3.0" "" COMPU_TAB_REF SN.CONV_TAB_TLE_Global_reqCompstate /end COMPU_METHOD
/begin COMPU_METHOD SN.TLE_Global_stCompstate "TargetLink Scaling Type InputY10_reqCompstate" TAB_VERB "%3.0" "" COMPU_TAB_REF SN.CONV_TAB_TLE_Global_stCompstate /end COMPU_METHOD
/begin COMPU_METHOD SN.TLE_ShiftOp_curState "TargetLink Scaling Type curstate of CplOp" TAB_VERB "%3.0" "" COMPU_TAB_REF SN.CONV_TAB_TLE_ShiftOp_curState /end COMPU_METHOD
/begin COMPU_METHOD SN.TLE_SvcJobN10_curState "TargetLink Scaling Type SvcJobP10_curState" TAB_VERB "%3.0" "" COMPU_TAB_REF SN.CONV_TAB_TLE_SvcJobN10_curState /end COMPU_METHOD
/begin COMPU_METHOD SN.TLE_cmdBckupFcn2 "Enumeration for Backupfunction Gear Shift / Park Lock" TAB_VERB "%3.0" "" COMPU_TAB_REF SN.CONV_TAB_TLE_cmdBckupFcn2 /end COMPU_METHOD
/begin COMPU_METHOD SN.TLE_cmdReqSvcJob "TargetLink Scaling Type SvcJobP10_stSystemState" TAB_VERB "%3.0" "" COMPU_TAB_REF SN.CONV_TAB_TLE_cmdReqSvcJob /end COMPU_METHOD
/begin COMPU_METHOD SN.TLE_modeSol "TargetLink Scaling Type mode solenoid" TAB_VERB "%3.0" "" COMPU_TAB_REF SN.CONV_TAB_TLE_modeSol /end COMPU_METHOD
/begin COMPU_METHOD SN.TLE_stGear "Enumeration for gear state" TAB_VERB "%3.0" "" COMPU_TAB_REF SN.CONV_TAB_TLE_stGear /end COMPU_METHOD
/begin COMPU_METHOD SN.TLS_AVL_SIG_AGE_TB "" LINEAR "%6.0" "ms" COEFFS_LINEAR 5 0 /end COMPU_METHOD
/begin COMPU_METHOD SO.Asw_Ang_deg "" IDENTICAL "%12.6" "degree" /end COMPU_METHOD
/begin COMPU_METHOD SO.Asw_Curr_A "" IDENTICAL "%12.6" "A" /end COMPU_METHOD
/begin COMPU_METHOD SO.Asw_Curr_Arms "" IDENTICAL "%12.6" "Arms" /end COMPU_METHOD
/begin COMPU_METHOD SO.Asw_Perc "" IDENTICAL "%12.6" "%" /end COMPU_METHOD
/begin COMPU_METHOD SO.Asw_Pwr_W "" IDENTICAL "%12.6" "W" /end COMPU_METHOD
/begin COMPU_METHOD SO.Asw_SigQly "" TAB_VERB "%s" "" COMPU_TAB_REF SO.CONV_TAB_Asw_SigQly /end COMPU_METHOD
/begin COMPU_METHOD SO.Asw_Spd_rpm "" IDENTICAL "%12.6" "rpm" /end COMPU_METHOD
/begin COMPU_METHOD SO.Asw_Temp_degC "" IDENTICAL "%6.1" "degC" /end COMPU_METHOD
/begin COMPU_METHOD SO.Asw_Time_s "" IDENTICAL "%12.6" "s" /end COMPU_METHOD
/begin COMPU_METHOD SO.Asw_Trq_Nm "" IDENTICAL "%12.6" "Nm" /end COMPU_METHOD
/begin COMPU_METHOD SO.Asw_Vel_kmh "" IDENTICAL "%12.6" "km/h" /end COMPU_METHOD
/begin COMPU_METHOD SO.Asw_Vof_lpmin "" IDENTICAL "%12.6" "lpm" /end COMPU_METHOD
/begin COMPU_METHOD SO.Asw_Volt_V "" IDENTICAL "%12.6" "V" /end COMPU_METHOD
/begin COMPU_METHOD SO.Edp_TrqLimRsn "" TAB_VERB "%d" "" COMPU_TAB_REF SO.CONV_TAB_Edp_TrqLimRsn /end COMPU_METHOD
/begin COMPU_METHOD SO.LibTlSrvc_DcmIfRoutnState "" TAB_VERB "%3.0" "" COMPU_TAB_REF SO.CONV_TAB_LibTlSrvc_DcmIfRoutnState /end COMPU_METHOD
/begin COMPU_METHOD SO.SI_cmdEmReq "" TAB_VERB "%3.0" "" COMPU_TAB_REF SO.CONV_TAB_SI_cmdEmReq /end COMPU_METHOD
/begin COMPU_METHOD SO.TLE_cmdBckupFcn1 "Enumeration for requested controller state" TAB_VERB "%3.0" "" COMPU_TAB_REF SO.CONV_TAB_TLE_cmdBckupFcn1 /end COMPU_METHOD
/begin COMPU_METHOD SO.TLE_cmdBckupFcn2 "Enumeration for Backupfunction Gear Shift / Park Lock" TAB_VERB "%3.0" "" COMPU_TAB_REF SO.CONV_TAB_TLE_cmdBckupFcn2 /end COMPU_METHOD
/begin COMPU_METHOD SO.TLE_cmdEm "TargetLink Scaling Type for command EM" TAB_VERB "%3.0" "" COMPU_TAB_REF SO.CONV_TAB_TLE_cmdEm /end COMPU_METHOD
/begin COMPU_METHOD SO.TLE_reqCtrlMode "Enumeration for requested controller state" TAB_VERB "%3.0" "" COMPU_TAB_REF SO.CONV_TAB_TLE_reqCtrlMode /end COMPU_METHOD
/begin COMPU_METHOD SO.TLE_stGear "Enumeration for gear state" TAB_VERB "%3.0" "" COMPU_TAB_REF SO.CONV_TAB_TLE_stGear /end COMPU_METHOD
/begin COMPU_METHOD SO.TLE_stGearShift "Enumeration for gear state" TAB_VERB "%3.0" "" COMPU_TAB_REF SO.CONV_TAB_TLE_stGearShift /end COMPU_METHOD
/begin COMPU_METHOD SO.TLE_stQuadrant "Enumeration for requested controller state" TAB_VERB "%3.0" "" COMPU_TAB_REF SO.CONV_TAB_TLE_stQuadrant /end COMPU_METHOD
/begin COMPU_METHOD SO.TLS_Develop_PT4_INV12CPC_01_ST3 "" LINEAR "%5.0" "" COEFFS_LINEAR 1 0 /end COMPU_METHOD
/begin COMPU_METHOD SO.TLS_Develop_PT4_INV12CPC_01_ST3_a "" LINEAR "%3.0" "" COEFFS_LINEAR 1 0 /end COMPU_METHOD
/begin COMPU_METHOD SO.TLS_Develop_PT4_INV12CPC_08_ST3 "" LINEAR "%5.0" "" COEFFS_LINEAR 1 0 /end COMPU_METHOD
/begin COMPU_METHOD SO.TLS_Develop_PT4_INV12CPC_08_ST3_b "" LINEAR "%3.0" "" COEFFS_LINEAR 1 0 /end COMPU_METHOD
/begin COMPU_METHOD SO.TLS_Meas_INV1_01_ST3 "" LINEAR "%5.0" "" COEFFS_LINEAR 1 0 /end COMPU_METHOD
/begin COMPU_METHOD SO.TLS_Meas_INV1_01_ST3_c "" LINEAR "%3.0" "" COEFFS_LINEAR 1 0 /end COMPU_METHOD
/begin COMPU_METHOD SO.TLS_Meas_INV1_64_ST3 "" LINEAR "%5.0" "" COEFFS_LINEAR 1 0 /end COMPU_METHOD
/begin COMPU_METHOD SO.TLS_Meas_INV1_64_ST3_d "" LINEAR "%3.0" "" COEFFS_LINEAR 1 0 /end COMPU_METHOD
/begin COMPU_METHOD SO.TLS_PT4_INV1Ctrl_3S_Actv_ST3 "" LINEAR "%5.0" "" COEFFS_LINEAR 1 0 /end COMPU_METHOD
/begin COMPU_METHOD SO.TLS_PT4_INV1Ctrl_3S_Actv_ST3_e "" LINEAR "%3.0" "" COEFFS_LINEAR 1 0 /end COMPU_METHOD
/begin COMPU_METHOD SO.TLS_PT4_INV1Ctrl_3S_Rdy_ST3 "" LINEAR "%5.0" "" COEFFS_LINEAR 1 0 /end COMPU_METHOD
/begin COMPU_METHOD SO.TLS_PT4_INV1Ctrl_3S_Rdy_ST3_f "" LINEAR "%3.0" "" COEFFS_LINEAR 1 0 /end COMPU_METHOD
/begin COMPU_METHOD SO.TLS_PT4_INV1Ctrl_AC_PredMaxCurr_ST3 "" LINEAR "%10.0" "A" COEFFS_LINEAR 1 0 /end COMPU_METHOD
/begin COMPU_METHOD SO.TLS_PT4_INV1Ctrl_AC_PredMaxCurr_ST3_g "" LINEAR "%5.0" "A" COEFFS_LINEAR 1 0 /end COMPU_METHOD
/begin COMPU_METHOD SO.TLS_PT4_INV1Ctrl_AC_PredMaxCurr_Short_ST3 "" LINEAR "%10.0" "A" COEFFS_LINEAR 1 0 /end COMPU_METHOD
/begin COMPU_METHOD SO.TLS_PT4_INV1Ctrl_AC_PredMaxCurr_Short_ST3_h "" LINEAR "%5.0" "A" COEFFS_LINEAR 1 0 /end COMPU_METHOD
/begin COMPU_METHOD SO.TLS_PT4_INV1Ctrl_AJ_Actv_ST3 "" LINEAR "%5.0" "" COEFFS_LINEAR 1 0 /end COMPU_METHOD
/begin COMPU_METHOD SO.TLS_PT4_INV1Ctrl_AJ_Actv_ST3_j "" LINEAR "%3.0" "" COEFFS_LINEAR 1 0 /end COMPU_METHOD
/begin COMPU_METHOD SO.TLS_PT4_INV1Ctrl_AJ_Rdy_ST3 "" LINEAR "%5.0" "" COEFFS_LINEAR 1 0 /end COMPU_METHOD
/begin COMPU_METHOD SO.TLS_PT4_INV1Ctrl_AJ_Rdy_ST3_k "" LINEAR "%3.0" "" COEFFS_LINEAR 1 0 /end COMPU_METHOD
/begin COMPU_METHOD SO.TLS_PT4_INV1Ctrl_ASO_Avl_ST3 "" LINEAR "%5.0" "" COEFFS_LINEAR 1 0 /end COMPU_METHOD
/begin COMPU_METHOD SO.TLS_PT4_INV1Ctrl_ASO_Avl_ST3_l "" LINEAR "%3.0" "" COEFFS_LINEAR 1 0 /end COMPU_METHOD
/begin COMPU_METHOD SO.TLS_PT4_INV1Ctrl_AnglOfsLrnd_ST3 "" LINEAR "%5.0" "" COEFFS_LINEAR 1 0 /end COMPU_METHOD
/begin COMPU_METHOD SO.TLS_PT4_INV1Ctrl_AnglOfsLrnd_ST3_m "" LINEAR "%3.0" "" COEFFS_LINEAR 1 0 /end COMPU_METHOD
/begin COMPU_METHOD SO.TLS_PT4_INV1Ctrl_Cltch_RPM_diff_ST3 "" LINEAR "%12.1" "rpm" COEFFS_LINEAR 0.5 -127 /end COMPU_METHOD
/begin COMPU_METHOD SO.TLS_PT4_INV1Ctrl_Cltch_RPM_diff_ST3_n "" LINEAR "%7.1" "rpm" COEFFS_LINEAR 0.5 -127 /end COMPU_METHOD
/begin COMPU_METHOD SO.TLS_PT4_INV1Ctrl_Cltch_Trq_Dcpl_Stat_ST3 "" LINEAR "%5.0" "" COEFFS_LINEAR 1 0 /end COMPU_METHOD
/begin COMPU_METHOD SO.TLS_PT4_INV1Ctrl_Cltch_Trq_Dcpl_Stat_ST3_o "" LINEAR "%3.0" "" COEFFS_LINEAR 1 0 /end COMPU_METHOD
/begin COMPU_METHOD SO.TLS_PT4_INV1Ctrl_DC_Curr_ST3 "" LINEAR "%11.1" "A" COEFFS_LINEAR 0.1 -1638.2 /end COMPU_METHOD
/begin COMPU_METHOD SO.TLS_PT4_INV1Ctrl_DC_Curr_ST3_p "" LINEAR "%6.1" "A" COEFFS_LINEAR 0.1 -1638.2 /end COMPU_METHOD
/begin COMPU_METHOD SO.TLS_PT4_INV1Ctrl_DC_Curr_Warn_RTM_ST3 "" LINEAR "%5.0" "" COEFFS_LINEAR 1 0 /end COMPU_METHOD
/begin COMPU_METHOD SO.TLS_PT4_INV1Ctrl_DC_Curr_Warn_RTM_ST3_q "" LINEAR "%3.0" "" COEFFS_LINEAR 1 0 /end COMPU_METHOD
/begin COMPU_METHOD SO.TLS_PT4_INV1Ctrl_Decpl_Rq_ST3 "" LINEAR "%5.0" "" COEFFS_LINEAR 1 0 /end COMPU_METHOD
/begin COMPU_METHOD SO.TLS_PT4_INV1Ctrl_Decpl_Rq_ST3_r "" LINEAR "%3.0" "" COEFFS_LINEAR 1 0 /end COMPU_METHOD
/begin COMPU_METHOD SO.TLS_PT4_INV1Ctrl_EMTrqLoss_ST3 "" LINEAR "%14.4" "Nm" COEFFS_LINEAR 0.0625 0 /end COMPU_METHOD
/begin COMPU_METHOD SO.TLS_PT4_INV1Ctrl_EMTrqLoss_ST3_s "" LINEAR "%9.4" "Nm" COEFFS_LINEAR 0.0625 0 /end COMPU_METHOD
/begin COMPU_METHOD SO.TLS_PT4_INV1Ctrl_Flt_Stat_Cool_ST3 "" LINEAR "%5.0" "" COEFFS_LINEAR 1 0 /end COMPU_METHOD
/begin COMPU_METHOD SO.TLS_PT4_INV1Ctrl_Flt_Stat_Cool_ST3_t "" LINEAR "%3.0" "" COEFFS_LINEAR 1 0 /end COMPU_METHOD
/begin COMPU_METHOD SO.TLS_PT4_INV1Ctrl_Flt_Stat_RPM_Lim_Rq_ST3 "" LINEAR "%10.0" "rpm" COEFFS_LINEAR 1 0 /end COMPU_METHOD
/begin COMPU_METHOD SO.TLS_PT4_INV1Ctrl_Flt_Stat_RPM_Lim_Rq_ST3_u "" LINEAR "%5.0" "rpm" COEFFS_LINEAR 1 0 /end COMPU_METHOD
/begin COMPU_METHOD SO.TLS_PT4_INV1Ctrl_Flt_Stat_SnsrlssSpdCtrl_ST3 "" LINEAR "%5.0" "" COEFFS_LINEAR 1 0 /end COMPU_METHOD
/begin COMPU_METHOD SO.TLS_PT4_INV1Ctrl_Flt_Stat_SnsrlssSpdCtrl_ST3_v "" LINEAR "%3.0" "" COEFFS_LINEAR 1 0 /end COMPU_METHOD
/begin COMPU_METHOD SO.TLS_PT4_INV1Ctrl_GbBcklash_Stat_ST3 "" LINEAR "%5.0" "" COEFFS_LINEAR 1 0 /end COMPU_METHOD
/begin COMPU_METHOD SO.TLS_PT4_INV1Ctrl_GbBcklash_Stat_ST3_x "" LINEAR "%3.0" "" COEFFS_LINEAR 1 0 /end COMPU_METHOD
/begin COMPU_METHOD SO.TLS_PT4_INV1Ctrl_GbOpn_Enbl_ST3 "" LINEAR "%5.0" "" COEFFS_LINEAR 1 0 /end COMPU_METHOD
/begin COMPU_METHOD SO.TLS_PT4_INV1Ctrl_GbOpn_Enbl_ST3_y "" LINEAR "%3.0" "" COEFFS_LINEAR 1 0 /end COMPU_METHOD
/begin COMPU_METHOD SO.TLS_PT4_INV1Ctrl_LowTemp_FlowVolCirc1_Rq_ST3 "" LINEAR "%11.1" "l_per_min" COEFFS_LINEAR 0.1 0 /end COMPU_METHOD
/begin COMPU_METHOD SO.TLS_PT4_INV1Ctrl_LowTemp_FlowVolCirc1_Rq_ST3_z "" LINEAR "%6.1" "l_per_min" COEFFS_LINEAR 0.1 0 /end COMPU_METHOD
/begin COMPU_METHOD SO.TLS_PT4_INV1Ctrl_MIL_On_Rq_ST3 "" LINEAR "%5.0" "" COEFFS_LINEAR 1 0 /end COMPU_METHOD
/begin COMPU_METHOD SO.TLS_PT4_INV1Ctrl_MIL_On_Rq_ST3_24 "" LINEAR "%3.0" "" COEFFS_LINEAR 1 0 /end COMPU_METHOD
/begin COMPU_METHOD SO.TLS_PT4_INV1Ctrl_Mach_Stat_ST3 "" LINEAR "%5.0" "" COEFFS_LINEAR 1 0 /end COMPU_METHOD
/begin COMPU_METHOD SO.TLS_PT4_INV1Ctrl_Mach_Stat_ST3_25 "" LINEAR "%3.0" "" COEFFS_LINEAR 1 0 /end COMPU_METHOD
/begin COMPU_METHOD SO.TLS_PT4_INV1Ctrl_OilCool_Rotor_Rq_ST3 "" LINEAR "%6.1" "l_per_min" COEFFS_LINEAR 0.1 0 /end COMPU_METHOD
/begin COMPU_METHOD SO.TLS_PT4_INV1Ctrl_OilCool_Rotor_Rq_ST3_26 "" LINEAR "%4.1" "l_per_min" COEFFS_LINEAR 0.1 0 /end COMPU_METHOD
/begin COMPU_METHOD SO.TLS_PT4_INV1Ctrl_OilCool_Stator_Rq_ST3 "" LINEAR "%6.1" "l_per_min" COEFFS_LINEAR 0.1 0 /end COMPU_METHOD
/begin COMPU_METHOD SO.TLS_PT4_INV1Ctrl_OilCool_Stator_Rq_ST3_27 "" LINEAR "%4.1" "l_per_min" COEFFS_LINEAR 0.1 0 /end COMPU_METHOD
/begin COMPU_METHOD SO.TLS_PT4_INV1Ctrl_PhaseAC_Curr_ST3 "" LINEAR "%11.1" "A" COEFFS_LINEAR 0.1 0 /end COMPU_METHOD
/begin COMPU_METHOD SO.TLS_PT4_INV1Ctrl_PhaseAC_Curr_ST3_28 "" LINEAR "%6.1" "A" COEFFS_LINEAR 0.1 0 /end COMPU_METHOD
/begin COMPU_METHOD SO.TLS_PT4_INV1Ctrl_PredTrqAvl_Max_ST3 "" LINEAR "%14.4" "Nm" COEFFS_LINEAR 0.0625 -2047.9375 /end COMPU_METHOD
/begin COMPU_METHOD SO.TLS_PT4_INV1Ctrl_PredTrqAvl_Max_ST3_29 "" LINEAR "%9.4" "Nm" COEFFS_LINEAR 0.0625 -2047.9375 /end COMPU_METHOD
/begin COMPU_METHOD SO.TLS_PT4_INV1Ctrl_PredTrqAvl_Min_ST3 "" LINEAR "%14.4" "Nm" COEFFS_LINEAR 0.0625 -2047.9375 /end COMPU_METHOD
/begin COMPU_METHOD SO.TLS_PT4_INV1Ctrl_PredTrqAvl_Min_ST3_30 "" LINEAR "%9.4" "Nm" COEFFS_LINEAR 0.0625 -2047.9375 /end COMPU_METHOD
/begin COMPU_METHOD SO.TLS_PT4_INV1Ctrl_PwrLoss_ST3 "" LINEAR "%11.0" "W" COEFFS_LINEAR 20 0 /end COMPU_METHOD
/begin COMPU_METHOD SO.TLS_PT4_INV1Ctrl_PwrLoss_ST3_31 "" LINEAR "%7.0" "W" COEFFS_LINEAR 20 0 /end COMPU_METHOD
/begin COMPU_METHOD SO.TLS_PT4_INV1Ctrl_PwrStg_Flt_Stat_ST3 "" LINEAR "%5.0" "" COEFFS_LINEAR 1 0 /end COMPU_METHOD
/begin COMPU_METHOD SO.TLS_PT4_INV1Ctrl_PwrStg_Flt_Stat_ST3_32 "" LINEAR "%3.0" "" COEFFS_LINEAR 1 0 /end COMPU_METHOD
/begin COMPU_METHOD SO.TLS_PT4_INV1Ctrl_PwrWst_Actv_ST3 "" LINEAR "%5.0" "" COEFFS_LINEAR 1 0 /end COMPU_METHOD
/begin COMPU_METHOD SO.TLS_PT4_INV1Ctrl_PwrWst_Actv_ST3_33 "" LINEAR "%3.0" "" COEFFS_LINEAR 1 0 /end COMPU_METHOD
/begin COMPU_METHOD SO.TLS_PT4_INV1Ctrl_PwrWst_Rdy_ST3 "" LINEAR "%5.0" "" COEFFS_LINEAR 1 0 /end COMPU_METHOD
/begin COMPU_METHOD SO.TLS_PT4_INV1Ctrl_PwrWst_Rdy_ST3_34 "" LINEAR "%3.0" "" COEFFS_LINEAR 1 0 /end COMPU_METHOD
/begin COMPU_METHOD SO.TLS_PT4_INV1Ctrl_SpdLimitBCS_Max_Actv_ST3 "" LINEAR "%5.0" "" COEFFS_LINEAR 1 0 /end COMPU_METHOD
/begin COMPU_METHOD SO.TLS_PT4_INV1Ctrl_SpdLimitBCS_Max_Actv_ST3_35 "" LINEAR "%3.0" "" COEFFS_LINEAR 1 0 /end COMPU_METHOD
/begin COMPU_METHOD SO.TLS_PT4_INV1Ctrl_SpdLimitBCS_Max_Rdy_ST3 "" LINEAR "%5.0" "" COEFFS_LINEAR 1 0 /end COMPU_METHOD
/begin COMPU_METHOD SO.TLS_PT4_INV1Ctrl_SpdLimitBCS_Max_Rdy_ST3_36 "" LINEAR "%3.0" "" COEFFS_LINEAR 1 0 /end COMPU_METHOD
/begin COMPU_METHOD SO.TLS_PT4_INV1Ctrl_SpdLimitBCS_Min_Actv_ST3 "" LINEAR "%5.0" "" COEFFS_LINEAR 1 0 /end COMPU_METHOD
/begin COMPU_METHOD SO.TLS_PT4_INV1Ctrl_SpdLimitBCS_Min_Actv_ST3_37 "" LINEAR "%3.0" "" COEFFS_LINEAR 1 0 /end COMPU_METHOD
/begin COMPU_METHOD SO.TLS_PT4_INV1Ctrl_SpdLimitBCS_Min_Rdy_ST3 "" LINEAR "%5.0" "" COEFFS_LINEAR 1 0 /end COMPU_METHOD
/begin COMPU_METHOD SO.TLS_PT4_INV1Ctrl_SpdLimitBCS_Min_Rdy_ST3_38 "" LINEAR "%3.0" "" COEFFS_LINEAR 1 0 /end COMPU_METHOD
/begin COMPU_METHOD SO.TLS_PT4_INV1Ctrl_Temp_Cpctr_ST3 "" LINEAR "%5.0" "degC" COEFFS_LINEAR 1 -40 /end COMPU_METHOD
/begin COMPU_METHOD SO.TLS_PT4_INV1Ctrl_Temp_Cpctr_ST3_39 "" LINEAR "%3.0" "degC" COEFFS_LINEAR 1 -40 /end COMPU_METHOD
/begin COMPU_METHOD SO.TLS_PT4_INV1Ctrl_Temp_InvCool_Inlet_ST3 "" LINEAR "%5.0" "degC" COEFFS_LINEAR 1 -40 /end COMPU_METHOD
/begin COMPU_METHOD SO.TLS_PT4_INV1Ctrl_Temp_InvCool_Inlet_ST3_40 "" LINEAR "%3.0" "degC" COEFFS_LINEAR 1 -40 /end COMPU_METHOD
/begin COMPU_METHOD SO.TLS_PT4_INV1Ctrl_Temp_InvCool_ST3 "" LINEAR "%5.0" "degC" COEFFS_LINEAR 1 -40 /end COMPU_METHOD
/begin COMPU_METHOD SO.TLS_PT4_INV1Ctrl_Temp_InvCool_ST3_41 "" LINEAR "%3.0" "degC" COEFFS_LINEAR 1 -40 /end COMPU_METHOD
/begin COMPU_METHOD SO.TLS_PT4_INV1Ctrl_Temp_Invrt_ST3 "" LINEAR "%5.0" "degC" COEFFS_LINEAR 1 -40 /end COMPU_METHOD
/begin COMPU_METHOD SO.TLS_PT4_INV1Ctrl_Temp_Invrt_ST3_42 "" LINEAR "%3.0" "degC" COEFFS_LINEAR 1 -40 /end COMPU_METHOD
/begin COMPU_METHOD SO.TLS_PT4_INV1Ctrl_Temp_Invrt_Warn_RTM_ST3 "" LINEAR "%5.0" "" COEFFS_LINEAR 1 0 /end COMPU_METHOD
/begin COMPU_METHOD SO.TLS_PT4_INV1Ctrl_Temp_Invrt_Warn_RTM_ST3_43 "" LINEAR "%3.0" "" COEFFS_LINEAR 1 0 /end COMPU_METHOD
/begin COMPU_METHOD SO.TLS_PT4_INV1Ctrl_Temp_RotorObsrv_ST3 "" LINEAR "%5.0" "degC" COEFFS_LINEAR 1 -40 /end COMPU_METHOD
/begin COMPU_METHOD SO.TLS_PT4_INV1Ctrl_Temp_RotorObsrv_ST3_44 "" LINEAR "%3.0" "degC" COEFFS_LINEAR 1 -40 /end COMPU_METHOD
/begin COMPU_METHOD SO.TLS_PT4_INV1Ctrl_Temp_Stator_ST3 "" LINEAR "%5.0" "degC" COEFFS_LINEAR 1 -40 /end COMPU_METHOD
/begin COMPU_METHOD SO.TLS_PT4_INV1Ctrl_Temp_Stator_ST3_45 "" LINEAR "%3.0" "degC" COEFFS_LINEAR 1 -40 /end COMPU_METHOD
/begin COMPU_METHOD SO.TLS_PT4_INV1Ctrl_Temp_Stator_Warn_RTM_ST3 "" LINEAR "%5.0" "" COEFFS_LINEAR 1 0 /end COMPU_METHOD
/begin COMPU_METHOD SO.TLS_PT4_INV1Ctrl_Temp_Stator_Warn_RTM_ST3_46 "" LINEAR "%3.0" "" COEFFS_LINEAR 1 0 /end COMPU_METHOD
/begin COMPU_METHOD SO.TLS_PT4_INV1Ctrl_Tow_Enbl_ST3 "" LINEAR "%5.0" "" COEFFS_LINEAR 1 0 /end COMPU_METHOD
/begin COMPU_METHOD SO.TLS_PT4_INV1Ctrl_Tow_Enbl_ST3_47 "" LINEAR "%3.0" "" COEFFS_LINEAR 1 0 /end COMPU_METHOD
/begin COMPU_METHOD SO.TLS_PT4_INV1Ctrl_TrqAvl_Max_Perc_ST3 "" LINEAR "%5.0" "perc" COEFFS_LINEAR 1 0 /end COMPU_METHOD
/begin COMPU_METHOD SO.TLS_PT4_INV1Ctrl_TrqAvl_Max_Perc_ST3_48 "" LINEAR "%3.0" "perc" COEFFS_LINEAR 1 0 /end COMPU_METHOD
/begin COMPU_METHOD SO.TLS_PT4_INV1Ctrl_TrqAvl_Max_ST3 "" LINEAR "%14.4" "Nm" COEFFS_LINEAR 0.0625 -2047.9375 /end COMPU_METHOD
/begin COMPU_METHOD SO.TLS_PT4_INV1Ctrl_TrqAvl_Max_ST3_49 "" LINEAR "%9.4" "Nm" COEFFS_LINEAR 0.0625 -2047.9375 /end COMPU_METHOD
/begin COMPU_METHOD SO.TLS_PT4_INV1Ctrl_TrqAvl_Min_Perc_ST3 "" LINEAR "%5.0" "perc" COEFFS_LINEAR 1 0 /end COMPU_METHOD
/begin COMPU_METHOD SO.TLS_PT4_INV1Ctrl_TrqAvl_Min_Perc_ST3_50 "" LINEAR "%3.0" "perc" COEFFS_LINEAR 1 0 /end COMPU_METHOD
/begin COMPU_METHOD SO.TLS_PT4_INV1Ctrl_TrqAvl_Min_ST3 "" LINEAR "%14.4" "Nm" COEFFS_LINEAR 0.0625 -2047.9375 /end COMPU_METHOD
/begin COMPU_METHOD SO.TLS_PT4_INV1Ctrl_TrqAvl_Min_ST3_51 "" LINEAR "%9.4" "Nm" COEFFS_LINEAR 0.0625 -2047.9375 /end COMPU_METHOD
/begin COMPU_METHOD SO.TLS_PT4_INV1Ctrl_TrqComf_ST3 "" LINEAR "%14.4" "Nm" COEFFS_LINEAR 0.0625 -2047.9375 /end COMPU_METHOD
/begin COMPU_METHOD SO.TLS_PT4_INV1Ctrl_TrqComf_ST3_52 "" LINEAR "%9.4" "Nm" COEFFS_LINEAR 0.0625 -2047.9375 /end COMPU_METHOD
/begin COMPU_METHOD SO.TLS_PT4_INV1Ctrl_TrqRdc_Flt_Stat_ST3 "" LINEAR "%5.0" "" COEFFS_LINEAR 1 0 /end COMPU_METHOD
/begin COMPU_METHOD SO.TLS_PT4_INV1Ctrl_TrqRdc_Flt_Stat_ST3_53 "" LINEAR "%3.0" "" COEFFS_LINEAR 1 0 /end COMPU_METHOD
/begin COMPU_METHOD SO.TLS_PT4_INV1Ctrl_TrqRdc_Stat_ST3 "" LINEAR "%5.0" "" COEFFS_LINEAR 1 0 /end COMPU_METHOD
/begin COMPU_METHOD SO.TLS_PT4_INV1Ctrl_TrqRdc_Stat_ST3_54 "" LINEAR "%3.0" "" COEFFS_LINEAR 1 0 /end COMPU_METHOD
/begin COMPU_METHOD SO.TLS_PT4_INV1Ctrl_VehImmobSyst_Actv_Md_ST3 "" LINEAR "%5.0" "" COEFFS_LINEAR 1 0 /end COMPU_METHOD
/begin COMPU_METHOD SO.TLS_PT4_INV1Ctrl_VehImmobSyst_Actv_Md_ST3_55 "" LINEAR "%3.0" "" COEFFS_LINEAR 1 0 /end COMPU_METHOD
/begin COMPU_METHOD SO.TLS_PT4_INV2Ctrl_ShW2_MnTrctAxl_DrvPosn_Stat_ST3 "" LINEAR "%5.0" "" COEFFS_LINEAR 1 0 /end COMPU_METHOD
/begin COMPU_METHOD SO.TLS_PT4_INV2Ctrl_ShW2_MnTrctAxl_DrvPosn_Stat_ST3_56 "" LINEAR "%3.0" "" COEFFS_LINEAR 1 0 /end COMPU_METHOD
/begin COMPU_METHOD SOc.Asw_Ang_deg "" IDENTICAL "%12.6" "degree" /end COMPU_METHOD
/begin COMPU_METHOD SOc.Asw_Perc "" IDENTICAL "%12.6" "%" /end COMPU_METHOD
/begin COMPU_METHOD SOc.Asw_Pwr_W "" IDENTICAL "%12.6" "W" /end COMPU_METHOD
/begin COMPU_METHOD SOc.Asw_SigQly "" TAB_VERB "%s" "" COMPU_TAB_REF SOc.CONV_TAB_Asw_SigQly /end COMPU_METHOD
/begin COMPU_METHOD SOc.Asw_Spd_rpm "" IDENTICAL "%12.6" "rpm" /end COMPU_METHOD
/begin COMPU_METHOD SOc.Asw_Temp_degC "" IDENTICAL "%6.1" "degC" /end COMPU_METHOD
/begin COMPU_METHOD SOc.Asw_Trq_Nm "" IDENTICAL "%12.6" "Nm" /end COMPU_METHOD
/begin COMPU_METHOD SOc.Asw_Vof_lpmin "" IDENTICAL "%12.6" "lpm" /end COMPU_METHOD
/begin COMPU_METHOD SOc.Asw_Volt_V "" IDENTICAL "%12.6" "V" /end COMPU_METHOD
/begin COMPU_METHOD SOc.Edp_TrqLimRsn "" TAB_VERB "%d" "" COMPU_TAB_REF SOc.CONV_TAB_Edp_TrqLimRsn /end COMPU_METHOD
/begin COMPU_METHOD SOc.SI_cmdEmReq "" TAB_VERB "%3.0" "" COMPU_TAB_REF SOc.CONV_TAB_SI_cmdEmReq /end COMPU_METHOD
/begin COMPU_METHOD SOc.TLE_cmdBckupFcn1 "Enumeration for requested controller state" TAB_VERB "%3.0" "" COMPU_TAB_REF SOc.CONV_TAB_TLE_cmdBckupFcn1 /end COMPU_METHOD
/begin COMPU_METHOD SOc.TLE_cmdBckupFcn2 "Enumeration for Backupfunction Gear Shift / Park Lock" TAB_VERB "%3.0" "" COMPU_TAB_REF SOc.CONV_TAB_TLE_cmdBckupFcn2 /end COMPU_METHOD
/begin COMPU_METHOD SOc.TLE_cmdEm "TargetLink Scaling Type for command EM" TAB_VERB "%3.0" "" COMPU_TAB_REF SOc.CONV_TAB_TLE_cmdEm /end COMPU_METHOD
/begin COMPU_METHOD SOc.TLE_reqCtrlMode "Enumeration for requested controller state" TAB_VERB "%3.0" "" COMPU_TAB_REF SOc.CONV_TAB_TLE_reqCtrlMode /end COMPU_METHOD
/begin COMPU_METHOD SOc.TLE_stGear "Enumeration for gear state" TAB_VERB "%3.0" "" COMPU_TAB_REF SOc.CONV_TAB_TLE_stGear /end COMPU_METHOD
/begin COMPU_METHOD SOc.TLE_stGearShift "Enumeration for gear state" TAB_VERB "%3.0" "" COMPU_TAB_REF SOc.CONV_TAB_TLE_stGearShift /end COMPU_METHOD
/begin COMPU_METHOD SOc.TLE_stQuadrant "Enumeration for requested controller state" TAB_VERB "%3.0" "" COMPU_TAB_REF SOc.CONV_TAB_TLE_stQuadrant /end COMPU_METHOD
/begin COMPU_METHOD SOc.TLS_PT4_INV1Ctrl_CyCutSw_Stat_ST3 "" LINEAR "%5.0" "" COEFFS_LINEAR 1 0 /end COMPU_METHOD
/begin COMPU_METHOD SOc.TLS_PT4_INV1Ctrl_CyCutSw_Stat_ST3_c "" LINEAR "%3.0" "" COEFFS_LINEAR 1 0 /end COMPU_METHOD
/begin COMPU_METHOD SOc.TLS_PT4_INV1Ctrl_DC_Volt_ST3 "" LINEAR "%12.3" "V" COEFFS_LINEAR 0.025 0 /end COMPU_METHOD
/begin COMPU_METHOD SOc.TLS_PT4_INV1Ctrl_DC_Volt_ST3_d "" LINEAR "%8.3" "V" COEFFS_LINEAR 0.025 0 /end COMPU_METHOD
/begin COMPU_METHOD SOc.TLS_PT4_INV1Ctrl_DC_Volt_ST3_m "" LINEAR "%13.3" "V" COEFFS_LINEAR 0.025 0 /end COMPU_METHOD
/begin COMPU_METHOD SOc.TLS_PT4_INV1Ctrl_Flt_Stat_ActvDschrg_ST3 "" LINEAR "%5.0" "" COEFFS_LINEAR 1 0 /end COMPU_METHOD
/begin COMPU_METHOD SOc.TLS_PT4_INV1Ctrl_Flt_Stat_ActvDschrg_ST3_a "" LINEAR "%3.0" "" COEFFS_LINEAR 1 0 /end COMPU_METHOD
/begin COMPU_METHOD SOc.TLS_PT4_INV1Ctrl_GbOpn_Stat_ST3 "" LINEAR "%5.0" "" COEFFS_LINEAR 1 0 /end COMPU_METHOD
/begin COMPU_METHOD SOc.TLS_PT4_INV1Ctrl_GbOpn_Stat_ST3_e "" LINEAR "%3.0" "" COEFFS_LINEAR 1 0 /end COMPU_METHOD
/begin COMPU_METHOD SOc.TLS_PT4_INV1Ctrl_Health_Stat_ST3 "" LINEAR "%5.0" "-" COEFFS_LINEAR 1 0 /end COMPU_METHOD
/begin COMPU_METHOD SOc.TLS_PT4_INV1Ctrl_Health_Stat_ST3_f "" LINEAR "%3.0" "-" COEFFS_LINEAR 1 0 /end COMPU_METHOD
/begin COMPU_METHOD SOc.TLS_PT4_INV1Ctrl_Intrlk_Stat_ST3 "" LINEAR "%5.0" "" COEFFS_LINEAR 1 0 /end COMPU_METHOD
/begin COMPU_METHOD SOc.TLS_PT4_INV1Ctrl_Intrlk_Stat_ST3_b "" LINEAR "%3.0" "" COEFFS_LINEAR 1 0 /end COMPU_METHOD
/begin COMPU_METHOD SOc.TLS_PT4_INV1Ctrl_NegTrq_Rs_ST3 "" LINEAR "%5.0" "" COEFFS_LINEAR 1 0 /end COMPU_METHOD
/begin COMPU_METHOD SOc.TLS_PT4_INV1Ctrl_NegTrq_Rs_ST3_g "" LINEAR "%3.0" "" COEFFS_LINEAR 1 0 /end COMPU_METHOD
/begin COMPU_METHOD SOc.TLS_PT4_INV1Ctrl_PwrStg_Stat_ST3 "" LINEAR "%5.0" "" COEFFS_LINEAR 1 0 /end COMPU_METHOD
/begin COMPU_METHOD SOc.TLS_PT4_INV1Ctrl_PwrStg_Stat_ST3_h "" LINEAR "%3.0" "" COEFFS_LINEAR 1 0 /end COMPU_METHOD
/begin COMPU_METHOD SOc.TLS_PT4_INV1Ctrl_RPM_ST3 "" LINEAR "%12.2" "rpm" COEFFS_LINEAR 0.25 -131071.75 /end COMPU_METHOD
/begin COMPU_METHOD SOc.TLS_PT4_INV1Ctrl_RPM_ST3_j "" LINEAR "%13.2" "rpm" COEFFS_LINEAR 0.25 -131071.75 /end COMPU_METHOD
/begin COMPU_METHOD SOc.TLS_PT4_INV1Ctrl_RPM_Warn_RTM_ST3 "" LINEAR "%5.0" "" COEFFS_LINEAR 1 0 /end COMPU_METHOD
/begin COMPU_METHOD SOc.TLS_PT4_INV1Ctrl_RPM_Warn_RTM_ST3_k "" LINEAR "%3.0" "" COEFFS_LINEAR 1 0 /end COMPU_METHOD
/begin COMPU_METHOD SOc.TLS_PT4_INV1Ctrl_Trq_ST3 "" LINEAR "%14.4" "Nm" COEFFS_LINEAR 0.0625 -2047.9375 /end COMPU_METHOD
/begin COMPU_METHOD SOc.TLS_PT4_INV1Ctrl_Trq_ST3_l "" LINEAR "%9.4" "Nm" COEFFS_LINEAR 0.0625 -2047.9375 /end COMPU_METHOD
/begin COMPU_METHOD SOc.TLS_time10ms "TargetLink Scaling Type time 10ms" LINEAR "%5.0" "10ms" COEFFS_LINEAR 1 0 /end COMPU_METHOD
/begin COMPU_METHOD SuccessFailedPending "fits to default return values" TAB_VERB "%3.1" "" COMPU_TAB_REF SuccessFailedPending /end COMPU_METHOD
/begin COMPU_METHOD TBI.Asw_Ang_deg "" IDENTICAL "%12.6" "degree" /end COMPU_METHOD
/begin COMPU_METHOD TBI.Asw_Curr_A "" IDENTICAL "%12.6" "A" /end COMPU_METHOD
/begin COMPU_METHOD TBI.Asw_Pwr_W "" IDENTICAL "%12.6" "W" /end COMPU_METHOD
/begin COMPU_METHOD TBI.Asw_SigQly "" TAB_VERB "%s" "" COMPU_TAB_REF TBI.CONV_TAB_Asw_SigQly /end COMPU_METHOD
/begin COMPU_METHOD TBI.Asw_SpdRate_rpmps "" IDENTICAL "%12.6" "rpm/s" /end COMPU_METHOD
/begin COMPU_METHOD TBI.Asw_Spd_rpm "" IDENTICAL "%12.6" "rpm" /end COMPU_METHOD
/begin COMPU_METHOD TBI.Asw_Temp_degC "" IDENTICAL "%6.1" "degC" /end COMPU_METHOD
/begin COMPU_METHOD TBI.Asw_Trq_Nm "" IDENTICAL "%12.6" "Nm" /end COMPU_METHOD
/begin COMPU_METHOD TBI.Asw_Vof_lpmin "" IDENTICAL "%12.6" "lpm" /end COMPU_METHOD
/begin COMPU_METHOD TBI.Asw_Volt_V "" IDENTICAL "%12.6" "V" /end COMPU_METHOD
/begin COMPU_METHOD TBI.SI_stGear "Enumeration for gear state" TAB_VERB "%3.0" "" COMPU_TAB_REF TBI.CONV_TAB_SI_stGear /end COMPU_METHOD
/begin COMPU_METHOD TBI.TLE_cmdEmReq "Enumeration for requested controller state" TAB_VERB "%3.0" "" COMPU_TAB_REF TBI.CONV_TAB_TLE_cmdEmReq /end COMPU_METHOD
/begin COMPU_METHOD TBI.TLE_stGear "Enumeration for gear state" TAB_VERB "%3.0" "" COMPU_TAB_REF TBI.CONV_TAB_TLE_stGear /end COMPU_METHOD
/begin COMPU_METHOD TBI.TLE_statePwrNet "Enumeration for requested controller state" TAB_VERB "%3.0" "" COMPU_TAB_REF TBI.CONV_TAB_TLE_statePwrNet /end COMPU_METHOD
/begin COMPU_METHOD TBI.TLS_AVL_SIG_AGE_TB "" LINEAR "%6.0" "ms" COEFFS_LINEAR 5 0 /end COMPU_METHOD
/begin COMPU_METHOD TBI.TLS_EdiClt_EmInletFlow "" LINEAR "%5.2" "l/min" COEFFS_LINEAR 0.05 0 /end COMPU_METHOD
/begin COMPU_METHOD TBI.TLS_EdiClt_EmInletTemp "" LINEAR "%7.2" "ï¿½C" COEFFS_LINEAR 0.25 80 /end COMPU_METHOD
/begin COMPU_METHOD TBI.TLS_EdiClt_InvInletFlow "" LINEAR "%5.2" "l/min" COEFFS_LINEAR 0.05 0 /end COMPU_METHOD
/begin COMPU_METHOD TBI.TLS_EdiClt_InvInletTemp "" LINEAR "%7.2" "ï¿½C" COEFFS_LINEAR 0.25 80 /end COMPU_METHOD
/begin COMPU_METHOD TBI.TLS_EdiDcpl_reqDcpl "" LINEAR "%3.0" "-" COEFFS_LINEAR 1 0 /end COMPU_METHOD
/begin COMPU_METHOD TBI.TLS_EdiEdrv_ActvDchrgReq "" LINEAR "%3.0" "-" COEFFS_LINEAR 1 0 /end COMPU_METHOD
/begin COMPU_METHOD TBI.TLS_EdiEdrv_AngReq "" LINEAR "%8.3" "deg" COEFFS_LINEAR 0.125 0 /end COMPU_METHOD
/begin COMPU_METHOD TBI.TLS_EdiEdrv_CmtModeReq "" LINEAR "%3.0" "" COEFFS_LINEAR 1 0 /end COMPU_METHOD
/begin COMPU_METHOD TBI.TLS_EdiEdrv_CmtTestModeEn "" LINEAR "%3.0" "" COEFFS_LINEAR 1 0 /end COMPU_METHOD
/begin COMPU_METHOD TBI.TLS_EdiEdrv_CtlModeReq "" LINEAR "%3.0" "" COEFFS_LINEAR 1 0 /end COMPU_METHOD
/begin COMPU_METHOD TBI.TLS_EdiEdrv_CtlTestModeEn "" LINEAR "%3.0" "" COEFFS_LINEAR 1 0 /end COMPU_METHOD
/begin COMPU_METHOD TBI.TLS_EdiEdrv_CurrReq "" LINEAR "%9.3" "A" COEFFS_LINEAR 0.625 0 /end COMPU_METHOD
/begin COMPU_METHOD TBI.TLS_EdiEdrv_SpdReqMotShaft "" LINEAR "%5.0" "RPM" COEFFS_LINEAR 2 0 /end COMPU_METHOD
/begin COMPU_METHOD TBI.TLS_EdiEdrv_TrqReqLimMax "" LINEAR "%10.5" "Nm" COEFFS_LINEAR 0.03125 0 /end COMPU_METHOD
/begin COMPU_METHOD TBI.TLS_EdiEdrv_TrqReqLimMin "" LINEAR "%10.5" "Nm" COEFFS_LINEAR 0.03125 0 /end COMPU_METHOD
/begin COMPU_METHOD TBI.TLS_EdiEdrv_TrqReqLimSpdCtrlMax "" LINEAR "%10.5" "Nm" COEFFS_LINEAR 0.03125 0 /end COMPU_METHOD
/begin COMPU_METHOD TBI.TLS_EdiEdrv_TrqReqLimSpdCtrlMin "" LINEAR "%10.5" "Nm" COEFFS_LINEAR 0.03125 0 /end COMPU_METHOD
/begin COMPU_METHOD TBI.TLS_EdiEdrv_TrqReqShaft "" LINEAR "%10.5" "Nm" COEFFS_LINEAR 0.03125 0 /end COMPU_METHOD
/begin COMPU_METHOD TBI.TLS_EdiEdrv_VoltReq "" LINEAR "%10.5" "V" COEFFS_LINEAR 0.03125 0 /end COMPU_METHOD
/begin COMPU_METHOD TBI.TLS_EdiSys_BattCurrMaxDyn "" LINEAR "%5.0" "A" COEFFS_LINEAR 1 0 /end COMPU_METHOD
/begin COMPU_METHOD TBI.TLS_EdiSys_BattCurrMinDyn "" LINEAR "%5.0" "A" COEFFS_LINEAR 1 -1023 /end COMPU_METHOD
/begin COMPU_METHOD TBI.TLS_EdiSys_BattVoltMax "" LINEAR "%10.5" "V" COEFFS_LINEAR 0.03125 0 /end COMPU_METHOD
/begin COMPU_METHOD TBI.TLS_EdiSys_BattVoltMin "" LINEAR "%10.5" "V" COEFFS_LINEAR 0.03125 0 /end COMPU_METHOD
/begin COMPU_METHOD TBI.TLS_EdiSys_SpdSlopMax "" LINEAR "%4.0" "rpm/s" COEFFS_LINEAR 10 0 /end COMPU_METHOD
/begin COMPU_METHOD TBI.TLS_EdiSys_WhlSpdLe "" LINEAR "%7.2" "RPM" COEFFS_LINEAR 0.15 0 /end COMPU_METHOD
/begin COMPU_METHOD TBI.TLS_EdiSys_WhlSpdRi "" LINEAR "%7.2" "RPM" COEFFS_LINEAR 0.15 0 /end COMPU_METHOD
/begin COMPU_METHOD TBO.Asw_Ang_deg "" IDENTICAL "%12.6" "degree" /end COMPU_METHOD
/begin COMPU_METHOD TBO.Asw_Curr_A "" IDENTICAL "%12.6" "A" /end COMPU_METHOD
/begin COMPU_METHOD TBO.Asw_Curr_Apeak "" IDENTICAL "%12.6" "Apeak" /end COMPU_METHOD
/begin COMPU_METHOD TBO.Asw_Flux_Wb "" IDENTICAL "%12.6" "Wb" /end COMPU_METHOD
/begin COMPU_METHOD TBO.Asw_Frq_Hz "" IDENTICAL "%12.6" "Hz" /end COMPU_METHOD
/begin COMPU_METHOD TBO.Asw_Perc "" IDENTICAL "%12.6" "%" /end COMPU_METHOD
/begin COMPU_METHOD TBO.Asw_Pwr_W "" IDENTICAL "%12.6" "W" /end COMPU_METHOD
/begin COMPU_METHOD TBO.Asw_SigQly "" TAB_VERB "%s" "" COMPU_TAB_REF TBO.CONV_TAB_Asw_SigQly /end COMPU_METHOD
/begin COMPU_METHOD TBO.Asw_Spd_rpm "" IDENTICAL "%12.6" "rpm" /end COMPU_METHOD
/begin COMPU_METHOD TBO.Asw_Temp_degC "" IDENTICAL "%6.1" "degC" /end COMPU_METHOD
/begin COMPU_METHOD TBO.Asw_Trq_Nm "" IDENTICAL "%12.6" "Nm" /end COMPU_METHOD
/begin COMPU_METHOD TBO.Asw_Volt_V "" IDENTICAL "%12.6" "V" /end COMPU_METHOD
/begin COMPU_METHOD TBO.Asw_Volt_Vpeak "" IDENTICAL "%12.6" "Vpeak" /end COMPU_METHOD
/begin COMPU_METHOD TBO.LibTlHwIo_PwrStgOpnMode "" TAB_VERB "%d" "" COMPU_TAB_REF TBO.CONV_TAB_LibTlHwIo_PwrStgOpnMode /end COMPU_METHOD
/begin COMPU_METHOD TBO.TLE_Global_stCompstate "TargetLink Scaling Type InputY10_reqCompstate" TAB_VERB "%3.0" "" COMPU_TAB_REF TBO.CONV_TAB_TLE_Global_stCompstate /end COMPU_METHOD
/begin COMPU_METHOD TBO.TLE_reqCtrlMode "Enumeration for requested controller state" TAB_VERB "%3.0" "" COMPU_TAB_REF TBO.CONV_TAB_TLE_reqCtrlMode /end COMPU_METHOD
/begin COMPU_METHOD TBO.TLE_stGear "Enumeration for gear state" TAB_VERB "%3.0" "" COMPU_TAB_REF TBO.CONV_TAB_TLE_stGear /end COMPU_METHOD
/begin COMPU_METHOD TBO.TLE_stPosMon "TargetLink Scaling Type PosMonS02_curstate" TAB_VERB "%3.0" "" COMPU_TAB_REF TBO.CONV_TAB_TLE_stPosMon /end COMPU_METHOD
/begin COMPU_METHOD TBO.TLS_EdiEdrv_CmdBckFcn1 "" LINEAR "%3.0" "-" COEFFS_LINEAR 1 0 /end COMPU_METHOD
/begin COMPU_METHOD TBO.TLS_EdiEdrv_CmdBckFcn1_a "" LINEAR "%5.0" "-" COEFFS_LINEAR 1 0 /end COMPU_METHOD
/begin COMPU_METHOD TBO.TLS_EdiEdrv_CmdBckFcn2 "" LINEAR "%3.0" "-" COEFFS_LINEAR 1 0 /end COMPU_METHOD
/begin COMPU_METHOD TBO.TLS_EdiEdrv_CmdBckFcn2_b "" LINEAR "%5.0" "-" COEFFS_LINEAR 1 0 /end COMPU_METHOD
/begin COMPU_METHOD TBO.TLS_EdiEdrv_CmdBckFcn3 "" LINEAR "%3.0" "-" COEFFS_LINEAR 1 0 /end COMPU_METHOD
/begin COMPU_METHOD TBO.TLS_EdiEdrv_CmdBckFcn3_c "" LINEAR "%5.0" "-" COEFFS_LINEAR 1 0 /end COMPU_METHOD
/begin COMPU_METHOD TBO.TLS_EdiEdrv_Csm_HV_State "" LINEAR "%3.0" "" COEFFS_LINEAR 1 0 /end COMPU_METHOD
/begin COMPU_METHOD TBO.TLS_EdiEdrv_Csm_HV_State_o "" LINEAR "%5.0" "" COEFFS_LINEAR 1 0 /end COMPU_METHOD
/begin COMPU_METHOD TBO.TLS_EdiEdrv_Csm_LV_State "" LINEAR "%3.0" "" COEFFS_LINEAR 1 0 /end COMPU_METHOD
/begin COMPU_METHOD TBO.TLS_EdiEdrv_Csm_LV_State_t "" LINEAR "%5.0" "" COEFFS_LINEAR 1 0 /end COMPU_METHOD
/begin COMPU_METHOD TBO.TLS_EdiEdrv_CtlMode "" LINEAR "%3.0" "" COEFFS_LINEAR 1 0 /end COMPU_METHOD
/begin COMPU_METHOD TBO.TLS_EdiEdrv_DcLinkCapDeltaTemp "" LINEAR "%7.2" "ï¿½C" COEFFS_LINEAR 0.25 80 /end COMPU_METHOD
/begin COMPU_METHOD TBO.TLS_EdiEdrv_DcLinkCapTemp "" LINEAR "%7.2" "ï¿½C" COEFFS_LINEAR 0.25 80 /end COMPU_METHOD
/begin COMPU_METHOD TBO.TLS_EdiEdrv_DcLinkCurr "" LINEAR "%9.3" "A" COEFFS_LINEAR 0.625 0 /end COMPU_METHOD
/begin COMPU_METHOD TBO.TLS_EdiEdrv_DcLinkCurrRippleCurr "" LINEAR "%9.3" "A" COEFFS_LINEAR 0.625 0 /end COMPU_METHOD
/begin COMPU_METHOD TBO.TLS_EdiEdrv_DcLinkVolt "" LINEAR "%10.5" "V" COEFFS_LINEAR 0.03125 0 /end COMPU_METHOD
/begin COMPU_METHOD TBO.TLS_EdiEdrv_DcLinkVoltRednt "" LINEAR "%10.5" "V" COEFFS_LINEAR 0.03125 0 /end COMPU_METHOD
/begin COMPU_METHOD TBO.TLS_EdiEdrv_DcLinkVoltRednt_e "" LINEAR "%15.5" "V" COEFFS_LINEAR 0.03125 0 /end COMPU_METHOD
/begin COMPU_METHOD TBO.TLS_EdiEdrv_DcLinkVolt_d "" LINEAR "%15.5" "V" COEFFS_LINEAR 0.03125 0 /end COMPU_METHOD
/begin COMPU_METHOD TBO.TLS_EdiEdrv_DcplgSt "" LINEAR "%3.0" "-" COEFFS_LINEAR 1 0 /end COMPU_METHOD
/begin COMPU_METHOD TBO.TLS_EdiEdrv_DrctCurr "" LINEAR "%9.3" "A" COEFFS_LINEAR 0.625 0 /end COMPU_METHOD
/begin COMPU_METHOD TBO.TLS_EdiEdrv_DrctCurr2 "" LINEAR "%9.3" "A" COEFFS_LINEAR 0.625 0 /end COMPU_METHOD
/begin COMPU_METHOD TBO.TLS_EdiEdrv_DrctVolt "" LINEAR "%10.5" "V" COEFFS_LINEAR 0.03125 0 /end COMPU_METHOD
/begin COMPU_METHOD TBO.TLS_EdiEdrv_DrctVolt2 "" LINEAR "%10.5" "V" COEFFS_LINEAR 0.03125 0 /end COMPU_METHOD
/begin COMPU_METHOD TBO.TLS_EdiEdrv_DrctVolt2_f "" LINEAR "%14.5" "V" COEFFS_LINEAR 0.03125 0 /end COMPU_METHOD
/begin COMPU_METHOD TBO.TLS_EdiEdrv_DrctVolt_g "" LINEAR "%14.5" "V" COEFFS_LINEAR 0.03125 0 /end COMPU_METHOD
/begin COMPU_METHOD TBO.TLS_EdiEdrv_EdSmState "" LINEAR "%3.0" "" COEFFS_LINEAR 1 0 /end COMPU_METHOD
/begin COMPU_METHOD TBO.TLS_EdiEdrv_EdSmState_h "" LINEAR "%5.0" "" COEFFS_LINEAR 1 0 /end COMPU_METHOD
/begin COMPU_METHOD TBO.TLS_EdiEdrv_ElecAng "" LINEAR "%12.6" "deg" COEFFS_LINEAR 0.351906 0 /end COMPU_METHOD
/begin COMPU_METHOD TBO.TLS_EdiEdrv_EmPwrLoss "" LINEAR "%6.0" "W" COEFFS_LINEAR 2 0 /end COMPU_METHOD
/begin COMPU_METHOD TBO.TLS_EdiEdrv_EmPwrLoss_j "" LINEAR "%10.0" "W" COEFFS_LINEAR 2 0 /end COMPU_METHOD
/begin COMPU_METHOD TBO.TLS_EdiEdrv_EmSmState "" LINEAR "%3.0" "" COEFFS_LINEAR 1 0 /end COMPU_METHOD
/begin COMPU_METHOD TBO.TLS_EdiEdrv_EmSmState_k "" LINEAR "%5.0" "" COEFFS_LINEAR 1 0 /end COMPU_METHOD
/begin COMPU_METHOD TBO.TLS_EdiEdrv_ErrBf "" LINEAR "%3.0" "" COEFFS_LINEAR 1 0 /end COMPU_METHOD
/begin COMPU_METHOD TBO.TLS_EdiEdrv_ErrBf_l "" LINEAR "%5.0" "" COEFFS_LINEAR 1 0 /end COMPU_METHOD
/begin COMPU_METHOD TBO.TLS_EdiEdrv_ExtSnsrFreq1 "" LINEAR "%7.1" "Hz" COEFFS_LINEAR 0.5 0 /end COMPU_METHOD
/begin COMPU_METHOD TBO.TLS_EdiEdrv_ExtSnsrFreq1_m "" LINEAR "%12.1" "Hz" COEFFS_LINEAR 0.5 0 /end COMPU_METHOD
/begin COMPU_METHOD TBO.TLS_EdiEdrv_ExtSnsrFreq2 "" LINEAR "%7.1" "Hz" COEFFS_LINEAR 0.5 0 /end COMPU_METHOD
/begin COMPU_METHOD TBO.TLS_EdiEdrv_ExtSnsrFreq2_n "" LINEAR "%12.1" "Hz" COEFFS_LINEAR 0.5 0 /end COMPU_METHOD
/begin COMPU_METHOD TBO.TLS_EdiEdrv_HgSmState "" LINEAR "%3.0" "" COEFFS_LINEAR 1 0 /end COMPU_METHOD
/begin COMPU_METHOD TBO.TLS_EdiEdrv_HgSmState_p "" LINEAR "%5.0" "" COEFFS_LINEAR 1 0 /end COMPU_METHOD
/begin COMPU_METHOD TBO.TLS_EdiEdrv_IndMotPsiD "" LINEAR "%16.14" "Wb" COEFFS_LINEAR 6.103515625E-05 0 /end COMPU_METHOD
/begin COMPU_METHOD TBO.TLS_EdiEdrv_IndMotSlipAngVel "" LINEAR "%9.4" "rad/s" COEFFS_LINEAR 0.0325 0 /end COMPU_METHOD
/begin COMPU_METHOD TBO.TLS_EdiEdrv_IndMotSlipAngVel_q "" LINEAR "%13.4" "rad/s" COEFFS_LINEAR 0.0325 0 /end COMPU_METHOD
/begin COMPU_METHOD TBO.TLS_EdiEdrv_IndMotStatorAngVel "" LINEAR "%7.2" "rad/s" COEFFS_LINEAR 0.25 0 /end COMPU_METHOD
/begin COMPU_METHOD TBO.TLS_EdiEdrv_IndMotStatorAngVel_r "" LINEAR "%12.2" "rad/s" COEFFS_LINEAR 0.25 0 /end COMPU_METHOD
/begin COMPU_METHOD TBO.TLS_EdiEdrv_InvJuncTempEstMax "" LINEAR "%7.2" "ï¿½C" COEFFS_LINEAR 0.25 80 /end COMPU_METHOD
/begin COMPU_METHOD TBO.TLS_EdiEdrv_InvPhaseCurr1 "" LINEAR "%9.3" "A" COEFFS_LINEAR 0.625 0 /end COMPU_METHOD
/begin COMPU_METHOD TBO.TLS_EdiEdrv_InvPhaseCurr1AdcVolt "" LINEAR "%8.5" "V" COEFFS_LINEAR 0.00125 0 /end COMPU_METHOD
/begin COMPU_METHOD TBO.TLS_EdiEdrv_InvPhaseCurr2 "" LINEAR "%9.3" "A" COEFFS_LINEAR 0.625 0 /end COMPU_METHOD
/begin COMPU_METHOD TBO.TLS_EdiEdrv_InvPhaseCurr2AdcVolt "" LINEAR "%8.5" "V" COEFFS_LINEAR 0.00125 0 /end COMPU_METHOD
/begin COMPU_METHOD TBO.TLS_EdiEdrv_InvPhaseCurr3 "" LINEAR "%9.3" "A" COEFFS_LINEAR 0.625 0 /end COMPU_METHOD
/begin COMPU_METHOD TBO.TLS_EdiEdrv_InvPhaseCurr3AdcVolt "" LINEAR "%8.5" "V" COEFFS_LINEAR 0.00125 0 /end COMPU_METHOD
/begin COMPU_METHOD TBO.TLS_EdiEdrv_InvPhaseCurr4 "" LINEAR "%9.3" "A" COEFFS_LINEAR 0.625 0 /end COMPU_METHOD
/begin COMPU_METHOD TBO.TLS_EdiEdrv_InvPhaseCurr4AdcVolt "" LINEAR "%8.5" "V" COEFFS_LINEAR 0.00125 0 /end COMPU_METHOD
/begin COMPU_METHOD TBO.TLS_EdiEdrv_InvPhaseCurr5 "" LINEAR "%9.3" "A" COEFFS_LINEAR 0.625 0 /end COMPU_METHOD
/begin COMPU_METHOD TBO.TLS_EdiEdrv_InvPhaseCurr5AdcVolt "" LINEAR "%8.5" "V" COEFFS_LINEAR 0.00125 0 /end COMPU_METHOD
/begin COMPU_METHOD TBO.TLS_EdiEdrv_InvPhaseCurr6 "" LINEAR "%9.3" "A" COEFFS_LINEAR 0.625 0 /end COMPU_METHOD
/begin COMPU_METHOD TBO.TLS_EdiEdrv_InvPhaseCurr6AdcVolt "" LINEAR "%8.5" "V" COEFFS_LINEAR 0.00125 0 /end COMPU_METHOD
/begin COMPU_METHOD TBO.TLS_EdiEdrv_InvPwrLoss "" LINEAR "%5.0" "W" COEFFS_LINEAR 1 0 /end COMPU_METHOD
/begin COMPU_METHOD TBO.TLS_EdiEdrv_InvPwrLoss_s "" LINEAR "%10.0" "W" COEFFS_LINEAR 1 0 /end COMPU_METHOD
/begin COMPU_METHOD TBO.TLS_EdiEdrv_InvTempU "" LINEAR "%7.2" "ï¿½C" COEFFS_LINEAR 0.25 80 /end COMPU_METHOD
/begin COMPU_METHOD TBO.TLS_EdiEdrv_InvTempV "" LINEAR "%7.2" "ï¿½C" COEFFS_LINEAR 0.25 80 /end COMPU_METHOD
/begin COMPU_METHOD TBO.TLS_EdiEdrv_InvTempW "" LINEAR "%7.2" "ï¿½C" COEFFS_LINEAR 0.25 80 /end COMPU_METHOD
/begin COMPU_METHOD TBO.TLS_EdiEdrv_InvTempX "" LINEAR "%7.2" "ï¿½C" COEFFS_LINEAR 0.25 80 /end COMPU_METHOD
/begin COMPU_METHOD TBO.TLS_EdiEdrv_InvTempY "" LINEAR "%7.2" "ï¿½C" COEFFS_LINEAR 0.25 80 /end COMPU_METHOD
/begin COMPU_METHOD TBO.TLS_EdiEdrv_InvTempZ "" LINEAR "%7.2" "ï¿½C" COEFFS_LINEAR 0.25 80 /end COMPU_METHOD
/begin COMPU_METHOD TBO.TLS_EdiEdrv_MotTemp1 "" LINEAR "%7.2" "ï¿½C" COEFFS_LINEAR 0.25 80 /end COMPU_METHOD
/begin COMPU_METHOD TBO.TLS_EdiEdrv_MotTemp2 "" LINEAR "%7.2" "ï¿½C" COEFFS_LINEAR 0.25 80 /end COMPU_METHOD
/begin COMPU_METHOD TBO.TLS_EdiEdrv_PcbaTemp "" LINEAR "%7.2" "ï¿½C" COEFFS_LINEAR 0.25 80 /end COMPU_METHOD
/begin COMPU_METHOD TBO.TLS_EdiEdrv_PhaseCurrAvlRms "" LINEAR "%5.0" "A" COEFFS_LINEAR 1 0 /end COMPU_METHOD
/begin COMPU_METHOD TBO.TLS_EdiEdrv_PhaseCurrRms "" LINEAR "%5.0" "A" COEFFS_LINEAR 1 0 /end COMPU_METHOD
/begin COMPU_METHOD TBO.TLS_EdiEdrv_PldSafeStateSrcStsBf "" LINEAR "%5.0" "" COEFFS_LINEAR 1 0 /end COMPU_METHOD
/begin COMPU_METHOD TBO.TLS_EdiEdrv_PmFluxFact "" LINEAR "%7.2" "%" COEFFS_LINEAR 0.05 0 /end COMPU_METHOD
/begin COMPU_METHOD TBO.TLS_EdiEdrv_PwrStgFbOpnMode "" LINEAR "%3.0" "-" COEFFS_LINEAR 1 0 /end COMPU_METHOD
/begin COMPU_METHOD TBO.TLS_EdiEdrv_PwrStgFbOpnMode_u "" LINEAR "%5.0" "-" COEFFS_LINEAR 1 0 /end COMPU_METHOD
/begin COMPU_METHOD TBO.TLS_EdiEdrv_QuadCurr "" LINEAR "%9.3" "A" COEFFS_LINEAR 0.625 0 /end COMPU_METHOD
/begin COMPU_METHOD TBO.TLS_EdiEdrv_QuadCurr2 "" LINEAR "%9.3" "A" COEFFS_LINEAR 0.625 0 /end COMPU_METHOD
/begin COMPU_METHOD TBO.TLS_EdiEdrv_QuadVolt "" LINEAR "%10.5" "V" COEFFS_LINEAR 0.03125 0 /end COMPU_METHOD
/begin COMPU_METHOD TBO.TLS_EdiEdrv_QuadVolt2 "" LINEAR "%10.5" "V" COEFFS_LINEAR 0.03125 0 /end COMPU_METHOD
/begin COMPU_METHOD TBO.TLS_EdiEdrv_QuadVolt2_v "" LINEAR "%14.5" "V" COEFFS_LINEAR 0.03125 0 /end COMPU_METHOD
/begin COMPU_METHOD TBO.TLS_EdiEdrv_QuadVolt_x "" LINEAR "%14.5" "V" COEFFS_LINEAR 0.03125 0 /end COMPU_METHOD
/begin COMPU_METHOD TBO.TLS_EdiEdrv_RotorTempEstMax "" LINEAR "%7.2" "ï¿½C" COEFFS_LINEAR 0.25 80 /end COMPU_METHOD
/begin COMPU_METHOD TBO.TLS_EdiEdrv_SftySt "" LINEAR "%3.0" "" COEFFS_LINEAR 1 0 /end COMPU_METHOD
/begin COMPU_METHOD TBO.TLS_EdiEdrv_SftySt_y "" LINEAR "%5.0" "" COEFFS_LINEAR 1 0 /end COMPU_METHOD
/begin COMPU_METHOD TBO.TLS_EdiEdrv_SpdMaxAllwdMotShaft "" LINEAR "%5.0" "RPM" COEFFS_LINEAR 1 0 /end COMPU_METHOD
/begin COMPU_METHOD TBO.TLS_EdiEdrv_SpdMaxAllwdMotShaft_z "" LINEAR "%10.0" "RPM" COEFFS_LINEAR 1 0 /end COMPU_METHOD
/begin COMPU_METHOD TBO.TLS_EdiEdrv_SpdMotShaft "" LINEAR "%5.0" "RPM" COEFFS_LINEAR 2 0 /end COMPU_METHOD
/begin COMPU_METHOD TBO.TLS_EdiEdrv_SpdMotShaft_24 "" LINEAR "%10.0" "RPM" COEFFS_LINEAR 2 0 /end COMPU_METHOD
/begin COMPU_METHOD TBO.TLS_EdiEdrv_StatorTempEstMax "" LINEAR "%7.2" "ï¿½C" COEFFS_LINEAR 0.25 80 /end COMPU_METHOD
/begin COMPU_METHOD TBO.TLS_EdiEdrv_TrqMotShaft "" LINEAR "%10.5" "Nm" COEFFS_LINEAR 0.03125 0 /end COMPU_METHOD
/begin COMPU_METHOD TBO.TLS_EdiEdrv_TrqMotShaft_25 "" LINEAR "%14.5" "Nm" COEFFS_LINEAR 0.03125 0 /end COMPU_METHOD
/begin COMPU_METHOD TBO.TLS_EdiEdrv_TrqNegAvlShaft "" LINEAR "%10.5" "Nm" COEFFS_LINEAR 0.03125 -2047.96875 /end COMPU_METHOD
/begin COMPU_METHOD TBO.TLS_EdiEdrv_TrqNegAvlShaft_26 "" LINEAR "%14.5" "Nm" COEFFS_LINEAR 0.03125 -2047.96875 /end COMPU_METHOD
/begin COMPU_METHOD TBO.TLS_EdiEdrv_TrqNegLimDerReason "" LINEAR "%3.0" "" COEFFS_LINEAR 1 0 /end COMPU_METHOD
/begin COMPU_METHOD TBO.TLS_EdiEdrv_TrqNegLimDerReason_27 "" LINEAR "%5.0" "" COEFFS_LINEAR 1 0 /end COMPU_METHOD
/begin COMPU_METHOD TBO.TLS_EdiEdrv_TrqPosAvlShaft "" LINEAR "%10.5" "Nm" COEFFS_LINEAR 0.03125 0 /end COMPU_METHOD
/begin COMPU_METHOD TBO.TLS_EdiEdrv_TrqPosAvlShaft_28 "" LINEAR "%14.5" "Nm" COEFFS_LINEAR 0.03125 0 /end COMPU_METHOD
/begin COMPU_METHOD TBO.TLS_EdiEdrv_TrqPosLimDerReason "" LINEAR "%3.0" "" COEFFS_LINEAR 1 0 /end COMPU_METHOD
/begin COMPU_METHOD TBO.TLS_EdiEdrv_TrqPosLimDerReason_29 "" LINEAR "%5.0" "" COEFFS_LINEAR 1 0 /end COMPU_METHOD
/begin COMPU_METHOD TBO.TLS_EdiEdrv_dutyCycleHvil "" LINEAR "%5.1" "%" COEFFS_LINEAR 0.5 0 /end COMPU_METHOD
/begin COMPU_METHOD TBO.TLS_EdiEdrv_dutyCycleHvil_30 "" LINEAR "%7.1" "%" COEFFS_LINEAR 0.5 0 /end COMPU_METHOD
/begin COMPU_METHOD TBO.TLS_EdiEdrv_frqHvil "" LINEAR "%8.2" "Hz" COEFFS_LINEAR 0.25 0 /end COMPU_METHOD
/begin COMPU_METHOD TBO.TLS_EdiEdrv_frqHvil_31 "" LINEAR "%13.2" "Hz" COEFFS_LINEAR 0.25 0 /end COMPU_METHOD
/begin COMPU_METHOD TBO.TLS_EdiEdrv_nMainShaft "" LINEAR "%5.0" "rpm" COEFFS_LINEAR 1 -32768 /end COMPU_METHOD
/begin COMPU_METHOD TBO.TLS_EdiEdrv_nMainShaft_32 "" LINEAR "%10.0" "rpm" COEFFS_LINEAR 1 -32768 /end COMPU_METHOD
/begin COMPU_METHOD TBO.TLS_EdiSys_ResetCounter "" LINEAR "%3.0" "" COEFFS_LINEAR 1 0 /end COMPU_METHOD
/begin COMPU_METHOD TBO.TLS_EdiSys_SwBugfixVer "" LINEAR "%3.0" "" COEFFS_LINEAR 1 0 /end COMPU_METHOD
/begin COMPU_METHOD TBO.TLS_EdiSys_SwBugfixVer_33 "" LINEAR "%5.0" "" COEFFS_LINEAR 1 0 /end COMPU_METHOD
/begin COMPU_METHOD TBO.TLS_EdiSys_SwMajorVer "" LINEAR "%3.0" "" COEFFS_LINEAR 1 0 /end COMPU_METHOD
/begin COMPU_METHOD TBO.TLS_EdiSys_SwMajorVer_34 "" LINEAR "%5.0" "" COEFFS_LINEAR 1 0 /end COMPU_METHOD
/begin COMPU_METHOD TBO.TLS_EdiSys_SwMinorVer "" LINEAR "%3.0" "" COEFFS_LINEAR 1 0 /end COMPU_METHOD
/begin COMPU_METHOD TBO.TLS_EdiSys_SwMinorVer_35 "" LINEAR "%5.0" "" COEFFS_LINEAR 1 0 /end COMPU_METHOD
/begin COMPU_METHOD TBO.TLS_EdiSys_SwPatch "" LINEAR "%3.0" "" COEFFS_LINEAR 1 0 /end COMPU_METHOD
/begin COMPU_METHOD TBO.TLS_EdiSys_SwPatch_36 "" LINEAR "%5.0" "" COEFFS_LINEAR 1 0 /end COMPU_METHOD
/begin COMPU_METHOD Tangens_to_electrical_degree "atan(phi/5)" TAB_INTP "%2.4" "° elektr." COMPU_TAB_REF Tangens_to_electrical_degree.REF /end COMPU_METHOD
/begin COMPU_METHOD Temperature_1_16 "" RAT_FUNC "%3.2" "°C" COEFFS 0 16 0 0 0 1 /end COMPU_METHOD
/begin COMPU_METHOD Voltage_1_1024 "" RAT_FUNC "%3.3" "V" COEFFS 0 1024 0 0 0 1 /end COMPU_METHOD
/begin COMPU_METHOD angular_speed_to_rpm "calculation of rpm if speed given in 2^(-16) revolutions per ms" LINEAR "%4.0" "rpm" COEFFS_LINEAR 0.915527344 0 /end COMPU_METHOD
/begin COMPU_METHOD dso_state "" TAB_VERB "%.3" "" COMPU_TAB_REF dso_state /end COMPU_METHOD
/begin COMPU_METHOD dso_trigcond "" TAB_VERB "%.3" "" COMPU_TAB_REF dso_trigcond /end COMPU_METHOD
/begin COMPU_METHOD dso_trigcondcheckmode "" TAB_VERB "%.3" "" COMPU_TAB_REF dso_trigcondcheckmode /end COMPU_METHOD
/begin COMPU_METHOD dso_trigdt "" TAB_VERB "%.3" "" COMPU_TAB_REF dso_trigdt /end COMPU_METHOD
/begin COMPU_METHOD dso_triglogicmode "" TAB_VERB "%.3" "" COMPU_TAB_REF dso_triglogicmode /end COMPU_METHOD
/begin COMPU_METHOD dso_trigmode "" TAB_VERB "%.3" "" COMPU_TAB_REF dso_trigmode /end COMPU_METHOD
/begin COMPU_METHOD factor_100_1 "" RAT_FUNC "%3.4" "" COEFFS 0 100 0 0 0 1 /end COMPU_METHOD
/begin COMPU_METHOD hundred_percent_1024 "" RAT_FUNC "%3.3" "%" COEFFS 0 10.24 0 0 0 1 /end COMPU_METHOD
/begin COMPU_METHOD hundred_percent_1f "" RAT_FUNC "%3.3" "%" COEFFS 0 0.01 0 0 0 1 /end COMPU_METHOD
/begin COMPU_METHOD miliseconds_to_seconds "time in seconds" RAT_FUNC "%3.4" "s" COEFFS 0 1000 0 0 0 1 /end COMPU_METHOD
/begin COMPU_METHOD s_to_us_for_14k7Hz "" FORM "%3.15" "" /begin FORMULA " X * 2 * 1000000 " FORMULA_INV "X / (2 * 1000000)" /end FORMULA /end COMPU_METHOD
/begin COMPU_METHOD tangens_to_degrees "" FORM "%3.15" ""
 /begin FORMULA "atan(X) * 180 / 3.14159265" FORMULA_INV "tan(X * 3.14159265 / 180)" /end FORMULA
/end COMPU_METHOD
/begin COMPU_METHOD ten_miliseconds_to_seconds "time in seconds" RAT_FUNC "%3.4" "s" COEFFS 0 100 0 0 0 1 /end COMPU_METHOD
/begin COMPU_METHOD ticks_to_milliseconds "time in 100 MHz ticks / time in milliseconds" RAT_FUNC "%3.4" "ms" COEFFS 0 100000 0 0 0 1 /end COMPU_METHOD
/begin COMPU_METHOD us_to_ms "time in milliseconds" RAT_FUNC "%3.4" "ms" COEFFS 0 1000 0 0 0 1 /end COMPU_METHOD
/end MODULE
/end PROJECT
